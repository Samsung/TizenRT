/****************************************************************************
 *
 * Copyright 2019 Samsung Electronics All Rights Reserved.
 *
 * Licensed under the Apache License, Version 2.0 (the "License");
 * you may not use this file except in compliance with the License.
 * You may obtain a copy of the License at
 *
 * http://www.apache.org/licenses/LICENSE-2.0
 *
 * Unless required by applicable law or agreed to in writing,
 * software distributed under the License is distributed on an
 * "AS IS" BASIS, WITHOUT WARRANTIES OR CONDITIONS OF ANY KIND,
 * either express or implied. See the License for the specific
 * language governing permissions and limitations under the License.
 *
 ****************************************************************************/
/****************************************************************************
 * kernel/irq/irq_procfs.c
 *
 *   Copyright (C) 2014 Gregory Nutt. All rights reserved.
 *   Author: Gregory Nutt <gnutt@nuttx.org>
 *
 * Redistribution and use in source and binary forms, with or without
 * modification, are permitted provided that the following conditions
 * are met:
 *
 * 1. Redistributions of source code must retain the above copyright
 *    notice, this list of conditions and the following disclaimer.
 * 2. Redistributions in binary form must reproduce the above copyright
 *    notice, this list of conditions and the following disclaimer in
 *    the documentation and/or other materials provided with the
 *    distribution.
 * 3. Neither the name NuttX nor the names of its contributors may be
 *    used to endorse or promote products derived from this software
 *    without specific prior written permission.
 *
 * THIS SOFTWARE IS PROVIDED BY THE COPYRIGHT HOLDERS AND CONTRIBUTORS
 * "AS IS" AND ANY EXPRESS OR IMPLIED WARRANTIES, INCLUDING, BUT NOT
 * LIMITED TO, THE IMPLIED WARRANTIES OF MERCHANTABILITY AND FITNESS
 * FOR A PARTICULAR PURPOSE ARE DISCLAIMED. IN NO EVENT SHALL THE
 * COPYRIGHT OWNER OR CONTRIBUTORS BE LIABLE FOR ANY DIRECT, INDIRECT,
 * INCIDENTAL, SPECIAL, EXEMPLARY, OR CONSEQUENTIAL DAMAGES (INCLUDING,
 * BUT NOT LIMITED TO, PROCUREMENT OF SUBSTITUTE GOODS OR SERVICES; LOSS
 * OF USE, DATA, OR PROFITS; OR BUSINESS INTERRUPTION) HOWEVER CAUSED
 * AND ON ANY THEORY OF LIABILITY, WHETHER IN CONTRACT, STRICT
 * LIABILITY, OR TORT (INCLUDING NEGLIGENCE OR OTHERWISE) ARISING IN
 * ANY WAY OUT OF THE USE OF THIS SOFTWARE, EVEN IF ADVISED OF THE
 * POSSIBILITY OF SUCH DAMAGE.
 *
 ****************************************************************************/

/****************************************************************************
 * Included Files
 ****************************************************************************/

#include <tinyara/config.h>

#include <sys/types.h>
#include <sys/statfs.h>
#include <sys/stat.h>

#include <stdint.h>
#include <stdbool.h>
#include <stdio.h>
#include <stdlib.h>
#include <string.h>
#include <fcntl.h>
#include <assert.h>
#include <errno.h>
#include <debug.h>

#include <tinyara/kmalloc.h>
#include <tinyara/fs/fs.h>
#include <tinyara/fs/procfs.h>
#include <tinyara/fs/dirent.h>

#include "irq/irq.h"
#include <arch/irq.h>

#if !defined(CONFIG_DISABLE_MOUNTPOINT) && defined(CONFIG_FS_PROCFS)

/****************************************************************************
 * Pre-processor Definitions
 ****************************************************************************/
/* Determines the size of an intermediate buffer that must be large enough
 * to handle the longest line generated by this logic.
 */

#define IRQS_LINELEN 64

#ifdef CONFIG_DEBUG_IRQ_INFO
#define IRQS_INFO_TITLE_FMT " %8s | %9s | %3s \n"
#define IRQS_INFO_LINE " ---------|-----------|--------------\n"
#define IRQS_INFO_TITLE "IRQ_NUM", "INT_COUNT", "ISR_NAME"
#define IRQS_INFO_FMT " %8d | %9d | %s \n"
#endif

#define IRQS_LOCK_STATUS "IRQLOCK STATUS:\n"
#define IRQS_LOCK_ENABLED "ENABLED"
#define IRQS_LOCK_DISABLED "DISABLED"
#define IRQS_LOCK_FMT "CPU%d - %8s\n"

#define IRQS          "irqs"
#define IRQS_STATUS   "status"
#define IRQS_LIST     "list"

/*
 * Level 1 : /proc/irqs
 * Level 2 : /proc/irqs/status or /proc/irqs/list
 */

#define IRQS_LEVEL_1   1
#define IRQS_LEVEL_2   2

/****************************************************************************
 * Private Types
 ****************************************************************************/

struct irqs_dir_s {
	struct procfs_dir_priv_s base; /* Base directory private data */
	uint8_t direntry;
	uint8_t dtype;
};

/* This structure describes one open "file" */

struct irqs_file_s {
	struct procfs_file_s base;	/* Base open file structure */
	unsigned int linesize;		/* Number of valid characters in line[] */
	char line[IRQS_LINELEN];	/* Pre-allocated buffer for formatted lines */
	struct irqs_dir_s dir;	       /* Reference to item being accessed */
};

/****************************************************************************
 * Private Function Prototypes
 ****************************************************************************/

/* File system methods */

static int irqs_open(FAR struct file *filep, FAR const char *relpath, int oflags, mode_t mode);
static int irqs_close(FAR struct file *filep);
static ssize_t irqs_read(FAR struct file *filep, FAR char *buffer, size_t buflen);

static int irqs_dup(FAR const struct file *oldp, FAR struct file *newp);

static int irqs_opendir(const char *relpath, FAR struct fs_dirent_s *dir);
static int irqs_closedir(FAR struct fs_dirent_s *dir);
static int irqs_readdir(FAR struct fs_dirent_s *dir);
static int irqs_rewinddir(FAR struct fs_dirent_s *dir);

static int irqs_stat(FAR const char *relpath, FAR struct stat *buf);

/****************************************************************************
 * Private Variables
 ****************************************************************************/

/****************************************************************************
 * Public Variables
 ****************************************************************************/

/* See fs_mount.c -- this structure is explicitly externed there.
 * We use the old-fashioned kind of initializers so that this will compile
 * with any compiler.
 */

const struct procfs_operations irqs_operations = {
	irqs_open,					/* open */
	irqs_close,					/* close */
	irqs_read,					/* read */
	NULL,						/* write */

	irqs_dup,					/* dup */

	irqs_opendir,	 /* opendir */
	irqs_closedir,	 /* closedir */
	irqs_readdir,	 /* readdir */
	irqs_rewinddir, /* rewinddir */

	irqs_stat					/* stat */
};

/****************************************************************************
 * Private Functions
 ****************************************************************************/
/****************************************************************************
 * Name: irqs_find_dirref
 *
 * Description:
 *   Analyse relpath to find the directory reference entry it represents,
 *   if any.
 *
 ****************************************************************************/

static int irqs_find_dirref(FAR const char *relpath, FAR struct irqs_dir_s *dir)
{
	const char *str;
	/* Function to check path is starting with given name */
	int checkStart(char *name, bool isDirectory) {
		uint16_t length = strlen(name);
		if (strncmp(str, name, length) != 0) {
			return ERROR;
		}
		str += length;
		if (str[0] == '\0') {
			return OK;
		}
		if (isDirectory && (str[0] == '/')) {
			str++;
			return OK;
		}
		return ERROR;
	}
	str = relpath;
	/* Check relpath has "irqs" mount point */
	if (checkStart(IRQS, true) == OK) {
		if (str[0] == '\0') {
			dir->base.level = 1;
			dir->base.index = 0;
			dir->base.nentries = 2;
			dir->dtype = DTYPE_DIRECTORY;
			return OK;
		}
		/* Check relpath has "list" mount point */
#ifdef CONFIG_DEBUG_IRQ_INFO
		if (checkStart(IRQS_LIST, false) == OK) {
			dir->base.level = 2;
			dir->base.index = 0;
			dir->base.nentries = 0;
			dir->dtype = DTYPE_FILE;
			return OK;
		/* Check relpath has "status" mount point */
		} else
#endif
		if(checkStart(IRQS_STATUS, false) == OK) {
			dir->base.level = 2;
			dir->base.index = 1;
			dir->base.nentries = 0;
			dir->dtype = DTYPE_FILE;
			return OK;
		}
	}
	fdbg("Invalid Path : Failed to find path %s \n", relpath);
	return -ENOENT;
}
/****************************************************************************
 * Name: irqs_open
 ****************************************************************************/

static int irqs_open(FAR struct file *filep, FAR const char *relpath, int oflags, mode_t mode)
{
	FAR struct irqs_file_s *attr;

	fvdbg("Open '%s'\n", relpath);

	/* PROCFS is read-only.  Any attempt to open with any kind of write
	 * access is not permitted.
	 *
	 * REVISIT:  Write-able proc files could be quite useful.
	 */

	if ((oflags & O_WRONLY) != 0 || (oflags & O_RDONLY) == 0) {
		fdbg("ERROR: Only O_RDONLY supported\n");
		return -EACCES;
	}

	/* Allocate a container to hold the file attributes */

	attr = (FAR struct irqs_file_s *)kmm_zalloc(sizeof(struct irqs_file_s));
	if (!attr) {
		fdbg("ERROR: Failed to allocate file attributes\n");
		return -ENOMEM;
	}
	int ret = irqs_find_dirref(relpath, &attr->dir);
	if (ret == -ENOENT) {
		/* Entry not found */

		kmm_free(attr);
		return ret;
	}
	/* Save the attributes as the open-specific state in filep->f_priv */

	filep->f_priv = (FAR void *)attr;
	return OK;
}

/****************************************************************************
 * Name: irqs_close
 ****************************************************************************/

static int irqs_close(FAR struct file *filep)
{
	FAR struct irqs_file_s *attr;

	/* Recover our private data from the struct file instance */

	attr = (FAR struct irqs_file_s *)filep->f_priv;
	DEBUGASSERT(attr);

	/* Release the file attributes structure */

	kmm_free(attr);
	filep->f_priv = NULL;
	return OK;
}

/****************************************************************************
 * Name: irqs_read
 ****************************************************************************/
static ssize_t irqs_read(FAR struct file *filep, FAR char *buffer, size_t buflen)
{
	FAR struct irqs_file_s *attr;
#ifdef CONFIG_DEBUG_IRQ_INFO
	uint16_t irq_idx;
#endif
	size_t linesize;
	size_t copysize;
	size_t totalsize;
	off_t offset;

	fvdbg("buffer=%p buflen=%d\n", buffer, (int)buflen);

	/* Recover our private data from the struct file instance */

	attr = (FAR struct irqs_file_s *)filep->f_priv;
	DEBUGASSERT(attr);

	offset = filep->f_pos;
	totalsize = 0;
#ifdef CONFIG_DEBUG_IRQ_INFO
	if ((attr->dir.base.level == IRQS_LEVEL_2) && (attr->dir.base.index == 0)) {
		linesize = snprintf(attr->line, IRQS_LINELEN, IRQS_INFO_TITLE_FMT, IRQS_INFO_TITLE);
		copysize = procfs_memcpy(attr->line, linesize, buffer, buflen - totalsize, &offset);
		totalsize += copysize;
		buffer += copysize;

		if (totalsize >= buflen) {
			goto end;
		}

		linesize = snprintf(attr->line, IRQS_LINELEN, IRQS_INFO_LINE);
		copysize = procfs_memcpy(attr->line, linesize, buffer, buflen - totalsize, &offset);
		totalsize += copysize;
		buffer += copysize;

		if (totalsize >= buflen) {
			goto end;
		}

		for (irq_idx = 0; irq_idx < NR_IRQS; irq_idx++) {
			if (g_irqvector[irq_idx].handler != NULL && g_irqvector[irq_idx].handler != irq_unexpected_isr) {
				linesize = snprintf(attr->line, IRQS_LINELEN, IRQS_INFO_FMT, irq_idx, g_irqvector[irq_idx].count, g_irqvector[irq_idx].irq_name);
				copysize = procfs_memcpy(attr->line, linesize, buffer, buflen - totalsize, &offset);	
				totalsize += copysize;
				buffer += copysize;

				if (totalsize >= buflen) {
					goto end;
				}
			}
		}
	} else
#endif
	{
		linesize = snprintf(attr->line, IRQS_LINELEN, IRQS_LOCK_STATUS);
		copysize = procfs_memcpy(attr->line, linesize, buffer, buflen - totalsize, &offset);
		totalsize += copysize;
		buffer += copysize;

		if (totalsize >= buflen) {
			goto end;
		}
		for (int cpu_idx = 0; cpu_idx < CONFIG_SMP_NCPUS; cpu_idx++) {
#ifdef CONFIG_SMP
			linesize = snprintf(attr->line, IRQS_LINELEN, IRQS_LOCK_FMT, cpu_idx, (g_cpu_irqset & (1 << cpu_idx))? IRQS_LOCK_ENABLED : IRQS_LOCK_DISABLED);
#else
#if defined(CONFIG_ARCH_ARMV7A_FAMILY) || defined(CONFIG_ARCH_ARMV7R_FAMILY)
			linesize = snprintf(attr->line, IRQS_LINELEN, IRQS_LOCK_FMT, cpu_idx, (irqstate() & (1 << 7))? IRQS_LOCK_ENABLED : IRQS_LOCK_DISABLED);
#endif
#endif
			copysize = procfs_memcpy(attr->line, linesize, buffer, buflen - totalsize, &offset);
			totalsize += copysize;
			buffer += copysize;

			if (totalsize >= buflen) {
				goto end;
			}
		}
	}

end:
	/* Update the file position */	
	if (totalsize > 0) {
		filep->f_pos += totalsize;
	}

	return totalsize;
}

/****************************************************************************
 * Name: irqs_dup
 *
 * Description:
 *   Duplicate open file data in the new file structure.
 *
 ****************************************************************************/

static int irqs_dup(FAR const struct file *oldp, FAR struct file *newp)
{
	FAR struct irqs_file_s *oldattr;
	FAR struct irqs_file_s *newattr;

	fvdbg("Dup %p->%p\n", oldp, newp);

	/* Recover our private data from the old struct file instance */

	oldattr = (FAR struct irqs_file_s *)oldp->f_priv;
	DEBUGASSERT(oldattr);

	/* Allocate a new container to hold the task and attribute selection */

	newattr = (FAR struct irqs_file_s *)kmm_malloc(sizeof(struct irqs_file_s));
	if (!newattr) {
		fdbg("ERROR: Failed to allocate file attributes\n");
		return -ENOMEM;
	}

	/* The copy the file attributes from the old attributes to the new */

	memcpy(newattr, oldattr, sizeof(struct irqs_file_s));

	/* Save the new attributes in the new file structure */

	newp->f_priv = (FAR void *)newattr;
	return OK;
}

/****************************************************************************
 * Name: irqs_opendir
 *
 * Description:
 *   Open a directory for read access
 *
 ****************************************************************************/

static int irqs_opendir(FAR const char *relpath, FAR struct fs_dirent_s *dir)
{
	FAR struct irqs_dir_s *irqsdir;
	int ret;

	fvdbg("relpath: \"%s\"\n", relpath ? relpath : "NULL");
	DEBUGASSERT(relpath && dir && !dir->u.procfs);

	/* The path refers to the 1st level subdirectory.  Allocate the irqsdir
	 * dirent structure.
	 */
	irqsdir = (FAR struct irqs_dir_s *)kmm_malloc(sizeof(struct irqs_dir_s));

	if (!irqsdir) {
		fdbg("ERROR: Failed to allocate the directory structure\n");
		return -ENOMEM;
	}

	/* Initialize base structure components */
	ret = irqs_find_dirref(relpath, irqsdir);

	if (ret == OK) {
		dir->u.procfs = (FAR void *)irqsdir;
	} else {
		kmm_free(irqsdir);
	}

	return ret;
}

/****************************************************************************
 * Name: irqs_closedir
 *
 * Description: Close the directory listing
 *
 ****************************************************************************/

static int irqs_closedir(FAR struct fs_dirent_s *dir)
{
	FAR struct irqs_dir_s *priv;

	DEBUGASSERT(dir && dir->u.procfs);
	priv = dir->u.procfs;

	if (priv) {
		kmm_free(priv);
	}

	dir->u.procfs = NULL;

	return OK;
}

/****************************************************************************
 * Name: irqs_readdir
 *
 * Description: Read the next directory entry
 *
 ****************************************************************************/

static int irqs_readdir(struct fs_dirent_s *dir)
{
	FAR struct irqs_dir_s *irqsdir;
	int index;

	DEBUGASSERT(dir && dir->u.procfs);
	irqsdir = dir->u.procfs;

	/* Have we reached the end of the directory */
	index = irqsdir->base.index;
	if (index >= irqsdir->base.nentries) {
		return -ENOENT;
	}
	switch (irqsdir->base.level) {
		/* List the content of "irqs" directory */
	case IRQS_LEVEL_1:
		switch (index) {
		case 0:
			dir->fd_dir.d_type = DTYPE_FILE;
			snprintf(dir->fd_dir.d_name, sizeof(dir->fd_dir.d_name), IRQS_LIST);
			irqsdir->base.index++;
			break;
		case 1:
			dir->fd_dir.d_type = DTYPE_FILE;
			snprintf(dir->fd_dir.d_name, sizeof(dir->fd_dir.d_name), IRQS_STATUS);
			irqsdir->base.index++;
			break;
		}
		break;

	default:
		fdbg("Invalid directory level\n");
		return -ENOENT;
	}
	return OK;
}

/****************************************************************************
 * Name: irqs_rewindir
 *
 * Description: Reset directory read to the first entry
 *
 ****************************************************************************/

static int irqs_rewinddir(struct fs_dirent_s *dir)
{
	FAR struct irqs_dir_s *priv;

	DEBUGASSERT(dir && dir->u.procfs);
	priv = dir->u.procfs;

	priv->base.index = 0;
	return OK;
}

/****************************************************************************
 * Name: irqs_stat
 *
 * Description: Return information about a file or directory
 *
 ****************************************************************************/

static int irqs_stat(const char *relpath, struct stat *buf)
{
	int ret;
	struct irqs_dir_s dir;

	/* Decide if the relpath is valid and if it is a file
	 *      or a directory and set it's permissions.
	 */

	ret = irqs_find_dirref(relpath, &dir);

	if (ret == OK) {
		if (dir.dtype == DTYPE_DIRECTORY) {
			/* This is a directory */
			buf->st_mode = S_IFDIR | S_IROTH | S_IRGRP | S_IRUSR;
		} else {
			/* This is a file */
			buf->st_mode = S_IFREG | S_IROTH | S_IRGRP | S_IRUSR;
		}
	}
	buf->st_size = 0;
	buf->st_blksize = 0;
	buf->st_blocks = 0;
	return OK;
}

/****************************************************************************
 * Public Functions
 ****************************************************************************/

#endif							/* !CONFIG_DISABLE_MOUNTPOINT && CONFIG_FS_PROCFS */
