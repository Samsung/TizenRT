## os/libs/libm/libm/arm/armv7-m/Kconfig
```kconfig
#
# For a description of the syntax of this configuration file,
# see kconfig-language at https://www.kernel.org/doc/Documentation/kbuild/kconfig-language.txt
#

if ARCH_ARMV7M

config ARMV7M_LIBM
	bool "Architecture specific FPU optimizations"
	default n
	select LIBM_ARCH_FABSF
	select LIBM_ARCH_SQRTF
	depends on ARCH_FPU
	depends on LIBM
	---help---
		Enable ARMv7E-M specific floating point optimizations
		for fabsf() and fsqrtf()

endif
```

## os/libs/libm/libm/arm/armv8-m/Kconfig
```kconfig
#
# For a description of the syntax of this configuration file,
# see kconfig-language at https://www.kernel.org/doc/Documentation/kbuild/kconfig-language.txt
#

if ARCH_ARMV8M

config ARMV8M_LIBM
	bool "Architecture specific optimizations"
	default n
	select LIBM_ARCH_CEIL if ARCH_DPFPU
	select LIBM_ARCH_FLOOR if ARCH_DPFPU
	select LIBM_ARCH_NEARBYINT if ARCH_DPFPU
	select LIBM_ARCH_RINT if ARCH_DPFPU
	select LIBM_ARCH_ROUND if ARCH_DPFPU
	select LIBM_ARCH_TRUNC if ARCH_DPFPU
	select LIBM_ARCH_CEILF if ARCH_FPU
	select LIBM_ARCH_FLOORF if ARCH_FPU
	select LIBM_ARCH_NEARBYINTF if ARCH_FPU
	select LIBM_ARCH_RINTF if ARCH_FPU
	select LIBM_ARCH_ROUNDF if ARCH_FPU
	select LIBM_ARCH_TRUNCF if ARCH_FPU
	depends on LIBM
	---help---
		Enable ARMv8 specific floating point optimizations.

endif
```

## os/mm/Kconfig
```kconfig
#
# For a description of the syntax of this configuration file,
# see kconfig-language at https://www.kernel.org/doc/Documentation/kbuild/kconfig-language.txt
#

config MM_KERNEL_HEAP
	bool
	default y

config REALLOC_DISABLE_NEIGHBOR_EXTENSION
	bool "Disable Realloc Neighbor Extension"
	default n
	---help---
		If enabled, realloc will not expand from old node to neighbor freenode.
		Instead, realloc will do "malloc new node, memcpy, free old node" which is safe,
		but waste of time and memory space. And it will be one of debugging
		features, especially when you modify existing malloc/free logic.

config KMM_REGIONS
	int "Number of kernel memory regions"
	default 1
	---help---
		If the architecture includes multiple, non-contiguous regions of
		memory to allocate from, KMM_REGIONS should be set to the number of
		memory. Or if you want to use multiple kernel heap, KMM_REGIONS
		should be set to the number of heaps.

config KMM_NHEAPS
	int "Number of kernel heaps"
	default 1
	---help---
		A number of kernel heap memory. If KMM_NHEAPS sets more than equal to 2,
		it can be split for multi kernel heap.
		You can refer to "https://github.com/Samsung/TizenRT/blob/master/docs/HowToUseMultiHeap.md"

config KMM_FORCE_ALLOC_AT
	bool "Force to alloc at specific mm heap for kernel"
	default n
	depends on KMM_NHEAPS != 1
	depends on MM_KERNEL_HEAP
	---help---
		When Enable multi heap, it's possible that need to alloc memory from
		specific heap for kernel

config KMM_FORCE_ALLOC_IDX
	int "Heap index for kernel memory"
	default 0
	depends on KMM_FORCE_ALLOC_AT
	---help---
		Index of the heap that need to alloc for kernel forcedly

config GRAN
	bool "Enable Granule Allocator"
	default n
	---help---
		Enable granule allocator support.  Allocations will be aligned to the
		granule size; allocations will be in units of the granule size.
		Larger granules will give better performance and less overhead but
		more losses of memory due to alignment and quantization waste.

		NOTE: The current implementation also restricts the maximum
		allocation size to 32 granaules.  That restriction could be
		eliminated with some additional coding effort.

config GRAN_SINGLE
	bool "Single Granule Allocator"
	default n
	depends on GRAN
	---help---
		Select if there is only one instance of the granule allocator (i.e.,
		gran_initialize will be called only once. In this case, (1) there
		are a few optimizations that can can be done and (2) the GRAN_HANDLE
		is not needed.

config GRAN_INTR
	bool "Interrupt level support"
	default n
	depends on GRAN
	---help---
		Normally mutual exclusive access to granule allocator data is assured
		using a semaphore.  If this option is set then, instead, mutual
		exclusion logic will disable interrupts.  While this options is more
		invasive to system performance, it will also support use of the granule
		allocator from interrupt level logic.

config DEBUG_GRAN
	bool "Granule Allocator Debug"
	default n
	depends on GRAN && DEBUG
	---help---
		Just like DEBUG_MM, but only generates output from the gran
		allocation logic.

config MM_PGALLOC
	bool "Enable Page Allocator"
	default n
	depends on ARCH_USE_MMU
	select GRAN
	---help---
		Enable support for a MMU physical page allocator based on the
		granule allocator.

if MM_PGALLOC

config MM_PGSIZE
	int "Page Size"
	default 4096
	---help---
		The MMU page size.  Must be one of {1024, 2048, 4096, 8192, or
		16384}.  This is easily extensible, but only those values are
		currently support.

config DEBUG_PGALLOC
	bool "Page Allocator Debug"
	default n
	depends on DEBUG
	---help---
		Just like DEBUG_MM, but only generates output from the page
		allocation logic.

endif # MM_PGALLOC

config MM_ASSERT_ON_FAIL
	bool "Assertion when Memory allocation fail"
	default y
	select MMINFO if APP_BINARY_SEPARATION
	---help---
		When memory allocation fails, make assertion.
		From the application binary with loadable build, it will be reloaded.

config MM_DUMP_CORRPUTED_HEAP
	bool "Dump the complete corrupted heap"
	default n
	---help---
		When we find a heap corruption, we can dump the entire heap, so that
		it can be manually analyzed to find more information about the corruption.

config MM_ALLOC_LARGE_FROM_BACK
	bool "Allocate large chunks from the back of free chunks"
	default n
	---help---
		Reduce heap fragmentation by separating small and large
		allocations. When enabled, chunks whose total size (requested
		size + allocation header, aligned to the memory granule) is
		greater than or equal to MM_LARGE_ALLOC_THRESHOLD are carved
		from the high-address end of the selected free chunk, while
		smaller chunks continue to be carved from the low-address end.

config MM_LARGE_ALLOC_THRESHOLD
	int "Large allocation threshold (bytes)"
	default 1048576
	depends on MM_ALLOC_LARGE_FROM_BACK
	---help---
		Allocations whose physical chunk size (user requested size +
		SIZEOF_MM_ALLOCNODE, granule aligned) is greater than or equal
		to this value are placed at the back of the selected free
		chunk. Default is 512KB. Must be larger than SIZEOF_MM_FREENODE.


config MM_BACKTRACE
	int "Backtrace depth for heap allocations"
	default -1
	---help---
		Enables recording of call-stack backtraces for each heap allocation.
		-1 : Disabled (no overhead)
		 0 : Record the allocation sequence number only (minimal overhead)
		>0 : Record the sequence number + N levels of backtrace (e.g. 4 or 8)

		Each allocation node grows by seqno(4) + N*sizeof(void *) bytes and the
		node header is rounded up to a MM_MIN_CHUNK multiple, so enabling this
		costs RAM on every live and free chunk.  Keep it disabled in production
		builds.  Ported from NuttX CONFIG_MM_BACKTRACE.

if MM_BACKTRACE >= 0

config MM_BACKTRACE_SEQNO
	bool "Record allocation sequence number"
	default y
	---help---
		Each allocation is tagged with a monotonically increasing sequence
		number. Useful for ordering and range-based leak filtering.

config MM_BACKTRACE_DEFAULT
	bool "Enable backtrace recording by default"
	default n
	depends on MM_BACKTRACE > 0
	---help---
		Start with backtrace recording enabled at boot. When disabled,
		recording can be activated later via the heap debug interface.

config MM_BACKTRACE_SKIP
	int "Number of stack frames to skip when capturing backtrace"
	default 3
	depends on MM_BACKTRACE > 0
	---help---
		Skips the given number of innermost frames (typically the allocator
		itself) so the stored trace starts at the actual caller.

endif # MM_BACKTRACE >= 0
```
