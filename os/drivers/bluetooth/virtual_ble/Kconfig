## os/drivers/wireless/scsc/Kconfig
```kconfig
menuconfig SCSC_WLAN
	bool "SCSC Wireless Module support"
	default n
	depends on LIBM && SCHED_WORKQUEUE && !DISABLE_PTHREAD && WPA_SUPPLICANT
	select SPI
	select PIPES

if SCSC_WLAN
config SLSI_WIFI_DEFAULT_WLAN_COUNTRY_CODE
	string "Country code (2 chars)"
	default "00"
	---help---
		The country code to use for the board when starting the first time.
		The country code is a two char upper-case value, e.g. DK, KR, JP, US.
		Use "00" for multi-country international.

config SLSI_WIFI_DEFAULT_WLAN_TX_POWER
	int "TX power in dBm (12-30)"
	range 12 30
	default 30
	---help---
		The default tx power value in dBm to use for the board when starting the first time.
		The tx power value is in the range 0-30 and is of the type dBm.

config SLSI_WIFI_FILESYSTEM_SUPPORT
	bool "Support filesystem"
	default n
	---help---
		The API can utilize the filesystem for configuration files and log files if needed.
		This is the default behavior but can be disabled on systems without filesystems.
		If filesystem support is disabled then functionality like auto-reconnect will not work as
		this uses the config file to store the relevant info across reboots.

if SLSI_WIFI_FILESYSTEM_SUPPORT
config SLSI_WIFI_DIR
	string "Path to where wifi can store the config files (ommit the trailing /)"
	default "/mnt/wifi"
	---help---
		The path where the wifi system can store the config and log files if needed. The path must be
		without the trailing /.

config SLSI_WIFI_LOG_FILE_NAME
	string "Name of the log file to use"
	default "slsiwifi.log"
	---help---
		The name of the file used to store logs from the wifi system.

config SLSI_WIFI_CONFIG_FILE_NAME
	string "name of the configuration file to use"
	default "slsiwifi.conf"
	---help---
		The name of the file used to store information about the wifi system.
endif

config SLSI_RX_PERFORMANCE_TEST
	bool "Enable UDP RX performance test"
        default n
	---help---
	  This option enables RX UDP performance measurement without
	  involving the LWIP stack

config SCSC_TX_FLOW_CONTROL
	bool "Enable TX flow control"
        default y
	---help---
	  This option enables TX flow control

config SCSC_ENABLE_PORT_CONTROL
	bool "Enable controlled/uncontrolled port logic in the driver"
	default y
	---help---
	  This option enables controlled/uncontrolled port logic in the driver

config SCSC_WLAN_STA_ONLY
	bool "Support WLAN STA only (no P2P/AP/IBSS)"
	default n
	---help---
	  Enable only basic STA mode for debugging purposes

config SCSC_WLAN_BLOCK_IPV6
	bool "Block IPv6"
	default n
	---help---
	  This option blocks IPv6 packets.

config SCSC_WLAN_UDP_FLOWCONTROL
	bool "Enable UDP Flow Control by changing LPWORK priority"
	default n
	---help---
	  This option enables when iperf UDP Rx packet drops exist
	  when mbox has been full, LPWORK drops its priority

config SCSC_WLAN_AUTO_RECOVERY
	bool "Enable Auto Recovery"
	default n
	---help---
	  Enables auto recovery on FW panic and SCSC driver watch dog timeouts,
	  which will reset subsystem and re-enable state.

config SCSC_WLAN_POWER_SAVE
        bool "Enable Power Save mode"
        default y
        ---help---
          This option enables driver to configure power save mode in
          firmware.

config SCSC_WLAN_MAX_INTERFACES
	int "Max number of virtual interfaces supported"
	default 1
	---help---
	  The driver structures are sized to support this
	  number of interfaces.

endif

menuconfig SCSC_CORE
	bool "SCSC Core driver Module support"
	default y
	select SPI

if SCSC_CORE

config SCSC_PLATFORM
	bool "Samsung SCSC MIF Platform driver implementation"
	default y

config SCSC_WLANLITE
	bool "Samsung SCSC WLANLITE driver mode"
	default n

config SCSC_DISABLE_WLAN_RESET
	bool "Never power down the Samsung SCSC WLAN CPU"
	default n

endif
```

## os/drivers/wireless/scsc/misc/Kconfig
```kconfig
if SCSC_CORE

config SCSC_PLATFORM
	bool "Samsung SCSC MIF Platform driver implementation"
	default n

config SCSC_WLANLITE
	bool "Samsung SCSC WLANLITE driver mode"
	default n

config SCSC_DISABLE_WLAN_RESET
	bool "Never power down the Samsung SCSC WLAN CPU"
	default n

endif
```
