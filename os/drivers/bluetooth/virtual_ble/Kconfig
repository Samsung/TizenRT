## os/drivers/ttrace/Kconfig
```kconfig
#
# For a description of the syntax of this configuration file,
# see kconfig-language at
# https://www.kernel.org/doc/Documentation/kbuild/kconfig-language.txt
#

comment "T-trace"

config TTRACE
	bool "T-trace support"
	default n
	---help---
		Present T-trace driver, library, TASH commands.
		T-trace can trace and measure times between TPs that
		defined by T-trace API.(trace_begin, trace_end)

if TTRACE
config TTRACE_BUFSIZE
	int "Trace buffer size"
	default 13200
	---help---
		Size of the trace buffer size at kernel.  Default: 13200
config TTRACE_DEVPATH
	string "T-trace device node path"
	default "/dev/ttrace"
endif
```

## os/drivers/usbhost/Kconfig
```kconfig
#
# For a description of the syntax of this configuration file,
# see kconfig-language at https://www.kernel.org/doc/Documentation/kbuild/kconfig-language.txt
#

config USBHOST_NPREALLOC
	int "Number of pre-allocated class instances"
	default 4
	---help---
		Number of pre-allocated class instances

config USBHOST_BULK_DISABLE
	bool "Disable bulk endpoint support"
	default n
	---help---
		On some architectures, selecting this setting will reduce driver size
		by disabling bulk endpoint support

config USBHOST_INT_DISABLE
	bool "Disable interrupt endpoint support"
	default n
	---help---
		On some architectures, selecting this setting will reduce driver size
		by disabling interrupt endpoint support

config USBHOST_ISOC_DISABLE
	bool "Disable isochronous endpoint support"
	default n
	---help---
		On some architectures, selecting this setting will reduce driver size
		by disabling isochronous endpoint support

config USBHOST_HAVE_ASYNCH
	bool
	default n

config USBHOST_ASYNCH
	bool "Asynchronous transfer support"
	default n
	depends on USBHOST_HAVE_ASYNCH
	---help---
		Select if the host controller driver needs to support asynchronous
		I/O transfer.  This may be required, for example, to receive
		infrequent, asynchronous input from an interrupt pipe.

config USBHOST_HUB
	bool "USB Hub Support"
	default n
	depends on USBHOST_HAVE_ASYNCH && !USBHOST_INT_DISABLE
	select USBHOST_ASYNCH
	---help---
		Select this option to build in support for USB hubs.

if USBHOST_HUB

config USBHOST_HUB_POLLMSEC
	int "USB Hub Polling Interval (MSec)"
	default 400
	---help---
		On higher end host controllers (OHCI and EHCI), the asynchronous,
		interrupt IN transfers will pend until data is available from the
		hub.  On lower end host controllers (like STM32 and EFM32), the
		transfer will fail immediately when the device NAKs the first
		attempted interrupt IN transfer (with result == EGAIN) and the hub
		class driver will fall back to polling the hub.

		For the case of the higher end controllers, this polling interval
		is not critical since it would really only be used in the event of
		failures to communicate with the hub.

		But for the lower end host controllers, the asynchronous transfers
		are ineffective and this polling interval becomes a critical
		parameter that must be tuned to tradeoff CPU usage with
		responsiveness to hub-related events (It would, I suppose, be more
		efficient to use synchronous transfers with these lower end host
		controllers).

endif # USBHOST_HUB

config USBHOST_MSC
	bool "Mass Storage Class Support"
	default n
	depends on !BULK_DISABLE
	---help---
		Enable support for the mass storage class driver.  This also depends on
		NFILE_DESCRIPTORS > 0 && SCHED_WORKQUEUE=y

config USBHOST_CDCACM
	bool "CDC/ACM support"
	default n
	depends on USBHOST_HAVE_ASYNCH && !USBHOST_BULK_DISABLE && !USBHOST_INT_DISABLE
	select USBHOST_ASYNCH
	select SERIAL_REMOVABLE
	---help---
		Select this option to build in host support for CDC/ACM serial
		devices.

if USBHOST_CDCACM

choice
	prompt "CDC/ACM Protocol"
	default USBHOST_CDCACM_COMPLIANT if SERIAL_OFLOWCONTROL && !USBHOST_INT_DISABLE
	default USBHOST_CDCACM_REDUCED  if !SERIAL_OFLOWCONTROL || USBHOST_INT_DISABLE

config USBHOST_CDCACM_COMPLIANT
	bool "CDC/ACM compliant"
	depends on SERIAL_OFLOWCONTROL && !USBHOST_INT_DISABLE
	---help---
		The device needs to implement the Abstract Control Model (ACM)
		subclass defined in the USB Communication Device Class (CDC)
		specification. This protocol requires two USB interfaces, a data
		interface which consists of two endpoints (bulk in + bulk out) and a
		control interface which consists of one interrupt in endpoint.
		Furthermore, on EP0 the device must implement the class-specific
		requests defined by the CDC specification. Because this USB protocol
		is compliant to the CDC/ACM standard on some other operating systems
		(e.g. Linux, MacOS) the device can work with in-box drivers.

config USBHOST_CDCACM_REDUCED
	bool "CDC/ACM reduced"
	---help---
		This mode uses the CDC data interface (bulk in + bulk out endpoint)
		only. No control interface (interrupt in endpoint) is required. The
		device needs to implement the CDC class-specific requests, so that
		is still possible to support baud rate settings and serial control/
		status lines. This mode is useful if the number of available
		endpoints is limited by hardware restrictions.

		If the the CDC/ACM compliant protocol is selected, then the reduced
		protocol is supported for devices that provide not interrupt IN
		endpoint.  This option is then most useful for testing purposes or
		if there are insufficient resources to support the compliant
		protocol.   The interrupt IN control interface will not be used even
		if it is available in this case.

config USBHOST_CDCACM_BULKONLY
	bool "Bulk only protocol"
	---help---
		The device implements only the data interface (bulk in + bulk out
		endpoint). The device does not provide an additional control
		interface and does not need to implement any class-specific requests
		on EP0. Because bulk transfer mode provides flow control, there is
		no need to support serial control/status lines. The advantage of
		the bulk-only protocol is that the implementation efforts on the
		device side are reduced to a minimum.

		By default, both the CDC/ACM compliant protocol and the reduced
		protocol are supported.  This option is then most useful for testing
		purposes.  The interrupt IN control interface will not be used even
		if it is available; nor will EP0 class requestes.

endchoice # CDC/ACM Protocol

config USBHOST_CDCACM_NTDELAY
	int "CDC/ACM notification polling interval (MSec)"
	default 400
	depends on USBHOST_CDCACM_COMPLIANT
	---help---
		On higher end host controllers (OHCI and EHCI), the asynchronous,
		interrupt IN transfers will pend until data is available from the
		hub.  On lower end host controllers (like STM32 and EFM32), the
		transfer will fail immediately when the device NAKs the first
		attempted interrupt IN transfer (with result == EGAIN) and the hub
		class driver will fall back to polling the hub.

		For the case of the higher end controllers, this polling interval
		is not critical since it would really only be used in the event of
		failures to communicate with the hub.

		But for the lower end host controllers, the asynchronous transfers
		are ineffective and this polling interval becomes a critical
		parameter that must be tuned to tradeoff CPU usage with
		responsiveness to hub-related events (It would, I suppose, be more
		efficient to use synchronous transfers with these lower end host
		controllers).

config USBHOST_CDCACM_RXDELAY
	int "RX poll delay (MSec)"
	default 200
	---help---
		When the CDC/ACM device is inactive, the host must poll it at this
		rate in order to discover if it has serial data to send to us.

config USBHOST_CDCACM_TXDELAY
	int "TX poll delay (MSec)"
	default 200
	---help---
		When the appellation is inactive, the host must poll it at this
		rate in order to discover if it has serial data to send to to the
		device.

config USBHOST_CDCACM_NPREALLOC
	int "Preallocated state"
	default 0
	---help---
		If this setting is zero, the CDC/ACM class driver will allocate
		memory as needed for CDC/ACM device state.  If this value is non-
		zero, then it provides a number of preallocated CDC/ACM state
		structures.  This increases the static size of the code image, but
		eliminates all, direct, run-time allocations by the driver.

config USBHOST_CDCACM_BAUD
	int "Initialize CDC/ACM BAUD"
	default 115200

config USBHOST_CDCACM_PARITY
	int "Initialize CDC/ACM parity"
	default 0
	range 0 2
	---help---
		Initialize CDC/ACM parity.  0=None, 1=Odd, 2=Even.  Default: None

config USBHOST_CDCACM_BITS
	int "Initialize CDC/ACM number of bits"
	default 8
	---help---
		Initialize CDC/ACM number of bits.  Default: 8

config USBHOST_CDCACM_2STOP
	int "Initialize CDC/ACM two stop bits"
	default 0
	---help---
		0=1 stop bit, 1=Two stop bits.  Default: 1 stop bit

config USBHOST_CDCACM_RXBUFSIZE
	int "Serial RX buffer size"
	default 128
	---help---
		This is the size of the serial buffer that will be used to hold
		received data.

config USBHOST_CDCACM_TXBUFSIZE
	int "Serial TX buffer size"
	default 128
	---help---
		This is the size of the serial buffer that will be used to hold
		data waiting for tranmission.

endif # USBHOST_CDCACM

config USBHOST_RTL8187
	bool "RTL8187-based wireless LAN"
	default n
	depends on NET

if USBHOST_RTL8187

config RTL8187B
	bool "RTL8187B chip"
	default y

config RTL8187_VID
	hex "RTL8187 VID"
	default 0x0bda

config RTL8187_PID
	hex "RTL8187 PID"
	default 0x8189

endif # USBHOST_RTL8187

config USBHOST_RTL8723D
	bool "RTL8723D-based wireless LAN"
	default n
	depends on NET

if USBHOST_RTL8723D

config RTL8723D
	bool "RTL8723D chip"
	default y

config RTL8723D_VID
	hex "RTL8723D VID"
	default 0x0bda

config RTL8723D_PID
	hex "RTL8723D PID"
	default 0xd723

endif # USBHOST_RTL8723D

config USBHOST_TRACE
	bool "Enable USB HCD tracing for debug"
	default n
	---help---
		Enables USB tracing for debug.  Only supported for the HCD and,
		further, no supported by all HCD implementations.

if USBHOST_TRACE

config USBHOST_TRACE_NRECORDS
	int "Number of trace entries to remember"
	default 128
	---help---
		Number of trace entries to remember.

config USBHOST_TRACE_VERBOSE
	bool "Enable verbose debug trace"
	default n
	---help---
		Enable verbose trace output if supported by the platform.  The
		intent is that if USBHOST_TRACE_VERBOSE is not defined, then only
		errors, warnings, and critical messages would be logged.  If
		USBHOST_TRACE_VERBOSE is defined, then general informative trace
		information would also be included.

endif
```

## os/drivers/usbhost/uvc/Kconfig
```kconfig
#
# For a description of the syntax of this configuration file,
# see the file kconfig-language.txt in the NuttX tools repository.
#

config USBHOST_UVC
	bool "USB Video Class Driver"
	default n

if USBHOST_UVC

config USBUVC_TRF_PRIO
	int "UVC Transfer Thread Priority"
	default 220
	---help---
		The asynchronous, isochronous IN transfers will be called every 125us, copying of data from
		isochronous IN buffer to user buffer would take more time. Have to be done in a separate
		thread without blocking the transfer callback. Priority of this thread decides the fps at
		which frames can be delivered to user applications.
config USBUVC_TRF_STACKSIZE
	int "UVC Transfer Thread Stack Size"
	default 2048
	---help---
		The asynchronous, isochronous IN transfers will be called every 125us, copying of data from
		isochronous IN buffer to user would take more time. Have to be done in a separate thread
		without blocking the transfer callback. Video driver transfer completion nofication is
		called from this thread, stack size should atleast 2048.
endif # USBHOST_UVC
```

## os/drivers/video/Kconfig
```kconfig
#
# For a description of the syntax of this configuration file,
# see kconfig-language at https://www.kernel.org/doc/Documentation/kbuild/kconfig-language.txt
#

config VIDEO_FB
	bool "Framebuffer character driver"
	default n

config FB_SYNC
	bool "Hardware signals vertical sync"
	depends on VIDEO_FB
	default n

config FB_OVERLAY
	bool "Framebuffer overlay support"
	depends on VIDEO_FB
	default n

config FB_OVERLAY_BLIT
	bool "Framebuffer overlay blit support"
	depends on FB_OVERLAY
	default n

config VIDEO_SOURCE
	bool "Driver for Video Source"
	default n

config VIDEO_NULL
	bool "Driver for Dummy Video lowerhalf"
	depends on VIDEO_SOURCE
	default n

if VIDEO_NULL

	comment "Select from the following supported options"

choice
	prompt   "Supported video-frame format options (-L)"

config NULL_VIDEO_FORMAT_MJPEG
	bool "MJPEG Video Format"

config NULL_VIDEO_FORMAT_YUY2
	bool "YUY2 Video Format"

endchoice

choice
	prompt   "Supported frame resolutions (-U)"

config NULL_QVGA
	bool "(0)QVGA (320x240)"

config NULL_VGA
	bool "(1)VGA (640x480)"

config NULL_QUADVGA
	bool "(2)QUADVGA (1280x960)"

config NULL_HD
	bool "(3)HD (1280x720)"

comment "Higher frame resolutions may not be supported"
comment "due to device memory restrictions"

config NULL_FHD
	bool "(4)FHD (1920x1080)"

config NULL_5M
	bool "(5)5M (2560x1920)"

config NULL_3M
	bool "(6)3M (2048x1536)"

endchoice

choice
	prompt   "Supported frame rates (-K)"

config NULL_FR_30
	bool "(0)1/30"

config NULL_FR_20
	bool "(1)1/20"

config NULL_FR_15
	bool "(2)1/15"

config NULL_FR_10
	bool "(3)1/10"

endchoice

config NULL_NUM_FRAMES
	int "No. of frames to be rendered"
	default 10

comment "The options displayed are only to provide help to the user"
comment "Actual option selection is to be done at runtime only using the commands and option numbers"
comment "For eg. - camera -L 0 -U 1 -K 2 -n 2"

endif
```

## os/drivers/wifi_csi/Kconfig
```kconfig
menu "CSI Driver Support"

menuconfig WIFI_CSI
	bool "CSI Support"
	default n
	select DEBUG_WIFICSI
	---help---
		Enable support for WIFI CSI driver.

if WIFI_CSI

config WIFICSI_CUSTOM_DEV_PATH
	string "Use custom device path"
	default "/dev/wificsi"

comment "CSI Devices"

choice
	prompt "Choose CSI device"
	default WIFI_CSI_RTL8730E
	---help---
		WIFI_CSI_RTL8730E for aidual chip
		/* Will support more in future like shown below */
		/* WIFI_CSI_RTL8721CSM for tp1x chip */


config WIFI_CSI_RTL8730E
	bool "WIFI_CSI_RTL8730E Driver"
	---help---
		Enable CSI Driver, WIFI_CSI_RTL8730E.

endchoice

endif # WIFI_CSI
endmenu
```

## os/drivers/wireless/Kconfig
```kconfig
#
# For a description of the syntax of this configuration file,
# see kconfig-language at https://www.kernel.org/doc/Documentation/kbuild/kconfig-language.txt
#

if DRIVERS_WIRELESS && SELECT_SCSC_WLAN

source drivers/wireless/scsc/Kconfig

endif # DRIVERS_WIRELESS
if DRIVERS_WIRELESS && SELECT_RTK_WLAN

source drivers/wireless/realtek/Kconfig

endif # DRIVERS_WIRELESS
```

## os/drivers/wireless/bluetooth/Kconfig
```kconfig
#
# For a description of the syntax of this configuration file,
# see the file kconfig-language.txt in the NuttX tools repository.
#

config BLUETOOTH_NULL
	bool "NULL Bluetooth device"
	default n
	---help---
		A do-nothing Bluetooth device driver to permit some basic testing of
		the Bluetooth stack on the simulator.  This driver just "closes the
		loop" and nothing more:  It is a just a bit-bucket for outgoing
		packets; it generates no incoming packets.
```
