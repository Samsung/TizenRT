## os/drivers/cpu/Kconfig
```kconfig
#
# For a description of the syntax of this configuration file,
# see kconfig-language at https://www.kernel.org/doc/Documentation/kbuild/kconfig-language.txt
#

config CPU_DRIVER
    bool "CPU state driver"
    default n
    depends on SMP
    ---help---
        Enable /dev/cpuX driver for secondary CPU state control.
        Provides IOCTL interface to manage CPU state (running, stop and query status).
```

## os/drivers/fscmd/Kconfig
```kconfig
#
# For a description of the syntax of this configuration file,
# see kconfig-language at https://www.kernel.org/doc/Documentation/kbuild/kconfig-language.txt
#

config FSCMD_DRV
	bool "File System Command Driver"
	default y
	depends on FS_CMDS
	---help---
		Support Kernel Context Access to File System Commands Used in the Tash Shell.
```

## os/drivers/gpio/Kconfig
```kconfig
#
# For a description of the syntax of this configuration file,
# see kconfig-language at https://www.kernel.org/doc/Documentation/kbuild/kconfig-language.txt
#

if GPIO

config GPIO_EXPORT
	bool "Support GPIO Export/Unexport."
	default n
	---help---
    Like a linux, userspace may ask the kernel to export control a GPIO to
    userspace by writing its number to this file. Then You can make easily new
    gpio pin is possible to read and write.
    For example: "echo 14 > /dev/gpio_export" will create a "gpio14" node for
    GPIO #14.

endif # GPIO
```

## os/drivers/input/Kconfig
```kconfig
menu "Touch Device Support"

menuconfig TOUCH
	bool "Touch Device Support"
	default n
	---help---
		Drivers for Touch Devices. These drivers support
		interfaces as defined in include/tinyara/input/touchscreen.h

		This selection is necessary to enable support for touch drivers in
		drivers/input

if TOUCH
choice
	prompt "choose TOUCH device"
	default TOUCH_IST415
	---help---
		IST415 with I2C

config TOUCH_IST415
	bool "IST415 Support"
	---help---
		Enable the Touch device IST415
endchoice

choice
	prompt "choose TOUCH DEVICE app notification type"
	default TOUCH_POLL
	
config TOUCH_POLL
	bool "Polling Notification"
	---help---
		Enable polling based notification to application

config TOUCH_CALLBACK
	bool "Callback Notification"
	---help---
		Enable callback based notification to application
endchoice

config TOUCH_NPOLLWAITERS
	int "Number of Multipolling Wait"
	default 2
	---help---
		Number of waiting fds to read touch data

config TOUCH_BUFSIZE
	int "Touch point buffer size"
	default 30
	---help---
		The touch points are buffered. One size means one
		touched pointer.

if TOUCH_IST415

config IST415_WORKPRIORITY
	int "ist415 irq process thread priority"
	default 201
	---help---
		The execution priority of the ist415 touchscreen irq process thread.

		When an interrupt occurs from the touchscreen IC, the thread reads
		the data of the IC through I2C to process the event.
		For example, it distinguishes whether it is touch data or not and
		generates a touch point event. If it is not touch data, it performs
		related tasks and waits next event.

endif # TOUCH_IST415
endif # TOUCH

endmenu # Touch Device Support
```

## os/drivers/iotdev/Kconfig
```kconfig
#
# For a description of the syntax of this configuration file,
# see kconfig-language at https://www.kernel.org/doc/Documentation/kbuild/kconfig-language.txt
#

config IOTDEV
	bool "Support IoT Device"
	default n
	---help---
		Handle events from peripheral devices
```

## os/drivers/kernel_test/Kconfig
```kconfig
#
# For a description of the syntax of this configuration file,
# see kconfig-language at https://www.kernel.org/doc/Documentation/kbuild/kconfig-language.txt
#

config DRIVERS_KERNEL_TEST
	bool
	default n
	---help---
		Enables overall support for kernel test driver library.
```

## os/drivers/lcd/Kconfig
```kconfig
#
# For a description of the syntax of this configuration file,
# see kconfig-language at https://www.kernel.org/doc/Documentation/kbuild/kconfig-language.txt
#

menu "LCD Driver Support"

menuconfig LCD
	bool "Graphic LCD Driver Support"
	default n
	---help---
		Drivers for parallel and serial LCD and OLED type devices.  These
		drivers support interfaces as defined in include/nuttx/lcd/lcd.h

		This selection is necessary to enable support for LCD drivers in
		drivers/lcd as well as for board-specific LCD drivers in the configs/
		subdirectories.

if LCD

config LCD_HWCURSOR
	bool
	default n

config LCD_PACKEDMSFIRST
	bool
	default n

config LCD_UPDATE
	bool
	default n
	select NX_UPDATE if NX

comment "Common Graphic LCD Settings"

config LCD_FRAMEBUFFER
	bool "LCD framebuffer front end"
	default n
	select LCD_UPDATE
	---help---
		Enable a "front end" that converts an sequential LCD driver into a
		standard, NuttX frame buffer driver.

		NOTE: Some LCD drivers implement an internal framebuffer for
		effeciency reasons but do not export a framebuffer interface.  So
		those LCD cannot be used as framebuffer drivers.  If the option is
		available, then such internal framebuffer support should be
		disabled because this external common framebuffer interface will
		provide the necessary buffering.

config LCD_EXTERNINIT
	bool "External LCD Initialization"
	default n
	depends on LCD_FRAMEBUFFER
	---help---
		Define to support external LCD initialization by platform-specific
		code.  This this option is defined, then the LCD framebuffer
		emulation will call board_graphics_setup() to initialize the
		graphics device.  This option is necessary if display is used that
		cannot be initialized using the standard LCD interfaces.

menu "LCD driver selection"

config LCD_NOGETRUN
	bool "Write-only LCD"
	default n
	---help---
		Many LCD hardware interfaces provide only minimal graphics capability.  In
		particulary, many simple LCD interfaces are write only.  That is we, can
		write graphics data to the LCD device memory, but we cannot read it back.
		If the LCD hardware does not support reading the graphics memory, then
		this option should be defined so that the NX layer can taking alternative
		measures when the LCD is not readable.  For example, if the LCD is not
		readable, then NX will not attempt to support transparency.

		See also NX_WRITEONLY in the graphics support menu.

config LCD_DMA_SUPPORT
	bool "LCD support DMA transmit"
	default n
	---help---
		Default putrun interface transmit data to LCD line by line, while some  
		device may support DMA transmit, which could send data buffer of the update
		area all together, to acheive a better flushing performance. to support this
		config, the specific lcd driver need to implement corresponding interface

config LCD_MAXCONTRAST
	int "LCD maximum contrast"
	default 63
	range 1 255
	---help---
		must be 63 with the Epson controller and 127 with
		the Phillips controller.

config LCD_MAXPOWER
	int "LCD maximum power"
	default 1
	range 1 255
	---help---
		Maximum value of LCD power setting.  This normally equates to brightness:
		The brighter the screen, the hight the power usage.

		On LCDs that have a backlight, this value corresponds directly to that
		backlight setting.  Board-specific logic may place restrictions on this
		value.

comment "Graphic LCD Devices"

choice
	prompt "LCD Orientation"
	default LCD_LANDSCAPE
	depends on LCD
	---help---
		Some LCD drivers may support displays in different orientations.
		If the LCD driver supports this capability, than these are configuration
		options to select that display orientation.

config LCD_LANDSCAPE
	bool "Landscape orientation"
	---help---
		Define for "landscape" orientation support.  Landscape mode refers one
		of two orientations where the display is wider than it is tall
		(LCD_RLANDSCAPE is the other).  This is the default orientation.

config LCD_PORTRAIT
	bool "Portrait orientation"
	---help---
		Define for "portrait" orientation support.  Portrait mode refers one
		of two orientations where the display is taller than it is wide
		(LCD_RPORTAIT is the other).

config LCD_RPORTRAIT
	bool "Reverse portrait display"
	---help---
		Define for "reverse portrait" orientation support.  Reverse portrait mode
		refers one of two orientations where the display is taller than it is
		wide (LCD_PORTAIT is the other).

config LCD_RLANDSCAPE
	bool "Reverse landscape orientation"
	---help---
		Define for "reverse landscape" orientation support.  Reverse landscape mode
		refers one of two orientations where the display is wider than it is
		tall (LCD_LANDSCAPE is the other).

endchoice

config LCD_ILI9341
	bool "ILI9341 LCD Single Chip Driver"
	default n
	---help---
		LCD Single Chip Driver, ILI9341, ILI Technology Corp. Used
		with the STM32F429i Discovery Board.

		Required LCD driver settings:
		LCD_MAXCONTRAST should be 255, but any value >0 and <=255 will be accepted.
		LCD_MAXPOWER should be 1:  0=off, 1=on

config LCD_ILI9341_NINTERFACES
	int "Number of supported display driver"
	range 1 2
	default 1
    depends on LCD_ILI9341
	---help---
		Define the number of supported  displays driven by a ili9341 LCD Single
		Chip Driver.

config LCD_ILI9341_IFACE0
	bool "(1) LCD Display"
	depends on LCD_ILI9341_NINTERFACES = 1 || LCD_ILI9341_NINTERFACES = 2
	---help---
		Configure first LCD Display.

if LCD_ILI9341_IFACE0
choice
	prompt "LCD Orientation"
	default LCD_ILI9341_IFACE0_LANDSCAPE
	---help---
		Configure display orientation.

config LCD_ILI9341_IFACE0_LANDSCAPE
	bool "Landscape orientation"
	---help---
		Define for "landscape" orientation support.

config LCD_ILI9341_IFACE0_PORTRAIT
	bool "Portrait orientation"
	---help---
		Define for "portrait" orientation support.

config LCD_ILI9341_IFACE0_RLANDSCAPE
	bool "Reverse landscape orientation"
	---help---
		Define for "reverse landscape" orientation support.

config LCD_ILI9341_IFACE0_RPORTRAIT
	bool "Reverse portrait display"
	---help---
		Define for "reverse portrait" orientation support.

endchoice

choice
	prompt "Color format"
	default LCD_ILI9341_IFACE0_RGB565
	---help---
		LCD color format.

config LCD_ILI9341_IFACE0_RGB565
	bool "16 bpp RGB565 color format"
	---help---
		16 bpp RGB565 color format

endchoice
endif

config LCD_ILI9341_IFACE1
	bool "(2) LCD Display"
	depends on LCD_ILI9341_NINTERFACES = 2
	---help---
		Configure second LCD Display.

if LCD_ILI9341_IFACE1
choice
	prompt "LCD Orientation"
	default LCD_ILI9341_IFACE1_LANDSCAPE
	---help---
		Configure display orientation.

config LCD_ILI9341_IFACE1_LANDSCAPE
	bool "Landscape orientation"
	---help---
		Define for "landscape" orientation support.

config LCD_ILI9341_IFACE1_PORTRAIT
	bool "Portrait orientation"
	---help---
		Define for "portrait" orientation support.

config LCD_ILI9341_IFACE1_RLANDSCAPE
	bool "Reverse landscape orientation"
	---help---
		Define for "reverse landscape" orientation support.

config LCD_ILI9341_IFACE1_RPORTRAIT
	bool "Reverse portrait display"
	---help---
		Define for "reverse portrait" orientation support.

endchoice

choice
	prompt "Color format"
	default LCD_ILI9341_IFACE1_RGB565
	---help---
		LCD color format.

config LCD_ILI9341_IFACE1_RGB565
	bool "16 bpp RGB565 color format"
	---help---
		16 bpp RGB565 color format

endchoice
endif

endmenu # LCD Driver selection
endif # LCD

endmenu # LCD Driver Support
```

## os/drivers/lwnl/Kconfig
```kconfig
#
# For a description of the syntax of this configuration file,
# see kconfig-language at https://www.kernel.org/doc/Documentation/kbuild/kconfig-language.txt

choice LWNL80211_DRV
	prompt"Driver selelction"
	default LWNL80211_VIRTUAL

config LWNL80211_VIRTUAL
	bool "Virtual driver"
	depends on !SELECT_SCSC_WLAN && !SELECT_RTK_WLAN
	---help---
		Virtual WiFi driver

config LWNL80211_SLSI
	bool "SLSI driver"
	depends on SELECT_SCSC_WLAN
	---help---
		Samsung Artik WiFi driver

config LWNL80211_RTK
	bool "Realtek driver"
	depends on SELECT_RTK_WLAN
	---help---
		Realtek WiFi driver

config LWNL80211_ETHERNET
	bool "Ethernet driver"
	---help---
		Ethernet driver
endchoice

config DEBUG_LWNL80211_ERROR
	bool "LWNL80211 ERROR DEBUG"
	default n
	---help---
		Enable LWNL80211 ERROR DEBUG

config DEBUG_LWNL80211_INFO
	bool "LWNL80211 INFO DEBUG"
	default n
	depends on DEBUG_VERBOSE
	---help---
		Enable LWNL80211 INFO DEBUG

config DEBUG_LWNL80211_VENDOR_DRV_ERROR
	bool "Vendor-specific driver interface ERROR DEBUG"
	default n
	depends on DEBUG_ERROR
	---help---
		Enable Vendor-Specific Driver ERROR Debug

config DEBUG_LWNL80211_VENDOR_DRV_INFO
	bool "Vendor-specific driver interface INFO DEBUG"
	default n
	depends on DEBUG_VERBOSE
	---help---
		Enable Vendor-Specific Driver INFO Debug
```

## os/drivers/mmwave/Kconfig
```kconfig
#
# For a description of the syntax of this configuration file,
# see kconfig-language at https://www.kernel.org/doc/Documentation/kbuild/kconfig-language.txt
#

menu "MMWave Driver Support"

menuconfig MMWAVE_SENSOR
        bool "MMWAVE Driver Support"
        default n
        ---help---
                Enable support for mmWave Sensor devices. This includes
		        drivers for SPI-based sensors like the IWRL6432.

                This selection is necessary to enable support for MMWAVE drivers in
                drivers/mmwave as well as for board-specific MMWAVE drivers in the configs subdirectories.

if MMWAVE_SENSOR
choice
        prompt "choose MMWAVE device"
        default SENSOR_IWRL6432
        ---help---
                IWRL6432 with SPI interface

config SENSOR_IWRL6432
        bool "IWRL6432 Support"
        ---help---
                Enable the mmWave Sensor IWRL6432 driver
endchoice

endif # MMWAVE_SENSOR

endmenu # MMWAVE Driver Support
```

## os/drivers/os_api_test/Kconfig
```kconfig
#
# For a description of the syntax of this configuration file,
# see kconfig-language at https://www.kernel.org/doc/Documentation/kbuild/kconfig-language.txt
#

config DRIVERS_OS_API_TEST
	bool
	default n
	---help---
		Enables overall support for OS API test driver library.
```

## os/drivers/pipes/Kconfig
```kconfig
#
# For a description of the syntax of this configuration file,
# see kconfig-language at https://www.kernel.org/doc/Documentation/kbuild/kconfig-language.txt
#

config DEV_PIPE_SIZE
	int "Default pipe size"
	default 1024
	---help---
		Sets the default size of the pipe ringbuffer in bytes.  A value of
		zero disables pipe support.
```

## os/drivers/seclink/Kconfig
```kconfig
#
# For a description of the syntax of this configuration file,
# see kconfig-language at https://www.kernel.org/doc/Documentation/kbuild/kconfig-language.txt
#

config SECURITY_LINK_DRV
	bool "seclink Driver Support"
	select SECURITY_LINK
	default n
	---help---
		Enable seclink Driver to support communication between HAL and security API.

if SECURITY_LINK_DRV

source "$FRAMEWORK_DIR/src/seclink/Kconfig"

config SECURITY_LINK_DRV_PROFILE
	bool "Display security driver performance"
	depends on TIMER
	default n
	---help---
		Enable seclink Driver to support communication between HAL and security API.

endif #SECURITY_LINK_DRV
```

## os/drivers/taskmgt/Kconfig
```kconfig
#
# For a description of the syntax of this configuration file,
# see kconfig-language at
# https://www.kernel.org/doc/Documentation/kbuild/kconfig-language.txt
#

comment "Task Management"

config TASKMGT_DRIVER
	bool "Task management support"
	default n
	---help---
		Task management driver.
```

## os/drivers/testcase/Kconfig
```kconfig
#
# For a description of the syntax of this configuration file,
# see kconfig-language at https://www.kernel.org/doc/Documentation/kbuild/kconfig-language.txt
#

config KERNEL_TEST_DRV
	bool
	default n
	---help---
		Enables overall support for Kernel testcase driver library.
```
