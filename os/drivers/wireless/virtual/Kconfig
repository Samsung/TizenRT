## os/kernel/binary_manager/Kconfig
```kconfig
#
# For a description of the syntax of this configuration file,
# see kconfig-language at https://www.kernel.org/doc/Documentation/kbuild/kconfig-language.txt
#

config USE_BP
	bool "Enable bootparameters"
	default n
	---help---
		This enables the use of bootparameters

config BINARY_MANAGER
	bool "Enable Binary Manager"
	default n
	depends on !DISABLE_MQUEUE && !DISABLE_SIGNAL
	depends on MTD_FTL && FLASH_PARTITION
	---help---
		This is kernel thread which manages binaries.
		It loads/unloads binaries and recovers any fault occurs in a system.

if BINARY_MANAGER

config BM_PRIORITY_MAX
	int
	default 205
	---help---
		This is a maximum priority of kernel threads which are in charge of binary management.

config BM_PRIORITY_MIN
	int
	default 200
	---help---
		This is a minimum priority of kernel threads which are in charge of binary management.

config BINMGR_RECOVERY
	bool "Enable Recovery Management"
	default y
	depends on APP_BINARY_SEPARATION && BINFMT_LOADABLE
	depends on !BINMGR_RELOAD_REBOOT
	---help---
		Enable the recovery management.
		If any fault occurs in a system, it will either restart binary or reboot the system
		accroding to the configuration.

config BINMGR_UPDATE
	bool "Enable Binary Update"
	default y
	select BCH
	select LIB_BOARDCTL
	select BOARDCTL_RESET
	---help---
		Enables Binary Manager Update APIs.

config BINMGR_UPDATE_SAME_VERSION
	bool "Allow Same Version Binary Update"
	default y
	depends on BINMGR_UPDATE
	---help---
		Allow same version binary update.
		If it is disabled, only higher version can be updated.

config BINMGR_RELOAD_REBOOT
	bool "Enable board reset for binary reloading"
	default n
	depends on BINMGR_UPDATE
	---help---
		Enable the board reset for binary reloading.
		If it is enabled, the board will be rebooted for binary reloading when fault recovery or binary update.

endif # BINARY_MANAGER
```

## os/kernel/crashlog_writer/Kconfig
```kconfig
#
# For a description of the syntax of this configuration file,
# see kconfig-language at https://www.kernel.org/doc/Documentation/kbuild/kconfig-language.txt
#


config CRASHLOG_WRITER
	bool "enable crashlog writer"
	default n
    depends on BINMGR_RECOVERY
	---help---
        This saves the crash log.

if CRASHLOG_WRITER

config CLWR_COMPRESS
    bool "CRASHLOG_COMPRESS"
    default y
    ---help---
        Controls whether compression is applied.
        if the value is 0 compression is not performed.


config CLWR_BUF_SIZE
    int "CRASHLOG_BUF_SIZE"
    default 8192
    ---help---
        Determines the size of the buffer where crash logs will be stored.
        The crash log is stored in the data section.
        
config CLWR_REBOOT
    bool "REBOOT_AFTER_SAVING_LOG"
    default n
    ---help---
        Determines whether to reboot after saving the crash log.

config CLWR_MAX_FILES
    int "MAX_FILES"
    default 5
    ---help---
        Determine the maximum number of crash log files to be stored.

config CLWR_RETRY_COUNT
    int "CRASHLOG_RETRY_COUNT"
    default 5
    depends on !REBOOT_AFTER_LOG_SAVE
    ---help---
        Limit the number of crash log saves in user mode during consecutive crashes to preserve flash memory lifespan.

config CLWR_RECORD_TIME
    bool "CRASHLOG_RECORD_TIME"
    default n
    ---help---
        Measure and record the time it takes to save the crash log to a file.

endif # CRASHLOG_SAVE
```

## os/kernel/log_dump/Kconfig
```kconfig
#
# For a description of the syntax of this configuration file,
# see kconfig-language at https://www.kernel.org/doc/Documentation/kbuild/kconfig-language.txt
#


config LOWLOG_DUMP
	bool "enable lowlog dump"
	default n
    depends on BINMGR_RECOVERY
	---help---
        This saves the lowlog.

if LOWLOG_DUMP

config LOWLOG_DUMP_COMPRESS
    bool "LOWLOG_DUMP_COMPRESS"
    default y
    ---help---
        Controls whether compression is applied.
        if the value is n compression is not performed.


config LOWLOG_DUMP_BUF_SIZE
    int "LOWLOG_DUMP_BUF_SIZE"
    default 8192
    ---help---
        Determines the size of the buffer where crash logs will be stored.
        The low log is stored in the data section.
        
config LOWLOG_DUMP_REBOOT
    bool "REBOOT_AFTER_SAVING_LOG"
    default y
    ---help---
        Determines whether to reboot after saving the low log.

config LOWLOG_DUMP_MAX_FILES
    int "LOWLOG_DUMP_MAX_FILES"
    default 5
    ---help---
        Determine the maximum number of low log files to be stored.

config LOWLOG_DUMP_RECORD_TIME
    bool "LOWLOG_DUMP_RECORD_TIME"
    default n
    ---help---
        Measure and record the time it takes to save the crash log to a file.

endif # LOWLOG_DUMP
```

## os/kernel/task_monitor/Kconfig
```kconfig
#
# For a description of the syntax of this configuration file,
# see kconfig-language at https://www.kernel.org/doc/Documentation/kbuild/kconfig-language.txt
#

config TASK_MONITOR
	bool "Enable Task Monitor"
	default n
	depends on LIB_BOARDCTL
	depends on BOARDCTL_RESET
	---help---
		This is kernel thread which monitor the tasks/pthreads.
		It checks if registered tasks/pthreads are alive.

if TASK_MONITOR

config TASK_MONITOR_PRIORITY
	int "Priority of Task Monitor"
	default 200
	---help---
		Set the Task Monitor priority.

config TASK_MONITOR_INTERVAL
	int "Interval for checking alive(sec)"
	default 5
	---help---
		Task Monitor checks the registered tasks/pthreads active status
		every this interval. If TASK_MONITOR_INTERVAL set by 5, Interval
		value can use as 5, 10, 15 .... and TASK_MONITOR_MAX_INTERVAL.

config TASK_MONITOR_MAX_INTERVAL
	int "Max interval for checking alive(sec)"
	default 20
	---help---
		It is maximum interval for task check and should be set to 
		a multiple of TASK_MONITOR_INTERVAL. If it is not a multiple
		of TASK_MONITOR_INTERVAL, it is set to the previous multiple.
		ex) If TASK_MONITOR_INTERVAL set by 5 and TASK_MONITOR_MAX_INTERVAL
		set by 17, Interval value can use as 5, 10 and 15.
		
endif # TASK_MONITOR
```

## os/logm/Kconfig
```kconfig
#
# For a description of the syntax of this configuration file,
# see kconfig-language at https://www.kernel.org/doc/Documentation/kbuild/kconfig-language.txt
#

config LOGM
	bool "Logger Module"
	default n
	---help---
		Logger.

if LOGM

config PRINTF2LOGM
	bool "Route printf through logm"
	default y

config SYSLOG2LOGM
	bool "Route all syslogs through logm"
	default y

config LOGM_TIMESTAMP
	bool "Prepend timestamp to message"
	default n

config LOGM_SYNCHRONOUS
	bool "Stall logging thread instead of dropping log messages"
	default n
	---help---
		When LOGM_SYNCHRONOUS is enabled, logm would wait for space in log
		buffer before discarding an overflowing log message.

config LOGM_TIMEOUT_MS
	int "Max delay logging thread would wait before dropping a message"
	default -1
	depends on LOGM_SYNCHRONOUS
	---help---
		When LOGM_SYNCHRONOUS is enabled, this option defines how
		long (in ms) a thread would wait for space in logging buffer.
		0 is equivalent to no wait, <0 waits (almost) indefinitely.
		See also LOGM_PRINT_INTERVAL.

config LOGM_BUFFER_SIZE
	int "Logm Buffer size"
	default 10240
	---help---
		Logm buffer size (default : 10KB)
		This value should be sufficient to avoid buffer overflow.
		If buffer overflow happens, some messages would be dropped.

config LOGM_PRINT_INTERVAL
	int "Interval for flusing logm buffer (ms)"
	default 1000
	---help---
		Logm queues messsages for several seconds and then spits out.
		This value decides how frequently buffer is flushed.
		The smaller this value is, the more frequent messages are shown.

config LOGM_TASK_PRIORITY
	int "Logm Task priority"
	default 110

config LOGM_TASK_STACKSIZE
	int "Logm Task stack size"
	default 1024

config LOGM_TEST
	bool "Test code for logger module "
	default n
	---help---
		Test code for logger module

endif # LOGM
```

## os/media/Kconfig
```kconfig
#
# For a description of the syntax of this configuration file,
# see kconfig-language at https://www.kernel.org/doc/Documentation/kbuild/kconfig-language.txt
#

config MEDIA
	bool "Media Support"
	default n
	depends on AUDIO
	---help---
		Enables overall support for Media library.

if MEDIA

config MEDIA_PRIORITY
	int "Media Priority"
	default 150

config MEDIA_STACK_SIZE
	int "Media Stack Size"
	default 8192

config MEDIA_PLAYER
	bool "Support Media player"
	default n
	---help---
		Enable media player functions

config MEDIA_RECORDER
	bool "Support Media recorder"
	default n
	---help---
		Enable media recoreder functions

endif
```

## os/net/Kconfig
```kconfig
#
# For a description of the syntax of this configuration file,
# see kconfig-language at https://www.kernel.org/doc/Documentation/kbuild/kconfig-language.txt
#

config ARCH_HAVE_NET
	bool
	default n

config ARCH_HAVE_PHY
	bool
	default n

config NET
	bool "Networking support"
	default n
	select ARCH_HAVE_NET
	---help---
		Enable or disable all system network features

if NET

choice
	prompt "Networking stack"
	default NET_LWIP

config	NET_LWIP
	bool "LwIP"

endchoice

if NET_LWIP
source net/lwip/configs/Kconfig
endif #NET_LWIP

menu "Driver buffer configuration"

config NET_ETH_MTU
	int "Ethernet packet buffer size (MTU)"
	default 1294 if NET_IPv6
	default 590 if !NET_IPv6
	depends on NET_ETHERNET
	range 590 1518
	---help---
		Packet buffer size.  This size includes the TCP/UDP payload plus the
		size of TCP/UDP header, the IP header, and the Ethernet header.
		This value is normally referred to as the MTU (Maximum Transmission
		Unit); the payload is the MSS (Maximum Segment Size).

		IPv4 hosts are required to be able to handle an MSS of at least
		536 octets, resulting in a minimum buffer size of 536+20+20+14 =
		590.

		IPv6 hosts are required to be able to handle an MSS of 1220 octets,
		resulting in a minimum buffer size of of 1220+20+40+14 = 1294

config NET_GUARDSIZE
	int #"Driver I/O guard size"
	default 2
	---help---
		Network drivers often receive packets with garbage at the end and
		are longer than the size of packet in the TCP header.  The following
		"fudge" factor increases the size of the I/O buffering by a small
		amount to allocate slightly oversize packets.  After receipt, the
		packet size will be chopped down to the size indicated in the TCP
		header.

endmenu # Driver buffer configuration

menu "Data link support"

config NET_MULTILINK
	bool
	default n

config NET_ETHERNET
	bool "Ethernet support"
	default y if !NET_SLIP
	default n if NET_SLIP
	select NETDEV_MULTINIC if NET_SLIP
	select NET_MULTILINK if NET_SLIP
	---help---
		If NET_SLIP is not selected, then Ethernet will be used (there is
		no need to define anything special in the configuration file to use
		Ethernet -- it is the default).

endmenu # Data link support

source net/netdev/Kconfig

menu "Protocols"

menu "Dynamic Host Configuration Protocol (DHCP)"
choice
	prompt "DHCP source"
	default NET_DHCP
config NET_DHCP
	bool "Default DHCP client/server application"
config NET_LWIP_DHCP
	bool "(Optional) Enabling LwIP DHCP client/server"
	depends on NET_LWIP
endchoice #DHCP

config LWIP_DHCP_TCPIP_THREAD
	bool "Running over LwIP Thread"
	depends on NET_LWIP_DHCP
	default n
	---help---
		Enable netifapi of DHCP to run it over LwIP TCPIP main thread

config LWIP_DHCP_HOSTNAME
	bool "Enable Hostname Option"
	depends on NET_LWIP_DHCP
	default n
	---help---
		Enable hostname option for DHCP client

source "$EXTERNALDIR/dhcpc/Kconfig.protocol"
source "$EXTERNALDIR/dhcpd/Kconfig.protocol"
endmenu #DHCP

source "$EXTERNALDIR/xmlrpc/Kconfig.protocol"
source "$EXTERNALDIR/ntpclient/Kconfig.protocol"
source "$EXTERNALDIR/webserver/Kconfig.protocol"
source "$EXTERNALDIR/ftpc/Kconfig.protocol"
source "$EXTERNALDIR/mdns/Kconfig.protocol"
source "$EXTERNALDIR/webclient/Kconfig.protocol"
source "$EXTERNALDIR/ftpd/Kconfig.protocol"
source "$EXTERNALDIR/websocket/Kconfig.protocol"
source "$EXTERNALDIR/libcoap/Kconfig.protocol"
source "$EXTERNALDIR/tftpc/Kconfig.protocol"
source "$EXTERNALDIR/telnetd/Kconfig.protocol"
source "$EXTERNALDIR/smtp/Kconfig.protocol"
source "$EXTERNALDIR/grpc/Kconfig.protocol"

source "../framework/src/network/mqtt/Kconfig.protocol"

config NET_SECURITY_TLS
	bool "TLS Support"
	default n
	depends on NET_LWIP_NETDB
	select DEV_URANDOM

if NET_SECURITY_TLS
source "$EXTERNALDIR/mbedtls/Kconfig.protocol"
endif #NET_SECURITY_TLS

endmenu #Protocols

menu "Wireless"

source ../framework/src/wifi_manager/Kconfig

endmenu #Wireless

menu "Bluetooth"

source net/bluetooth/Kconfig
source ../framework/src/bluetooth/Kconfig

endmenu #Bluetooth

menu "Network utilities"

source "$EXTERNALDIR/netutils/Kconfig.netutil"

endmenu #menu "Network utilities"

menu "Network Manager"

source "net/netmgr/Kconfig"

endmenu # "Network Manager"

menuconfig LWNL80211
	bool "Enable light-weight netlink"
	default n
	---help---
		Lwnl provides a driver interface for NIC hardware.

if LWNL80211
source "drivers/lwnl/Kconfig"
endif

config NET_LOOPBACK_INTERFACE
	bool "Support loopback interface"
	default n
	---help---
		Support loop interface (127.0.0.1).

source "net/local/Kconfig"

endif # NET
```

## os/net/local/Kconfig
```kconfig
#
# For a description of the syntax of this configuration file,
# see kconfig-language at https://www.kernel.org/doc/Documentation/kbuild/kconfig-language.txt
#

menu "Unix Domain Socket Support"
	depends on NET && !DISABLE_PSEUDOFS_OPERATIONS

config NET_LOCAL
	bool "Unix domain (local) sockets"
	default n
	select PIPES
	---help---
		Enable or disable Unix domain (aka Local) sockets.

if NET_LOCAL

config NUDS_DESCRIPTORS
	int "Number of uds socket descriptors"
	default 8
	range 1 99999
	---help---
		Maximum number of uds socket descriptors per task/thread.

config NET_LOCAL_STREAM
	bool "Unix domain stream sockets"
	default y
	---help---
		Enable support for Unix domain SOCK_STREAM type sockets

config NET_LOCAL_DGRAM
	bool "Unix domain datagram sockets"
	default y
	---help---
		Enable support for Unix domain SOCK_DGRAM type sockets

endif # NET_LOCAL

endmenu # Unix Domain Sockets
```
