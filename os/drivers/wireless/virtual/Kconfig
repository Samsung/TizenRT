## os/fs/driver/mtd/m25px/Kconfig
```kconfig
if MTD_M25P

menu "SPI-based M25 flash options"

config M25P_SPIMODE
        int "M25P SPI mode"
        default 0

config M25P_MANUFACTURER
        hex "M25P manufacturers ID"
	default 0x20
        ---help---
                Various manufacturers may have produced the parts.  0x20 is the manufacturer ID
                for the STMicro MP25x serial FLASH.  If, for example, you are using the a Macronix
                International MX25 serial FLASH, the correct manufacturer ID would be 0xc2.
                Manufacturers ID for Eon silicon en25f80 flash is 0x1c.

config M25P_MEMORY_TYPE
        hex "M25P memory type ID"
        default 0x20
        ---help---
                The memory type for M25 "P" series is 0x20, but the driver also supports "F" series
                devices, such as the EON EN25F80 part which adds a 4K sector erase capability.  The
                memory type for "F" series parts from EON is 0x31.  The 4K sector erase size will
                automatically be enabled when filesytems that can use it are enabled, such as SMART.

if M25P_MANUFACTURER = 0x1c

config EN25F80_FLASH
        bool "Enable EN25F80 flash driver for mikroequail"
        default y
        ---help---
                Enable EN25F80 (click board) flash driver for mikroequail.

config EN25F80_READONLY
        bool "Enable readonly feature for EN25F80 flash for mikroequail"
        default n
        ---help---
                Enable readonly feature for EN25F80 flash for mikroequail
endif

config M25P_SUBSECTOR_ERASE
        bool "Sub-Sector Erase"
        default n
        ---help---
                Some devices (such as the EON EN25F80) support a smaller erase block
                size (4K vs 64K).  This option enables support for sub-sector erase.
                The SMART file system can take advantage of this option if it is enabled.
endmenu

endif
```

## os/fs/driver/mtd/rammtd/Kconfig
```kconfig
if RAMMTD

menu "RAM MTD options"

config RAMMTD_BLOCKSIZE
        int "RAM MTD block size"
        default 512

config RAMMTD_ERASESIZE
        int "RAM MTD erase block size"
        default 4096

config RAMMTD_ERASESTATE
        hex "Simulated erase state"
        default 0xff

config RAMMTD_FLASHSIM
        bool "RAM MTD FLASH Simulation"
        default n
        ---help---
                RAMMTD_FLASHSIM will add some extra logic to improve the level of
                FLASH simulation.
endmenu

endif #RAMMTD
```

## os/fs/littlefs/Kconfig
```kconfig
#
# For a description of the syntax of this configuration file,
# see kconfig-language at https://www.kernel.org/doc/Documentation/kbuild/kconfig-language.txt
#

config FS_LITTLEFS
	bool "LITTLEFS File System"
	default n
	depends on !DISABLE_MOUNTPOINT
	select MTD_NAND_ERASE_SIZE
	---help---
		Build the LITTLEFS file system. https://github.com/ARMmbed/littlefs.

config MTD_NAND_ERASE_SIZE
	bool "set NAND ERASE SIZE"
	default n
	---help---
		Change the header size of resource partition to the appropriate size for nand at build.
```

## os/fs/procfs/Kconfig
```kconfig
#
# For a description of the syntax of this configuration file,
# see kconfig-language at https://www.kernel.org/doc/Documentation/kbuild/kconfig-language.txt
#

config FS_PROCFS
	bool "PROCFS File System"
	default n
	depends on !DISABLE_MOUNTPOINT
	select FS_READABLE
	---help---
		The PROCFS file system provides access to task status and other driver
		status through the TinyAra file system.  The PROCFS may, for example, be
		mount at /proc.  Then information about all of the currently active
		tasks and threads will be available in /proc.

if FS_PROCFS

config FS_AUTOMOUNT_PROCFS
	bool "Auto mount PROCFS File System"
	default n
	---help---
		This provides an option to enable auto mounting of
		PROCFS during File System initialization.

menu "Exclude individual procfs entries"

config FS_PROCFS_EXCLUDE_PROCESS
	bool "Exclude process information"
	default n
	---help---
		Causes the process information to be excluded from the procfs system.
		This will reduce code space, but then giving access to process info
		was kinda the whole point of procfs, but hey, whatever.

config FS_PROCFS_EXCLUDE_UPTIME
	bool "Exclude uptime"
	default n

config FS_PROCFS_EXCLUDE_VERSION
	bool "Exclude version"
	default n

config FS_PROCFS_EXCLUDE_CPULOAD
	bool "Exclude CPU load"
	default n
	depends on SCHED_CPULOAD

config FS_PROCFS_EXCLUDE_IRQS
	bool "Exclude irqs"
	default n

config FS_PROCFS_EXCLUDE_MTD
	bool "Exclude mtd"
	depends on MTD
	default n

config FS_PROCFS_EXCLUDE_PARTITIONS
	bool "Exclude partitions"
	depends on MTD_PARTITION
	default n

config FS_PROCFS_EXCLUDE_SMARTFS
	bool "Exclude fs/smartfs"
	depends on FS_SMARTFS
	default n

config FS_PROCFS_EXCLUDE_POWER
	bool "Exclude power/domains"
	depends on PM
	default n

config FS_PROCFS_EXCLUDE_EREPORT
	bool "Exclude error report"
	depends on ERROR_REPORT
	default n

endmenu #
endif # FS_PROCFS
```

## os/fs/romfs/Kconfig
```kconfig
#
# For a description of the syntax of this configuration file,
# see kconfig-language at https://www.kernel.org/doc/Documentation/kbuild/kconfig-language.txt
#

config FS_ROMFS
	bool "ROMFS file system"
	default n
	depends on !DISABLE_MOUNTPOINT
	select FS_READABLE
	---help---
		Enable ROMFS filesystem support
		Arch-dependent fs automount option can be found at "os/arch/arm/src/<board>/Kconfig"
```

## os/fs/semaphore/Kconfig
```kconfig
#
# For a description of the syntax of this configuration file,
# see kconfig-language at https://www.kernel.org/doc/Documentation/kbuild/kconfig-language.txt
#

config FS_NAMED_SEMAPHORES
	bool "Named semaphore support"
	default n
	---help---
		Include support for named semaphores.

if FS_NAMED_SEMAPHORES

config FS_NAMED_SEMPATH
	string "Path to semaphore storage"
	default "/var/lock"
	---help---
		The path to where named semaphores will exist in the VFS namespace.
    
endif # FS_NAMED_SEMAPHORES
```

## os/fs/smartfs/Kconfig
```kconfig
#
# For a description of the syntax of this configuration file,
# see kconfig-language at https://www.kernel.org/doc/Documentation/kbuild/kconfig-language.txt
#

config FS_SMARTFS
	bool "SMART file system"
	default y
	depends on !DISABLE_MOUNTPOINT
	select FS_READABLE
	select FS_WRITABLE
	---help---
		Enable TinyAra SMART Flash file system (SMARTFS) support.

if FS_SMARTFS

menu "SMARTFS options"

config SMARTFS_ERASEDSTATE
	hex "FLASH erased state"
	default 0xff
	---help---
		The erased state of FLASH.
		This must have one of the values of 0xff or 0x00.
		Default: 0xff.

config SMARTFS_MAXNAMLEN
	int "Maximum file name length"
	default 32
	---help---	
		The maximum size of a SMARTFS file name at a given
		directory level.  Overall path name is not restricted
		by this value, only individual segments in a path,
		such as (assuming /usr is the mount point):

			/usr/games/chess/player_stats/game1.xml

		Default: 16.

config SMARTFS_MULTI_ROOT_DIRS
	bool "Support multiple Root Directories / Mount Points"
	default n
	---help---
		Enables support for multiple root directory entries
		on the SMART FLASH.  Multiple root directories means
		the device can have multiple mount point in the VFS,
		each with it's own unique directory structure under it.

		When this option is enabled, instead of reporting the
		SMART block devices as "/dev/mtdsmart0", they will be
		reported as "/dev/mtdsmart0d1", "/dev/mtdsmart0d2", etc.
		The number of root entries actually created is set
		during the "mksmartfs" command when the device is
		initialized.

		Default: y.

config SMARTFS_ALIGNED_ACCESS
	bool "Ensure 16 and 32 bit accesses are alined"
	default y
	---help---
		Performs little endian byte accesses to 16 and 32 values
		within the directory list to ensure processors that can't
		handle un-aligned accesses don't bomb out.  Default should
		probably by 'Y', but set to 'N' in case any existing Big
		Endian instances of SmartFS exist that already have
		directories with data stored in big endian mode.

config SMARTFS_BAD_SECTOR
bool "Bad Sector Management"
	default n
	---help---
		Enables Bad Sector Management for SMART FS to ensure data
                consistency of the persistant storage (Flash).

config SMARTFS_DYNAMIC_HEADER
bool "Dynamic Header"
	default n
	---help---
		Using Modified Used Byte Method to Reduce Sector Relocation 

config SMARTFS_JOURNALING
        bool "Enable filesystem journaling for smartfs"
        default n
        ---help---
                Enables logging of write operations on filesystem, so that in
                case of power failure the filesystem can be brought to a stable
                state with minimal data loss.
                Enabling journaling will increase the delay in filesystem
                operations, because before doing any fs operation, journaling
                will first log it in journal area. The journal area will also
                take up space in the flash, leaving lesser space for filesystem.
                The space reserved for journal area is proportional to max number
                of file descriptors allowed and sector size defined. Thus, to
                minimize the area reserved for journaling, it is advised to keep
                sector size small.
                
if SMARTFS_JOURNALING

config SMARTFS_JOURNAL_VERIFY
	bool "Verify Journal logging"
	default n
	---help---
		The read & verify joural value after right
		Sometimes electronic power grow up after power off, in this case
		FS decide write finished properly, but it doesn't finished properly.
		To prevent this, verifying needed.
		On the other hands, it takes more time for most of file operation that
		using journal Logging.
endif

config SMARTFS_SECTOR_RECOVERY
	bool "Enable recovery of lost sectors in Filesystem"
	default n
	---help---
		Enables recovery of lost sectors after power failure. Lost
		sectors are the sectors which are allocated but not reachable
		from root directory.

config SMARTFS_SECURE
	bool "Secure File System"
	default n
	select CRYPTO
	select CRYPTO_SW_AES
	---help---
		Provides encryption & decryption support using AES algorithm.

endmenu

endif
```
