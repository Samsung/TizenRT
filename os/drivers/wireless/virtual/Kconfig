## os/net/lwip/Kconfig
```kconfig
#
# For a description of the syntax of this configuration file,
# see kconfig-language at https://www.kernel.org/doc/Documentation/kbuild/kconfig-language.txt
#

menu "LwIP options"

menu "LwIP memory options"

config NET_LWIP_MEM_ALIGNMENT
	int "Memory alignment size"
	default 4
	---help---
		should be set to the alignment of the CPU

config NET_LWIP_MEM_SIZE
	int "Size of LwIP memory pool"
	default 1600
	---help---
		the size of the heap memory. If the application will send
		a lot of data that needs to be copied, this should be set high.

config NET_LWIP_MEMP_OVERFLOW_CHECK
	int "Memory pool overflow protection"
	default 0
	---help---
		memp overflow protection reserves a configurable amount of bytes
		before and after each memp element in every pool and fills
		it with a prominent default value.
		if 0, no checking
		if 1, checks each element when it is freed
		if 2, checks each element in every pool every time memp_malloc()
		or memp_free() is called (useful but slow!)

config NET_LWIP_MEMP_SANITY_CHECK
	bool "Memory pool sanity check"
	default n
	---help---
		run a sanity check after each memp_free() to make sure that
		there are no cycles in the linked lists.

config NET_LWIP_MEMP_NUM_PBUF
	int "Number of Pbufs"
	default 16
	---help---
		The number of memp struct pbufs (used for PBUF_ROM and PBUF_REF).
		If the application sends a lot of data out of ROM (or other static memory),
		this should be set high.

config NET_LWIP_MEMP_NUM_RAW_PCB
	int "Number of raw connection PCBs"
	default 4
	depends on NET_LWIP_RAW
	---help---
		Number of raw connection PCBs

config NET_LWIP_MEMP_NUM_UDP_PCB
	int "Number of udp connection PCBs"
	default 4
	depends on NET_LWIP_UDP
	---help---
		Number of udp connection PCBs

config NET_LWIP_MEMP_NUM_TCP_PCB
	int "Number of tcp connection PCBs"
	default 5
	depends on NET_LWIP_TCP
	---help---
		Number of tcp connection PCBs

config NET_LWIP_MEMP_NUM_TCP_PCB_LISTEN
	int "Number of listening tcp connections"
	default 5
	depends on NET_LWIP_TCP
	---help---
		Number of simultaneously queued TCP segments

config NET_LWIP_MEMP_NUM_TCP_SEG
	int "Number of simultaneously queued TCP segments"
	default 16
	depends on NET_LWIP_TCP
	---help---
		Number of simultaneously queued TCP segments

config NET_LWIP_MEMP_NUM_REASSDATA
	int "Number of IP reassemble packets"
	default 5
	---help---
		Number of IP fragments simultaneously sent
		for reassembly (whole packets, not fragments!)

config NET_LWIP_MEMP_NUM_FRAG_PBUF
	int "Number of IP fragments packets"
	default 15
	---help---
		Number of IP fragments simultaneously sent
		(fragments, not whole packets!).

config NET_LWIP_MEMP_NUM_ARP_QUEUE
	int "Maximum number of waiting arp request packet"
	default 30
	---help---
		Number of simultaneously queued outgoing packets (pbufs)
		that are waiting for an ARP request (to resolve their
		destination address) to finish.

endmenu #LwIP memory options

menuconfig NET_LWIP_SOCKET
	bool "Socket support"
	default y

if NET_LWIP_SOCKET

config NET_LWIP_RAW
	bool "Raw socket support"
	default y

config NET_LWIP_SOCKET_OPTION_BROADCAST
	bool "Support SO_BROADCAST Option"
	default n
	---help---
		Enable SO_BROADCAST option support.

config NET_LWIP_RANDOMIZE_INITIAL_LOCAL_PORTS
	bool "Randomize the initial local port for TCP/UDP"
	default n
	---help---
		Randomize the local port for the first local TCP/UDP pcb (default==0).
		This can prevent creating predictable port numbers after booting a device.

config NET_LWIP_SOCKET_SENDTIMEOUT
	bool "Enable send timeout socket option"
	default n

config NET_LWIP_SOCKET_RECVTIMEOUT
	bool "Enable receive timeout socket option"
	default n

config NET_LWIP_SOCKET_RCVBUF
	bool "Enable SO_RCVBUF socket option"
	default y

config NET_LWIP_SOCKET_REUSE
	bool "Enable SO_REUSE socket option"
	default n

endif #NET_LWIP_SOCKET

menuconfig NET_LWIP_ICMP
	bool "ICMP support"
	default y

if NET_LWIP_ICMP

config NET_LWIP_ICMP_BROADCAST_PING
	bool "Enable respond to broadcast pings"
	default n
	---help---
		respond to broadcast pings (default is unicast only)

config NET_LWIP_ICMP_MULTICAST_PING
	bool "Enable respond to multicast pings"
	default n
	---help---
		respond to multicast pings (default is unicast only)

endif #NET_LWIP_ICMP


menuconfig NET_LWIP_IGMP
	bool "IGMP support"
	default n

if NET_LWIP_IGMP

config NET_LWIP_MEMP_NUM_IGMP_GROUP
	int "Maximum number of IGMP group"
	default 8
	---help---
		Number of multicast groups whose network interfaces
		can be members at the same time
endif #NET_LWIP_IGMP


menuconfig NET_LWIP_UDP
	bool "UDP support"
	default y

if NET_LWIP_UDP

config NET_LWIP_UDPLITE
	bool "UDP-Lite support"
	default n

endif #NET_LWIP_UDP

menuconfig NET_LWIP_TCP
	bool "TCP support"
	default y

if NET_LWIP_TCP

config NET_LWIP_TCP_KEEPALIVE
	bool "Enable TCP Keepalive"
	default n


config NET_LWIP_TCP_WINDOW_SIZE
	int "The size of a TCP window"
	default 2144
	---help---
		The size of a TCP window.  This must be at least
		(2 * TCP_MSS) for things to work well

config NET_LWIP_TCP_MAX_RETRANS
	int "Maximum number of retransmissions of data segments"
	default 12
	---help---
		The Maximum number of retransmissions of data segments.

config NET_LWIP_TCP_SYN_MAX_RETRANS
	int "Maximum number of retransmissions of SYN segments"
	default 6
	---help---
		The maximum number of retransmissions of SYN segments

config NET_LWIP_TCP_QUEUE_OOSEQ
	bool "Enable queueing out of order packets"
	default y
	---help---
		Queue segments that arrive out of order.
		Disable if your device is low on memory.

config NET_LWIP_TCP_MSS
	int "TCP Maximum segment size"
	default 536
	---help---
		TCP Maximum segment size in bytes.

config NET_LWIP_TCP_SEND_BUF
	int "TCP send buffer size in bytes"
	default 1072
	---help---
		TCP sender buffer space (bytes).
		To achieve good performance, this should be at least 2 * TCP_MSS.

config NET_LWIP_TCP_TIMESTAMPS
	bool "Support the TCP timestamp option"
	default n
	---help---
		Support the TCP timestamp option.

config NET_LWIP_TCP_LISTEN_BACKLOG
	bool "Support the backlog option for tcp listen pcb"
	default n
	---help---
		Support the the backlog option for tcp listen pcb.

endif #NET_LWIP_TCP
endmenu #LwIP options
```

## os/net/lwip/configs/Kconfig
```kconfig
#
# For a description of the syntax of this configuration file,
# see kconfig-language at https://www.kernel.org/doc/Documentation/kbuild/kconfig-language.txt
#

menu "LwIP options"

menuconfig NET_IPv4
	bool "IPv4 support"
	default y
	---help---
		Build in support for IPv4.

source "net/lwip/configs/ipv4/Kconfig"

menuconfig NET_IPv6
	bool "IPv6 support"
	default n
	---help---
		Build in support for IPv6.

source "net/lwip/configs/ipv6/Kconfig"

source "net/lwip/configs/socket/Kconfig"

menuconfig NET_ARP
	bool "ARP Support"
	default y
	depends on NET_ETHERNET && NET_IPv4
	---help---
		This setting is currently overridden by logic in include/nuttx/net

source "net/lwip/configs/arp/Kconfig"

menuconfig NET_IPv6_ND
	bool "ND support"
	depends on NET_IPv6
	default y
	---help---
		Build in support for IPv6 Neighbor Discovery.

source "net/lwip/configs/nd/Kconfig"

menuconfig NET_UDP
	bool "UDP Support"
	depends on NET_IPv4 || NET_IPv6
	default y
	---help---
		UDP support on or off

source "net/lwip/configs/udp/Kconfig"


menuconfig NET_TCP
	bool "TCP Support"
	depends on NET_IPv4 || NET_IPv6
	default y
	---help---
		TCP support on or off

source "net/lwip/configs/tcp/Kconfig"


menuconfig NET_ICMP
	bool "ICMP Support"
	depends on NET_IPv4
	default n
	---help---
		Enable minimal ICMP support. Includes built-in support
		for sending replies to received ECHO (ping) requests.

if NET_ICMP
source "net/lwip/configs/icmp/Kconfig"
endif

menuconfig NET_IPv6_ICMP
	bool "ICMP6 support"
	depends on NET_IPv6
	default y
	---help---
		Build in support icmp for IPv6.

source net/lwip/configs/icmp6/Kconfig


menuconfig NET_LWIP_IGMP
	bool "IGMP Support"
	depends on NET_IPv4	
	default n

if NET_LWIP_IGMP

config NET_LWIP_MEMP_NUM_IGMP_GROUP
	int "Maximum number of IGMP group"
	default 8
	---help---
		Number of multicast groups whose network interfaces
		can be members at the same time
endif #NET_LWIP_IGMP

menuconfig NET_IPv6_MLD
	bool "MLD Support"
	depends on NET_IPv6
	default y

if NET_IPv6_MLD
source "net/lwip/configs/mld/Kconfig"
endif

config NET_IPv6_DHCP
	bool "DHCPv6 Support"
	depends on NET_IPv6
	default n
	---help---
		Enable DHCPv6 stateful address autoconfiguration.


source "net/lwip/configs/mbox/Kconfig"
source "net/lwip/configs/mem/Kconfig"
source "net/lwip/configs/sys/Kconfig"
source "net/lwip/configs/debug/Kconfig"
source "net/lwip/configs/stats/Kconfig"

config NET_LWIP_VLAN
	bool "Support VLAN"
	default n
	---help---
		support receiving ethernet packets with VLAN header.
		Additionally, you can define ETHARP_VLAN_CHECK to an u16_t VLAN ID to check.
		If VLAN_CHECK is defined, only VLAN-traffic for this VLAN is accepted.

config NET_LWIP_VLAN_CHECK
	bool "Check VLAN ID for receiviing packet"
	default n
	depends on NET_LWIP_VLAN

config NET_LWIP_VLAN_CHECK_ID
	int "VLAN ID for receiviing packet"
	default 1
	depends on NET_LWIP_VLAN_CHECK

config NET_LWIP_LOOPBACK_INTERFACE
	bool "Support loopback interface"
	default n
	---help---
		Support loop interface (127.0.0.1).


################# SLIP #######################

menuconfig NET_LWIP_SLIP_INTERFACE
	bool "Support serial line IP interface"
	default n

if NET_LWIP_SLIP_INTERFACE

config NET_LWIP_SLIPIF_THREAD_NAME
	string "The name assigned to the slipif_loop thread"
	default "slipif_loop"

config NET_LWIP_SLIPIF_THREAD_STACKSIZE
	int "The stack size used by the slipif_loop thread"
	default 1024

config NET_LWIP_SLIPIF_THREAD_PRIO
	int "The priority assigned to the slipif_loop thread"
	default 100

endif #NET_LWIP_SLIP_INTERFACE


################# PPP #######################

menuconfig NET_LWIP_PPP_SUPPORT
	bool "Enable PPP"
	default n

if NET_LWIP_PPP_SUPPORT

config NET_LWIP_PPP_SESSIONS
	int "Max PPP sessions"
	default 1

config NET_LWIP_PAP_SUPPORT
	bool "Support PAP"
	default n

config NET_LWIP_CHAP_SUPPORT
	bool "Support CHAP"
	default n

config NET_LWIP_VJ_SUPPORT
	bool "Support VJ header compression"
	default n

config NET_LWIP_MD5_SUPPORT
	bool "Support MD5"
	default n

config NET_LWIP_PPP_MTU
	int "PPP MTU size in bytes"
	default 1500

config NET_LWIP_PPP_THREAD_NAME
	string "The name assigned to the pppInputThread"
	default "pppInputThread"

config NET_LWIP_PPP_THREAD_STACKSIZE
	int "The stack size used by the pppInputThread"
	default 1024

config NET_LWIP_PPP_THREAD_PRIO
	int "The priority assigned to the pppInputThread"
	default 100

endif #NET_LWIP_PPP_SUPPORT


################# SNMP #######################

menuconfig NET_LWIP_SNMP
	bool "Enable SNMP"
	default n
	depends on NET_UDP

if NET_LWIP_SNMP

config NET_LWIP_SNMP_CONCURRENT_REQUESTS
	int "Number of concurrent requests"
	default 1
	---help---
		Number of concurrent requests the module will allow.
		At least one request buffer is required.
		Does not have to be changed unless external MIBs answer
		request asynchronously

config NET_LWIP_SNMP_TRAP_DESTINATIONS
	int "Number of trap destinations"
	default 1	
	---help---
		Number of trap destinations. At least one trap destination
		is required

config NET_LWIP_SNMP_PRIVATE_MIB
	bool "Supports Private MIB"
	default n
	---help---
		When using a private MIB, you have to create a file 'private_mib.h'
		that contains a 'struct mib_array_node mib_private' which contains your MIB.

config NET_LWIP_SNMP_MAX_TREE_DEPTH
	int "The maximum depth of the SNMP tree"
	default 15
	---help---
		The maximum depth of the SNMP tree. With private MIBs enabled,
		this depends on your MIB! This affects the size of MEMP_SNMP_VALUE elements.

endif #NET_LWIP_SNMP

menu "Interface Name"
config NET_ETH_IFNAME
    string "Ethernet"
    default "en"

config NET_LOOP_IFNAME
    string "Loopback"
    default "lo"

config NET_STA_IFNAME
    string "Wi-Fi Station"
    default "wl"

config NET_SOFTAP_IFNAME
    string "Wi-Fi SoftAP"
    default "sa"
endmenu #"Interface Name"

menuconfig NET_LWIP_NETDB
	bool "Enable LWIP NETDB Library"
	default y
	depends on (NET_IPv4 || NET_IPv6) && NET_UDP

source "net/lwip/configs/netdb/Kconfig"

endmenu #LwIP options
```

## os/net/lwip/configs/arp/Kconfig
```kconfig
#
# For a description of the syntax of this configuration file,
# see kconfig-language at https://www.kernel.org/doc/Documentation/kbuild/kconfig-language.txt
#

if NET_ARP

config NET_ARP_TABLESIZE
	int "ARP table size"
	default 10
	---help---
		Number of active MAC-IP address pairs cached

config NET_ARP_QUEUEING
	bool "ARP queueing"
	default y
	---help---
		Multiple outgoing packets are queued during hardware address resolution.

config NET_ETHARP_TRUST_IP_MAC
	bool "ARP trust IP mac"
	default y
	---help---
		Incoming IP packets cause the ARP table to be updated with
		the source MAC and IP addresses supplied in the packet.

config NET_ETH_PAD_SIZE
	int "Number of ethernet padding bytes"
	default 0
	---help---
		Number of bytes added before the ethernet header to ensure
		alignment of payload after that header. Since the header is 14 bytes long,
		without this padding e.g. addresses in the IP header will not be aligned
		on a 32-bit boundary, so setting this to 2 can speed up 32-bit-platforms.

config NET_ARP_STATIC_ENTRIES
	bool "Support ARP static entries"
	default n
	---help---
		Enable code to support static ARP table
		entries (using etharp_add_static_entry/etharp_remove_static_entry).

endif #NET_ARP
```
