## os/net/lwip/configs/debug/Kconfig
```kconfig
menu "Debug Options for Network"

config NET_LWIP_ASSERT
	bool "Enable Assert Features"
	default n
	---help---
		Enable ASSERT options for each layers

config NET_LWIP_ERROR
	bool "Enable Error Features"
	default n
	---help---
		Enable ERROR options for each layers

config NET_LWIP_DEBUG
	bool "Enable Debug Features"
	default n
	---help---
		Debug options for each layers

if NET_LWIP_DEBUG

config NET_LWIP_DEBUG_LEVEL
	int "LWIP debug level"
	default 1
	range 0 3
	---help---
		Configure LwIP log level.
		0 : debug all
		1 : warning (bad checksums, dropped packets, ...)
		2 : serious (memory allocation failures, ... )
		3 : severe

config NET_API_LIB_DEBUG
	bool "Enable API Library Debugging"
	default n
	---help---
		Enable debugging in api_lib.c.

config NET_API_MSG_DEBUG
	bool "Enable API Message Debugging"
	default n
	---help---
		Enable debugging in api_msg.c.

config NET_AUTOIP_DEBUG
	bool "Enable Auto IP Debugging"
	default n
	---help---
		Enable debugging in autoip.c.

config NET_ETHARP_DEBUG
	bool "Enable ETHARP Debugging"
	default n
	---help---
		Enable debugging in etharp.c.

config NET_ICMP_DEBUG
	bool "Enable ICMP Debugging"
	default n
	---help---
		Enable debugging in icmp.c.

config NET_IGMP_DEBUG
	bool "Enable IGMP Debugging"
	default n
	---help---
		Enable debugging in igmp.c.

config NET_IP_DEBUG
	bool "Enable IP Debugging"
	default n
	---help---
		Enable debugging for IP.

config NET_IP_REASS_DEBUG
	bool "Enable IP Reassemble Debugging"
	default n
	---help---
		Enable debugging in ip_frag.c for both frag & reass.

config NET_MEM_DEBUG
	bool "Enable Memory Debugging"
	default n
	---help---
		Enable debugging in mem.c.

config NET_MEMP_DEBUG
	bool "Enable Memory Pool Debugging"
	default n
	---help---
		Enable debugging in memp.c.

config NET_NETIF_DEBUG
	bool "Enable NIC Debugging"
	default n
	---help---
		Enable debugging in netif.c.

config NET_PBUF_DEBUG
	bool "Enable PBUF Debugging"
	default n
	---help---
		Enable debugging in pbuf.c.

config NET_POLL_DEBUG
	bool "Enable Poll Debugging"
	default n
	---help---
		Enable debugging for poll.

config NET_RAW_DEBUG
	bool "Enable Raw Socket Debugging"
	default n
	---help---
		Enable debugging in raw.c.

config NET_SOCKETS_DEBUG
	bool "Enable Socket Debugging"
	default n
	---help---
		Enable debugging in sockets.c.

config NET_SYS_DEBUG
	bool "Enable System Debugging"
	default n
	---help---
		Enable debugging in sys_arch.c.

config NET_UDP_DEBUG
	bool "Enable UDP Debugging"
	default n
	---help---
		Enable debugging in UDP.

config NET_TCP_DEBUG
	bool "Enable TCP Debugging"
	default n
	---help---
		Enable debugging for TCP.

config NET_TCP_CWND_DEBUG
	bool "Enable TCP Congestion Window Debugging"
	default n
	---help---
		Enable debugging for TCP congestion window.

config NET_TCP_FR_DEBUG
	bool "Enable TCP Fast Retrasmit Debugging"
	default n
	---help---
		Enable debugging in tcp_in.c for fast retransmit.

config NET_TCP_INPUT_DEBUG
	bool "Enable TCP Incoming Debugging"
	default n
	---help---
		Enable debugging in tcp_in.c for incoming debug.

config NET_TCP_OUTPUT_DEBUG
	bool "Enable TCP Output Debugging"
	default n
	---help---
		Enable debugging in tcp_out.c output functions.

config NET_TCP_QLEN_DEBUG
	bool "Enable TCP Queue Length Debugging"
	default n
	---help---
		Enable debugging for TCP queue lengths.

config NET_TCP_RST_DEBUG
	bool "Enable TCP RST Message Debugging"
	default n
	---help---
		Enable debugging for TCP with the RST message.

config NET_TCP_RTO_DEBUG
	bool "Enable TCP Retransmit Debugging"
	default n
	---help---
		Enable debugging in TCP for retransmit timeout.

config NET_TCP_WND_DEBUG
	bool "Enable TCP Window Debugging"
	default n
	---help---
		Enable debugging in tcp_in.c for window updating.

config NET_TCPIP_DEBUG
	bool "Enable LWIP Thread Debugging"
	default n
	---help---
		Enable debugging in tcpip.c.

config NET_TIMERS_DEBUG
	bool "Enable Timer Debugging"
	default n
	---help---
		Enable debugging in timers.c.

config NET_IPv6_DEBUG
	bool "Enable IPv6 Debugging"
	depends on NET_IPv6
	default n
	---help---
		Enable debugging for IPv6.

config NET_ND6_DEBUG
	bool "Enable ND6 Debugging"
	depends on NET_IPv6
	default n
	---help---
		Enable debugging for ND6.

endif #LWIP_DEBUG

endmenu #"Debug Options for Network"
```

## os/net/lwip/configs/icmp/Kconfig
```kconfig
#
# For a description of the syntax of this configuration file,
# see kconfig-language at https://www.kernel.org/doc/Documentation/kbuild/kconfig-language.txt
#

config NET_ICMP_TTL
	int "ICMP TTL"
	default 255
	---help---
		Default value for Time-To-Live used by ICMP packets.

config NET_BROADCAST_PING
	bool "ICMP respond broadcast pings"
	default n
	---help---
		Respond to broadcast pings (default is unicast only)

config NET_MULTICAST_PING4
	bool "ICMP respond multicast pings"
	default n
	---help---
		Respond to multicast pings (default is unicast only)
```
