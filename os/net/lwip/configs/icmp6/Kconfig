## os/net/lwip/configs/nd/Kconfig
```kconfig
#
# For a description of the syntax of this configuration file,
# see kconfig-language at https://www.kernel.org/doc/Documentation/kbuild/kconfig-language.txt
#

if NET_IPv6_ND

config NET_IPv6_ND_QUEUEING
	bool "Enable queue outgoing IPv6 packets while MAC address"
	default y
	---help---
		Enable queue outgoing IPv6 packets while MAC address.	


config NET_IPv6_ND_QUEUE
	int "Max number of IPv6 packets to queue during MAC resolution"
	default 20
	---help---
		Max number of IPv6 packets to queue during MAC resolution.	

config NET_IPv6_ND_NUM_NEIGHBORS
	int "Number of entries in IPv6 neighbor cache"
	default 10
	---help---
		Number of entries in IPv6 neighbor cache.	

config NET_IPv6_ND_NUM_DESTINATIONS
	int "Number of entries in IPv6 destination cache"
	default 10
	---help---
		Number of entries in IPv6 destination cache.	

config NET_IPv6_ND_NUM_PREFIXES
	int "Number of entries in IPv6 on-link prefixes cache"
	default 5 
	---help---
		Number of entries in IPv6 on-link prefixes cache.	

config NET_IPv6_ND_NUM_ROUTERS
	int "Number of entries in IPv6 default router cache"
	default 3 
	---help---
		Number of entries in IPv6 default router cache.	

config NET_IPv6_ND_MAX_MULTICAST_SOLICIT
	int "Max number of multicast solicit messages to send"
	default 3 
	---help---
		Max number of multicast solicit messages to send.	

config NET_IPv6_ND_MAX_UNICAST_SOLICIT
	int "Max number of unicast neighbor solicitation messages"
	default 3 
	---help---
		Max number of unicast neighbor solicitation messages
		to send during neighbor reachability detection.

config NET_IPv6_ND_MAX_SOLICIT_INTERVAL
	int "Max interval time of solicit messages to send"
	default 4000
	---help---
		Max interval time of solicit message to send

config NET_IPv6_ND_REACHABLE_TIME
	int "Default neighbor reachable time (in milliseconds)"
	default 30000
	---help---
		Default neighbor reachable time (in milliseconds).
		May be updated by router advertisement messages.

config NET_IPv6_ND_RETRANS_TIMER
	int "Default retransmission timer for solicitation messages"
	default 1000
	---help---
		Default retransmission timer for solicitation messages.

config NET_IPv6_ND_DELAY_FIRST_PROBE_TIME
	int "Delay before first unicast neighbor solicitation"
	default 5000
	---help---
		Delay before first unicast neighbor solicitation
		message is sent, during neighbor reachability detection.
	
config NET_IPv6_ND_ALLOW_RA_UPDATES
	bool "Allow Router Advertisement messages to update"
	default y
	---help---
		Allow Router Advertisement messages to update
		Reachable time and retransmission timers, and netif MTU.

config NET_IPv6_ND_TCP_REACHABILITY_HINTS
	bool "Allow TCP to provide ND with RA hints"
	default y
	---help---
		Allow TCP to provide Neighbor Discovery with reachability
		hints for connected destinations. This helps avoid sending
		unicast neighbor solicitation messages.

config NET_IPv6_ND_RDNSS_MAX_DNS_SERVERS
	int "Use IPv6 Router Advertisement Recursive DNS Server Option"
	default 0
	---help---
		Use IPv6 Router Advertisement Recursive DNS Server Option
		(as per RFC 6106) to copy a defined maximum number of DNS
		servers to the DNS module.


endif
```

## os/net/lwip/configs/netdb/Kconfig
```kconfig
#
# For a description of the syntax of this configuration file,
# see kconfig-language at https://www.kernel.org/doc/Documentation/kbuild/kconfig-language.txt
#

if NET_LWIP_NETDB

config NET_DNS_TABLE_SIZE
	int "DNS maximum number of entries to maintain locally"
	default 4
	---help---
		DNS maximum number of entries to maintain locally.

config NET_DNS_MAX_NAME_LENGTH
	int "DNS maximum host name length supported in the name table"
	default 256
	---help---
		DNS maximum host name length supported in the name table.

config NET_DNS_MAX_SERVERS
	int "The maximum of DNS servers"
	default 2
	---help---
		The maximum of DNS servers
		The first server can be initialized automatically by defining
		DNS_SERVER_ADDRESS(ipaddr), where \'ipaddr\' is an \'ip_addr_t\*\'

config NET_DNS_DOES_NAME_CHECK
	bool "DNS do a name checking between the query and the response"
	default 1
	---help---
		DNS do a name checking between the query and the response.

config NET_DNS_SECURE
	int "LWIP_DNS_SECURE: controls the security level of the DNS"
	default 0
	---help---
		controls the security level of the DNS implementation
		LWIP_DNS_SECURE_RAND_XID 1
		LWIP_DNS_SECURE_NO_MULTIPLE_OUTSTANDING 2
		LWIP_DNS_SECURE_RAND_SRC_PORT 4
		Use all DNS security features, set it to 7.
		This is overridable but should only be needed by very small targets or when using against non standard DNS servers.

config NET_DNS_LOCAL_HOSTLIST
	bool "DNS_LOCAL_HOSTLIST: Implements a local host-to-address list. If enabled, you have to define an initialize"
	default n
	---help---
		Implements a local host-to-address list. If enabled, you have to define an initialize.

if NET_DNS_LOCAL_HOSTLIST
config NET_DNS_LOCAL_HOSTLIST_IS_DYNAMIC
	bool "If this is turned on, the local host-list can be dynamically changed at runtime"
	default n
	---help---
		If this is turned on, the local host-list can be dynamically changed at runtime.
endif

endif
```

## os/net/lwip/configs/socket/Kconfig
```kconfig
#
# For a description of the syntax of this configuration file,
# see kconfig-language at https://www.kernel.org/doc/Documentation/kbuild/kconfig-language.txt
#

menu "Socket support"

config NET_SOCKET
	bool
	default y

if NET_SOCKET

config NSOCKET_DESCRIPTORS
	int "Number of socket descriptor"
	default 8
	---help---
		Maximum number of socket descriptors per task/thread.

config NET_TCP_KEEPALIVE
	bool "TCP keepalive"
	default y
	---help---
		Enable TCP_KEEPIDLE, TCP_KEEPINTVL and TCP_KEEPCNT options processing.
		Note that TCP_KEEPIDLE and TCP_KEEPINTVL have to be set in seconds.
		(does not require sockets.c, and will affect tcp.c)

config NET_RAW
	bool "Raw socket support"
	default y

config NET_SOCKET_OPTION_BROADCAST
	bool "Support SO_BROADCAST Option"
	default n
	---help---
		Enable SO_BROADCAST option support.

config NET_RANDOMIZE_INITIAL_LOCAL_PORTS
	bool "Randomize the initial local port for TCP/UDP"
	default n
	---help---
		Randomize the local port for the first local TCP/UDP pcb (default==0).
		This can prevent creating predictable port numbers after booting a device.

config NET_SO_SNDTIMEO
	bool "Enable send timeout socket option"
	default n
	---help---
		Enable send timeout for sockets/netconns and SO_SNDTIMEO processing.

config NET_SO_RCVTIMEO
	bool "Enable receive timeout socket option"
	default y
	---help---
		Enable receive timeout for sockets/netconns and SO_RCVTIMEO processing.

config NET_SO_RCVBUF
	bool "Enable SO_RCVBUF socket option"
	default n
	---help---
		Enable SO_RCVBUF processing.

config NET_SO_REUSE
	bool "Enable SO_REUSE socket option"
	default y
	---help---
		Enable SO_REUSEADDR option.

if NET_SO_REUSE

config NET_SO_REUSE_RXTOALL
	bool "Enable RX to All"
	default n
	---help---
		Pass a copy of incoming broadcast/multicast packets to all local matches
		if SO_REUSEADDR is turned on.
		WARNING: Adds a memcpy for every packet if passing to more than one pcb!

endif #NET_SO_REUSE

endif #NET_SOCKET

endmenu #Socket support
```

## os/net/lwip/configs/stats/Kconfig
```kconfig
menu "Enable Statistics"

config NET_STATS
	bool "Enable Statistics"
	default y
	---help---
		Enable statistics collection in lwip_stats.

if NET_STATS

config NET_STATS_DISPLAY
	bool "Enable Stats Display"
	default n
	---help---
		Enable stats display.

config NET_LINK_STATS
	bool "Enable Link Stats"
	default n
	---help---
		Enable link stats.

config NET_ETHARP_STATS
	bool "Enable ETHARP Stats"
	depends on NET_ARP
	default n
	---help---
		Enable etharp stats.

config NET_IP_STATS
	bool "Enable IP Stats"
	depends on NET_IPv4
	default n
	---help---
		Enable IP stats.

if NET_IP_FRAG || NET_IP_REASSEMBLY
config NET_IPFRAG_STATS
	bool "Enable IP Fragment"
	default n
	---help---
		Enable IP fragmentation stats. Default is on if using either frag or reass.

endif #NET_IP_FRAG || NET_IP_REASSEMBLY

config NET_ICMP_STATS
	bool "Enable ICMP Stats"
	depends on NET_ICMP
	default n
	---help---
		Enable ICMP stats.

config NET_IGMP_STATS
	bool "Enable IGMP Stats"
	depends on NET_IGMP
	default n
	---help---
		Enable IGMP stats.

config NET_UDP_STATS
	bool "Enable UDP Stats"
	depends on NET_UDP
	default n
	---help---
		Enable UDP stats. Default is on if UDP enabled, otherwise off.

config NET_TCP_STATS
	bool "Enable TCP Stats"
	depends on NET_TCP
	default n
	---help---
		Enable TCP stats. Default is on if TCP enabled, otherwise off.

if !NET_MEM_LIBC_MALLOC && !NET_MEM_USE_POOLS
config NET_MEM_STATS
	bool "Enable Memory Stats"
	default n
	---help---

endif #!NET_MEM_LIBC_MALLOC && !NET_MEM_USE_POOLS

config NET_MEMP_STATS
	bool "Enable Memory Pool Stats"
	depends on !NET_MEMP_MEM_MALLOC
	default n
	---help---
		Enable mem.c stats.

config NET_SYS_STATS
	bool "Enable System Stats"
	default n
	---help---
		Enable system stats (sem and mbox counts, etc).

config NET_IPv6_STATS
	bool "Enable IPv6 Stats"
	depends on NET_IPv6
	default n
	---help---
		Enable IPv6 stats.

config NET_IPv6_ICMP_STATS
	bool "Enable ICMP stats for IPv6"
	depends on NET_IPv6
	default n
	---help---
		Enable ICMP stats for IPv6.

config NET_IPv6_FRAG_STATS
	bool "Enable IPv6 fragmentation stats"
	depends on NET_IPv6_FRAG
	default n
	---help---
		Enable IPv6 fragmentation stats.


config NET_IPv6_MLD_STATS
	bool "Enable IPv6 MLD stats"
	depends on NET_IPv6_MLD
	default n
	---help---
		Enable IPv6 MLD stats.

config NET_IPv6_ND_STATS
	bool "Enable IPv6 ND stats"
	depends on NET_IPv6
	default n
	---help---
		Enable IPv6 ND stats.

endif #NET_STATS
endmenu #"Enable Statistics"
```

## os/net/lwip/configs/sys/Kconfig
```kconfig
menu "LWIP Task Configurations"

config NET_TCPIP_CORE_LOCKING
	bool "Enable TCPIP Core Locking"
	default n
	---help---
		Creates a global mutex that is held during TCPIP thread operations.
		Can be locked by client code to perform lwIP operations without changing into TCPIP thread
		using callbacks. See LOCK_TCPIP_CORE() and UNLOCK_TCPIP_CORE().
		Your system should provide mutexes supporting priority inversion to use this.

config NET_TCPIP_CORE_LOCKING_INPUT
	bool "Enable TCPIP Core Locking Input"
	default n
	---help---
		When LWIP_TCPIP_CORE_LOCKING is enabled, this lets tcpip_input() grab the mutex
		for input packets as well, instead of allocating a message and passing it to tcpip_thread.

		ATTENTION: this does not work when tcpip_input() is called from interrupt context!

config NET_TCPIP_THREAD_NAME
	string "LWIP Task Name"
	default "LWIP_TCP/IP"
	---help---
		 The name assigned to the main tcpip thread.

config NET_TCPIP_THREAD_PRIO
	int "LWIP Task Priority"
	default 110
	range 0 255
	---help---
		The priority assigned to the main tcpip thread.
		The priority value itself is platform-dependent,
		but is passed to sys_thread_new() when the thread is created.

config NET_TCPIP_THREAD_STACKSIZE
	int "LWIP Task Stack Size"
	default 4096
	---help---
		The stack size used by the main tcpip thread.
		The stack size value itself is platform-dependent,
		but is passed to sys_thread_new() when the thread is created.

config NET_COMPAT_MUTEX
	bool "Enable Compat Mutex"
	default y
	---help---
		Define LWIP_COMPAT_MUTEX if the port has no mutexes and binary semaphores should be used instead.

config NET_SYS_LIGHTWEIGHT_PROT
	bool "Enable Inter-task Protection"
	default y
	---help---
		Enable inter-task protection (and task-vs-interrupt protection) for certain critical regions
		during buffer allocation, deallocation and memory allocation and deallocation.

		ATTENTION: This is required when using lwIP from more than one context!
			If you disable this, you must be sure what you are doing!

config NET_DEFAULT_THREAD_NAME
	string "LWIP Default Thread Name"
	default "lwIP"
	---help---
		The name assigned to any other lwIP thread.

config NET_DEFAULT_THREAD_PRIO
	int "LWIP Default Thread Priority"
	default 1
	range 0 255
	---help---
		The priority assigned to any other lwIP thread.
		The priority value itself is platform-dependent,
		but is passed to sys_thread_new() when the thread is created.

config NET_DEFAULT_THREAD_STACKSIZE
	int "LWIP Default Thread Stack Size"
	default 0
	---help---
		The stack size used by any other lwIP thread.
		The stack size value itself is platform-dependent,
		but is passed to sys_thread_new() when the thread is created.

endmenu #"LWIP Task Configurations"
```
