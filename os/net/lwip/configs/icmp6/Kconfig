## os/net/lwip/configs/tcp/Kconfig
```kconfig
#
# For a description of the syntax of this configuration file,
# see kconfig-language at https://www.kernel.org/doc/Documentation/kbuild/kconfig-language.txt
#

if NET_TCP

config NET_TCP_TTL
	int "TCP TTL"
	default 255
	---help---
		Default Time-To-Live value

config NET_TCP_WND
	int "TCP Window Size"
	default 2144
	---help---
		The size of a TCP window.  This must be at least (2 * TCP_MSS)
		for things to work well

config NET_TCP_MAXRTX
	int "TCP Max Retransmissions"
	default 12
	---help---
		Maximum number of retransmissions of data segments.

config NET_TCP_SYNMAXRTX
	int "TCP SYN Max Retransmissions"
	default 6
	---help---
		Maximum number of retransmissions of SYN segments.

config NET_TCP_QUEUE_OOSEQ
	bool "TCP out of order support"
	default y
	---help---
		TCP will queue segments that arrive out of order.
		Select 'n' if your device is low on memory.

config NET_TCP_MSS
	int "TCP MSS"
	default 536
	---help---
		TCP Maximum segment size. (default is 536, a conservative default,
		you might want to increase this.) For the receive side, this MSS is
		advertised to the remote side when opening a connection. For the transmit
		size, this MSS sets an upper limit on the MSS advertised by the remote host.

config NET_TCP_CALCULATE_EFF_SEND_MSS
	bool "TCP Enable Effective Send MSS"
	default y
	---help---
		The maximum size of a segment that TCP really sends, the 'effective send MSS,
		' MUST be the smaller of the send MSS (which reflects the available reassembly
		buffer size at the remote host) and the largest size permitted by
		the IP layer (RFC 1122)
		Setting this to 1 enables code that checks TCP_MSS against the MTU of
		the netif used for a connection and limits the MSS if it would be too
		big otherwise.


config NET_TCP_SND_BUF
	int "TCP Send Buffer"
	default 1072
	---help---
		TCP sender buffer space (bytes).
		To achieve good performance, this should be at least 2 * TCP_MSS.


config NET_TCP_SND_QUEUELEN
	int "TCP Send Buffer Pbuf"
	default 8
	---help---
		TCP sender buffer space (pbufs).
		This must be at least as much as (2 * TCP_SND_BUF/TCP_MSS) for things to work.

if !NET_TCP_QUEUE_OOSEQ

config NET_TCP_OOSEQ_MAX_BYTES
	int "The maximum number of bytes queued on ooseq"
	default 0
	---help---
		The maximum number of bytes queued on ooseq per pcb.
		Default is 0 (no limit). Only valid for TCP_QUEUE_OOSEQ==n.


config NET_TCP_OOSEQ_MAX_PBUFS
	int "The maximum number of pbufs queued on ooseq per pcb"
	default 0
	---help---
		The maximum number of pbufs queued on ooseq per pcb.
		Default is 0 (no limit). Only valid for TCP_QUEUE_OOSEQ==n.

endif #!NET_TCP_QUEUE_OOSEQ


config NET_TCP_LISTEN_BACKLOG
	bool "Enable the backlog"
	default n
	---help---
		Enable the backlog option for tcp listen pcb.

if NET_TCP_LISTEN_BACKLOG

config NET_TCP_DEFAULT_LISTEN_BACKLOG
	hex "The maximum allowed backlog"
	default 0xff
	range 0x0 0xff
	---help---
		The maximum allowed backlog for TCP listen netconns.
		This backlog is used unless another is explicitly specified.
		0xff is the maximum (u8_t).

endif #NET_TCP_LISTEN_BACKLOG

config NET_TCP_OVERSIZE
	int "TCP Oversize"
	default 536
	---help---
		TCP_OVERSIZE: The maximum number of bytes that tcp_write may
		allocate ahead of time in an attempt to create shorter pbuf chains
		for transmission. The meaningful range is 0 to TCP_MSS. Some
		suggested values are:
		* 0:         Disable oversized allocation.
		             Each tcp_write() allocates a new pbuf (old behaviour).
		* 1:         Allocate size-aligned pbufs with minimal excess.
		             Use this if your scatter-gather DMA requires aligned fragments.
		* 128:       Limit the pbuf/memory overhead to 20%.
		* TCP_MSS:   Try to create unfragmented TCP packets.
		* TCP_MSS/4: Try to create 4 fragments or less per TCP packet.


config NET_TCP_TIMESTAMPS
	bool "Enable Timestamp"
	default n
	---help---
		support the TCP timestamp option.


config NET_TCP_WND_UPDATE_THRESHOLD
	int "TCP Window Update Threshold"
	default 536
	---help---
		Difference in window to trigger an explicit window update
		Default value : LWIP_MIN((TCP_WND / 4), (TCP_MSS * 4))

endif #NET_TCP
```

## os/net/lwip/configs/udp/Kconfig
```kconfig
#
# For a description of the syntax of this configuration file,
# see kconfig-language at https://www.kernel.org/doc/Documentation/kbuild/kconfig-language.txt
#
if NET_UDP

config NET_NETBUF_RECVINFO
	bool "Append Destination Infomation"
	default n
	---help---
		append destination addr and port to every netbuf.

config NET_UDP_TTL
	int "UDP TTL"
	default 255
	---help---
		Default Time-To-Live value.

config NET_UDPLITE
	bool "Enable UDP-Lite"
	default y
	---help---
		Turn on UDP-Lite. (Requires LWIP_UDP)

endif
```

## os/net/mac/Kconfig
```kconfig
#
# For a description of the syntax of this configuration file,
# see kconfig-language at https://www.kernel.org/doc/Documentation/kbuild/kconfig-language.txt
#

menu "Link Layer Device Interface"

config MAC_ETHERNETIF
	bool "Enable Ethernet Interface between ethernet driver and LWIP network layer"
	default y
	---help---
		Enable support for ethernet interface required for LWIP network layer"

endmenu # Link Layer Device Interface
```

## os/net/netdev/Kconfig
```kconfig
#
# For a description of the syntax of this configuration file,
# see kconfig-language at https://www.kernel.org/doc/Documentation/kbuild/kconfig-language.txt
#

menu "Network Device Operations"

config NETDEV_PHY_IOCTL
	bool "Enable PHY ioctl()"
	default n
	---help---
		Enable support for ioctl() commands to access PHY registers"	
		

endmenu # Network Device Operations
```

## os/net/netmgr/Kconfig
```kconfig
#
# For a description of the syntax of this configuration file,
# see kconfig-language at https://www.kernel.org/doc/Documentation/kbuild/kconfig-language.txt
#
config NET_NETMGR
	bool "Network manager"
	select LWNL80211
	default n
	---help---
		network refactoring

if NET_NETMGR
config NET_NETMGR_ZEROCOPY
	bool "Enable zero-copy in Network Manager"
	default n
	---help---
		Enable zero copy to have Wi-Fi driver handle pbuf directly and vice versa
		this option should be handled carefully

config NET_TASK_BIND
	bool "Bind to the task"
	depends on NSOCKET_DESCRIPTORS > 0
	default n
	---help---
		Enable bind sockets to task

config NET_DEBUG_PORT
	bool "Debugging binded local ports"
	depends on NSOCKET_DESCRIPTORS > 0
	depends on DEBUG_NET_WARN
	default n
	---help---
		Debugging which task requested an open port.
		It accesses lwip pcb outside lwip main thread. So it have to be
		used debugging purpose only.
		And it can't catch ports which applications call lwip API directly like
		dns. And you have to set DEBUG_NET_WARN to print port information.

endif

menu "Network Device Operations"

config NETDEV_PHY_IOCTL
	bool "Enable PHY ioctl()"
	default n
	---help---
		Enable support for ioctl() commands to access PHY registers"	
		

endmenu # Network Device Operations
```

## os/net/tls/Kconfig
```kconfig
if NET_SECURITY_TLS

config TLS_WITH_SSS
	bool "Enable HW Accelerator(SSS)"
	depends on S5J_SSS
	default n

if TLS_WITH_SSS

menu "HW Selection"

config HW_RNG
	bool "HW RNG"
	default n
	---help---
		Supports true random generator by hardware
		Maximum random size is 256 bytes at one time.

config HW_HASH
	bool "HW Hash"
	default n
	---help---
		Accelates hash caculation based on hardware
		Supporting algorithm :
		 . SHA1 : 160
		 . SHA2 : 256, 384, 512
		 . SHA3 : 224, 256, 384, 512

config HW_DH_PARAM
	bool "HW supports DH params"
	default n
	---help---
		Generates and caculates diffie-hellman parameter with hardware.
		Supporting parameter size : 1024, 2048

config HW_ECDH_PARAM
	bool "HW supports ECDH params"
	default n
	---help---
		Generates and caculates eliptic curve params with hardware.
                Supporting curves :
		 . SECP 192, 224, 256, 384, 512
		 . Brainpool 256

config HW_RSA_SIGN
	bool "HW rsa sign"
	default n
	---help---
		Signing a RSA signature based on hardware.
		CAUTION: For use this configuration, keys should be stored in secure storage.
		Supporting key size : 1024, 2048

config HW_RSA_VERIFICATION
	bool "HW rsa verification"
	default n
	---help---
		Verifing a RSA signature based on hardware.
		Supporting key size : 1024, 2048

config HW_ECDSA_SIGN
	bool "HW ecdsa sign"
	default n
	---help---
		Signing a ECDSA signature based on hardware.
		CAUTION: For use this configuration, keys should be stored in secure storage.
		Supporting curves :
		 . SECP 192, 224, 256, 384, 512
		 . Brainpool 256

config HW_ECDSA_VERIFICATION
	bool "HW ecdsa verification"
	default n
	---help---
		Verifing a ECDSA signature based on hardware.
		Supporting curves :
		 . SECP 192, 224, 256, 384, 512
		 . Brainpool 256

endmenu

endif
endif
```

## os/net/utils/Kconfig
```kconfig
#
# For a description of the syntax of this configuration file,
# see kconfig-language at https://www.kernel.org/doc/Documentation/kbuild/kconfig-language.txt
#

config NET_ARCH_CHKSUM
	bool "Architecture-specific net_chksum()"
	default n
	---help---
		Define if you architecture provided an optimized version of
		functions with the following prototypes:

			uint16_t net_chksum(FAR uint16_t *data, uint16_t len)
			uint16_t ipv4_chksum(FAR struct net_driver_s *dev)
			uint16_t tcp_ipv4_chksum(FAR struct net_driver_s *dev);
			uint16_t tcp_ipv6_chksum(FAR struct net_driver_s *dev);
			uint16_t udp_ipv4_chksum(FAR struct net_driver_s *dev);
			uint16_t udp_ipv6_chksum(FAR struct net_driver_s *dev);
```

## os/pm/Kconfig
```kconfig
#
# For a description of the syntax of this configuration file,
# see kconfig-language at https://www.kernel.org/doc/Documentation/kbuild/kconfig-language.txt
#

menuconfig PM
	bool "Power management (PM) driver interfaces"
	default n
	---help---
		Power management (PM) driver interfaces.  These interfaces are used
		to manage power usage of a platform by monitoring driver activity
		and by placing drivers into reduce power usage modes when the
		drivers are not active.

if PM

menuconfig PM_METRICS
	bool "Power management (PM) metrics"
	default n
	---help---
		Power management's metrics

config PM_NDOMAINS
	int "Number of PM activity domains"
	default 32
	---help---
		Defines the number of "domains" that activity may be monitored on.
		For example, you may want to separately manage the power from the
		Network domain, shutting down the network when it is not be used,
		from the UI domain, shutting down the UI when it is not in use.

config PM_DVFS
	bool "Dynamic Voltage Frequency Scaling"
	default n
	depends on ARCH_HAVE_DVFS
	---help---
		Enables option to use DVFS to save power with AI_Dual chipset.

config PM_TICKSUPPRESS
	bool "Support PM Tick Suppression"
	default n
	select SCHED_TICKSUPPRESS
	depends on !SCHED_TICKLESS && ARCH_HAVE_TICKSUPPRESS
	---help---
		Periodic tick interrupts can be suppressed to keep the CPU idle for a longer period
		of time. Tick suppression requires that missed ticks while the core is in an idle state
		be compensated for when the core becomes active. To enable this configuration to
		suppress ticks, the pm_wakehandler() API must be called when the core wakes up.

if PM_TICKSUPPRESS

config PM_TIMEDWAKEUP
	bool "Support PM Timed Wake-up"
	default n
	select SCHED_WAKEUPSOURCE
	---help---
		This config allow application to set power management wakeup timer. The wakeup timer wakes up
		the board after specified time has been passed using hardware timer interrupt.

if PM_TIMEDWAKEUP

config PM_SLEEP_ENTRY_WAIT_MS
	int "Sleep Entry Wait Threshold (in msec)"
	default 10
	---help---
		This value represents the system sleep wait threshold. System should not go to sleep
		if the app request it to sleep below this value. Because then it might not be very
		power efficient. 
		Also Note that, this value is in millisecond.

endif # PM_TIMEDWAKEUP
endif # PM_TICKSUPPRESS

config PM_DOMAIN_NAME_SIZE
	int "Maximum Length of Domain String"
	default 32
	---help---
		This value represents maxinmum domain string size. The domain string should be less than
		this size. This config is intended to reduce unwanted memory consumption cause of long 
		domain string.

endif # PM
```

## os/se/Kconfig
```kconfig
#
# For a description of the syntax of this configuration file,
# see kconfig-language at https://www.kernel.org/doc/Documentation/kbuild/kconfig-language.txt
#

config SE
	bool "Enable embedded SE"
	select TLS_WITH_HW_ACCEL
	select SECURITY_LINK_DRV

if SE
#
# Debug options
#
config DEBUG_SECURE_ELEMENT_ERROR
	bool "Secure element debug ERROR"
	default n
	depends on DEBUG_ERROR
	---help---
		Enable Secure Element ERROR Debug

config DEBUG_SECURE_ELEMENT_INFO
	bool "Secure element debug INFO"
	default n
	depends on DEBUG_VERBOSE
	---help---
		Enable Secure Element INFO Debug

choice
	prompt "SE selection"
	default SE_SSS

config SE_SSS
	bool "Samsung SSS"
	---help---
		Samsung SE chip

config SE_KONAI
	bool "KONAI"
	---help---
		KONAI SE chip

config SE_VIRTUAL
	bool "Virtual SE chip"
	---help---
		Enable Virtual SE chip for testing

config SE_AMEBA
	bool "Ameba Software SE"
	---help---
		Enable Ameba Software SE
endchoice

#
# Below configurations shows availabilities that the SE supports
# Those features let mbedtls know what features it supports
# Each vendors of SE should select features that it supports from below list
#
# config HW_RNG
# config HW_DH_PARAM
# config HW_ECDH_PARAM
# config HW_RSA_VERIFICATION
# config HW_ECDSA_VERIFICATION
# config HW_RSA_ENC
# config HW_SE_STORAGE

if SE_SSS
source se/sss/Kconfig
endif

if SE_KONAI
source se/konai/Kconfig
endif

if SE_VIRTUAL
source se/virtual/Kconfig
endif

if SE_AMEBA
source se/ameba/Kconfig
endif

endif

#
# Config for setting security_level
#
config SECURITY_LEVEL
	bool "Enable setting security level"
	default y
	---help---
		Setting security level high or low.
```

## os/se/konai/Kconfig
```kconfig
config HW_RNG
	bool "HW RNG"
	default n
	---help---
		Supports true random generator by hardware
		Maximum random size is 256 bytes at one time.

config HW_RSA_ENC
	bool "HW rsa encryption"
	default n
	---help---
		Encrypts a data based on hardware.
		Supporting key size : 1024, 2048
```

## os/se/sss/Kconfig
```kconfig
config HW_RNG
	bool "HW RNG"
	default n
	---help---
		Supports true random generator by hardware
		Maximum random size is 256 bytes at one time.

config HW_DH_PARAM
	bool "HW supports DH params"
	default n
	---help---
		Generates and caculates diffie-hellman parameter with hardware.
		Supporting parameter size : 1024, 2048

config HW_ECDH_PARAM
	bool "HW supports ECDH params"
	default n
	---help---
		Generates and caculates eliptic curve params with hardware.
                Supporting curves :
		 . SECP 192, 224, 256, 384, 512
		 . Brainpool 256

config HW_RSA_VERIFICATION
	bool "HW rsa verification"
	default n
	---help---
		Verifing a RSA signature based on hardware.
		Supporting key size : 1024, 2048

config HW_ECDSA_VERIFICATION
	bool "HW ecdsa verification"
	default n
	---help---
		Verifing a ECDSA signature based on hardware.
		Supporting curves :
		 . SECP 192, 224, 256, 384, 512
		 . Brainpool 256

config HW_RSA_ENC
	bool "HW rsa encryption"
	default n
	---help---
		Encrypts a data based on hardware.
		Supporting key size : 1024, 2048

config HW_SE_STORAGE
	bool "Secure Storage Support"
	default n
	---help---
		SE supports Secure Stroage
```
