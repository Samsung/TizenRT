## os/binfmt/libelf/Kconfig
```kconfig
#
# For a description of the syntax of this configuration file,
# see kconfig-language at https://www.kernel.org/doc/Documentation/kbuild/kconfig-language.txt
#

config ELF_ALIGN_LOG2
	int "Log2 Section Alignment"
	default 2
	---help---
		Align all sections to this Log2 value:  0->1, 1->2, 2->4, etc.

config ELF_STACKSIZE
	int "ELF Stack Size"
	default 2048
	---help---
		This is the default stack size that will be used when starting ELF binaries.

config ELF_BUFFERSIZE
	int "ELF I/O Buffer Size"
	default 32
	---help---
		This is an I/O buffer that is used to access the ELF file.  Variable length items
		will need to be read (such as symbol names).  This is really just this initial
		size of the buffer; it will be reallocated as necessary to hold large symbol
		names).  Default: 32

config ELF_BUFFERINCR
	int "ELF I/O Buffer Realloc Increment"
	default 32
	---help---
		This is an I/O buffer that is used to access the ELF file.  Variable length items
		will need to be read (such as symbol names).  This value specifies the size
		increment to use each time the buffer is reallocated.  Default: 32

config ELF_DUMPBUFFER
	bool "Dump ELF buffers"
	default n
	depends on DEBUG_BINFMT_INFO
	---help---
		Dump various ELF buffers for debug purposes

config ELF_EXIDX_SECTNAME
	string "ELF Section Name for Exception Index"
	default ".ARM.exidx"
	depends on LIBCXX_EXCEPTION
	---help---
		Set the name string for the exception index section on the ELF modules to
		be loaded by the ELF binary loader.

		This is needed to support exception handling on loadable ELF modules.

config ELF_EXCLUDE_SYMBOLS
	bool "Excludes symbol information from ELF file"
	default n
	---help---
		If this option is enabled, then it excludes symbol information from the ELF
		and results in a ELF of much smaller size.

config ELF_CACHE_READ
        bool "ELF cache read support"
        default n
        depends on BINFMT_ENABLE
        ---help---
		Enabling this config would increase the elf read performance by
		manyfolds with its caching mechanism.

		If an elf_read taking more time and consistently trying to read the
		same position multiple times, then there would be a considerable delay.
		Enabling this config will cache/buffer the previously accessed data.


if ELF_CACHE_READ

config ELF_CACHE_BLOCK_SIZE
        int "Block size for elf read caching"
        default 2048
        range 512 8192
        ---help---
                Enter block size to use for caching the elf read.

                Note: For compressed binaries, Make sure the cache block size, should be
                      greater than or equal to compression block size. Which would
                      yield good read performance during caching

config ELF_CACHE_BLOCKS_COUNT
        int "Number of Blocks to be cached when reading elf"
        default 60
        range 2 100
        ---help---
                Enter the number of blocks(counts) to use for caching.

endif # ELF_CACHE_READ
```

## os/board/artik05x/Kconfig
```kconfig
#
# For a description of the syntax of this configuration file,
# see kconfig-language at https://www.kernel.org/doc/Documentation/kbuild/kconfig-language.txt
#
config FLASH_START_ADDR
	hex
	default 0x4000000
	---help---
		A start address of flash (in hex).
		This is fixed value, so user doesn't need to change it.

config FLASH_SIZE
	int
	default 8388608
	depends on S5J_SFLASH
	---help---
		A size of flash (in bytes).
		This is fixed value, so user doesn't need to change it.

config ARTIK05X_BOOT_FAILURE_DETECTION
	bool "Clear bootcount when boot completes"
	default y
	---help---
		BL2 sets up a watchdog before it jumps to TinyARA to detect
		boot failures. On a successful boot, the secondary OS should
		turn the watchdog off and clear the bootcount register that
		stores the number of tries to boot. Otherwise, the watchdog
		will bark and BL2 may go into recovery mode.

config ARTIK05X_BOOT_COUNTS_ADDR
	hex "Address of scratch pad register to store the bootcount"
	default 0x80090810
	depends on ARTIK05X_BOOT_FAILURE_DETECTION
	---help---
		The number of tries to boot will be stored in this address.
		On successful boot, it is cleared to zero. The register should
		be kept intact even on watchdog resets.

config ARTIK05X_FLASH_PAGE_SIZE
	int "Page size of external flash memory (in bytes)"
	default 4096
	depends on S5J_SFLASH
	---help---
		Sets the page size of the external flash memory on the
		ARTIK-05x Series Starter Kit board. It can be the size of erase
		unit flash memory supports.

config ARTIK05X_AUTOMOUNT_SSSRW
	bool "Automount secure storage partiton"
	default n
	depends on AUTOMOUNT
	---help---
		If enabled, secure storage partition will be mounted
		automatically at boot.

config ARTIK05X_AUTOMOUNT_SSSRW_DEVNAME
	string "Device name of the partition for secure storage"
	default "/dev/smart0p10"
	depends on ARTIK05X_AUTOMOUNT_SSSRW
	---help---
		Specifies the device name (/dev/smart0pX) of the partition
		for secure storage.

config ARTIK05X_AUTOMOUNT_SSSRW_MOUNTPOINT
	string "Mountpoint of the partition for secure storage"
	default "/sss"
	depends on ARTIK05X_AUTOMOUNT_SSSRW
	---help---
		Specifies the mount point where secure storage
		will be mounted at.

config ARTIK05X_AUTOMOUNT_TZDEVNAME
	string "Device name of the partition for zoneinfo file system"
	default "/dev/mtdblock10"
	depends on LIBC_ZONEINFO_ROMFS
	depends on AUTOMOUNT
	---help---
		Specifies the device name (/dev/mtdblock10) of the partition
		for zoneinfo file system.

config SVR_DB_SECURESTORAGE
	bool "Enable storing SVR DB inside secure storage partition"
	default n
	depends on (SECURITY_SS && ARTIK05X_AUTOMOUNT_SSSRW)
	---help---
		If enabled, SVR DB is stored in secure storage partion
		mounted at the specified mount point.

if RAMMTD
config ARTIK05X_RAMMTD_NEBLOCKS
	int "RAM MTD erase block count"
	default 64
	---help---
		Ramfs size will be RAMMTD_ERASESIZE * ARTIK05X_RAMMTD_NEBLOCKS.
		You have to consider total ramsize to alloc ramfs size.

config ARTIK05X_RAMMTD_DEV_NUMBER
	int "device number for mtd of smartfs"
	default 3

config ARTIK05X_RAMMTD_DEV_POINT
	string "Device name of the partition for ramfs r/w file system"
	default "/dev/smart3"

config ARTIK05X_RAMMTD_MOUNT_POINT
	string "Mountpoint of the partition for ramfs r/w file system"
	default "/ramfs"
endif
```

## os/board/bk7239n/Kconfig
```kconfig
#
# For a description of the syntax of this configuration file,
# see kconfig-language at https://www.kernel.org/doc/Documentation/kbuild/kconfig-language.txt
#

if ARCH_BOARD_BK7239N

source "board/bk7239n/src/middleware/arch/cm33/Kconfig"
source "board/bk7239n/src/middleware/compal/Kconfig"
source "board/bk7239n/src/middleware/boards/bk7239n/vnd_cal/Kconfig"
source "board/bk7239n/src/middleware/boards/bk7239n/vnd_flash/Kconfig"
source "board/bk7239n/src/middleware/soc/Kconfig"
source "board/bk7239n/src/middleware/soc/bk7239n/Kconfig"
source "board/bk7239n/src/middleware/driver/Kconfig"
source "board/bk7239n/src/components/tfm/Kconfig"
source "board/bk7239n/src/components/wpa_supplicant-2.10/Kconfig"
source "board/bk7239n/src/components/bk_startup/Kconfig"
source "board/bk7239n/src/components/bk_system/Kconfig"
source "board/bk7239n/src/components/cmsis/Kconfig"
source "board/bk7239n/src/components/tfm_mbedtls/Kconfig"
# source "board/bk7239n/src/components/bk_rtos/Kconfig"
source "board/bk7239n/src/components/temp_detect/Kconfig"
source "board/bk7239n/src/components/bk_wifi/Kconfig"
source "board/bk7239n/src/components/bk_ate/Kconfig"
source "board/bk7239n/src/components/bk_pm/Kconfig"
source "board/bk7239n/src/components/bk_bluetooth/Kconfig"
source "board/bk7239n/src/components/psa_mbedtls/customization/Kconfig"
source "board/bk7239n/src/components/psa_mbedtls/Kconfig"
source "board/bk7239n/src/components/bk_cli/uart_debug/Kconfig"
source "board/bk7239n/src/components/bk_cli/Kconfig"
source "board/bk7239n/src/components/bk_phy/Kconfig"
source "board/bk7239n/src/components/easy_flash/Kconfig"
source "board/bk7239n/src/libs/Kconfig"


menu "SPI Flash driver"
config FLASH_START_ADDR
    hex "FLASH_START_ADDR"
    default 0x0
    help
        A start address of flash (in hex).
        This is fixed value, so user doesn't need to change it.

config FLASH_SIZE
    int "FLASH_SIZE"
    default 4194304
    help
        A size of flash (in bytes).
        This is fixed value, so user doesn't need to change it.

config BK_FLASH_BASE
    hex "Start address for user filesystem"
    default 0x200000
    help
        Setting this vaule to configure flash start address for user filesystem,
        such as smartfs, romfs.

config BK_FLASH_CAPACITY
    hex "Size for user filesystem"
    default 0x400000
    help
        Setting this vaule to configure flash size  for user filesystem,
        such as smartfs, romfs.

config BK_FLASH_PAGE_SIZE
    int "Read/write unit size of SPI flash"
    default 256
    help
        Setting this vaule to configure read/write unit size of BK SPI flash.

    config BK_FLASH_SECTOR_SIZE
        int "Erase unit size of SPI flash"
        default 4096
        help
            Setting this vaule to configure erase unit size of BK SPI flash.

endmenu

endif
```

## os/board/bk7239n/Kconfig.signing
```kconfig
config USER_SIGN_PREPEND_SIZE
	int "Prepended user binary signing size"
	default 192
	depends on BINARY_SIGNING
	---help---
		This is a size of prepended binary signing data.
```

## os/board/bk7239n/src/components/bk_ate/Kconfig
```kconfig
menu "Bk_ate"

	config ATE
		bool "Enable Ate"
		default n

	menu "Modify Ate Config"
		config ATE_GPIO_ID
			depends on ATE
			int "Set Ate Gpio Id"
			default 0

		config ATE_GPIO_PULL_UP
			depends on ATE
			bool "Enable Ate Gpio Pull Up"
			default y

		config ATE_TEST
			depends on ATE
			bool "Enable Ate Test"
			default n
			
		config ATE_CPU2_ADDRESS
			hex "ATE_CPU2_ADDRESS"
			default 0x2809FFF7

		config ATE_CPU2_VALUE
			hex "ATE_CPU2_VALUE"
			default 0x4332

		config RF_TEST_ENABLE
			depends on ATE
			bool "RF_TEST_ENABLE"
			default n
		config RF_TEST_SWITCH
			depends on ATE
			bool "RF_TEST_ENABLE"
			default n
	endmenu

endmenu
```

## os/board/bk7239n/src/components/bk_bluetooth/Kconfig
```kconfig
menu "BK_Bluetooth"
	depends on ARMINO_BLE

	config BT
		bool "Enable BT"
		default n

	config BLE
		bool "Enable BLE"
		default y

	config BTDM_CONTROLLER_ONLY
		bool "BTDM controller only"
		default n

    config BLUETOOTH_BLE_DISCOVER_AUTO
        bool "auto ble discover. Only used when single ble host"
        default n

    config SUPPORT_BLE_ADV_TXPWR_SET
        bool "support setting ble txpwr"
        default n

    config SUPPORT_BLE_RECONNECTION_STRATEGY
        bool "automatically initialize ble reconnection due to connection establishment failed"
        default y

    config BLE_LV_SUPPORT
        bool "support low voltage sleep"
        default n

    config SUPPORT_REPORTING_COEX_BLE_STATE
        bool "reporting coex ble state"
        default n

    config BLE_MAX_LATENCY
        int "max latency."
        default 20
        range 0 499
endmenu
```
