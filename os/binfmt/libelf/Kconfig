## os/board/bk7239n/src/components/bk_wifi/Kconfig
```kconfig
#TODO optimize it
menu "Bk_Wifi"

	config WIFI_ENABLE
		bool "Enable Wifi Enable"
		default y
		help
			enable wifi

	config WIFI_TX_RAW_ENABLE
		bool "Enable Wifi TX RAW Enable"
		default y
		help
			enable wifi TX RAW

	config WIFI6_CODE_STACK
		depends on WIFI_ENABLE
		bool "Enable Wifi6 Code Stack"
		default y
		help
			Use WiFi-6 Code Stack

	config WIFI_BAND_5G
		depends on WIFI_ENABLE
		bool "Enable 5G Band"
		default n
		help
			Enable WiFi 5G Band.

	config WIFI_BAND_6G
		depends on WIFI_ENABLE
		bool "Enable 6G Band"
		default n
		help
			Enable WiFi 6G Band.

	config WIFI4
		depends on WIFI_ENABLE
		bool "Enable Wifi4"
		default y
		help
			Don't disable it when WiFi-6 is enabled.

	config WIFI5
		bool "Enable Wifi5"
		depends on WIFI6_CODE_STACK && WIFI_BAND_5G
		default n
		help
			Don't disable it when WiFi-6 is enabled.

	config WIFI6
		bool "Enable Wifi6"
		depends on WIFI6_CODE_STACK && WIFI_ENABLE
		default n

	config WIFI6E
		bool "Enable Wifi6e"
		depends on WIFI6_CODE_STACK && WIFI_BAND_6G
		default n
		help
			Don't disable it when WiFi-6 is enabled.

	config WIFI6_IP_DEBUG
		depends on WIFI6_CODE_STACK
		bool "Enable Wifi6 Ip Debug"
		default n

	config MULTI_STA_IN_SAP
		depends on WIFI_ENABLE
		bool "Enable Multi STA"
		default n

	config WIFI_PS_DISABLE
		bool "Disable WiFi PS"
		default n
		help
			disable wifi ps if need.

	config WIFI_CSI_EN
		depends on WIFI_ENABLE
		bool "Wifi CSI"
		default n


	config WIFI_AUTO_COUNTRY_CODE
		bool "Wifi AUTO CC"
		default n

	config WIFI_SCAN_COUNTRY_CODE
		bool "Wifi SCAN CC"
		default n

	config MSDU_RESV_HEAD_LENGTH
		int "Set Msdu Resv Head Length"
		range 1 1500
		default 96
		help
			MSDU reserved header length

	config MSDU_RESV_TAIL_LENGTH
		int "Set Msdu Resv Tail Length"
		range 1 1500
		default 16
		help
			MSDU reserved tail length
	
	config TASK_RECONNECT_PRIO
		int "Set Task Reconnect Prio"
		range 1 10
		default 4
		help
			Priority of WiFi reconnect task

	config AP_MONITOR_COEXIST
		bool "Enable Ap Monitor Coexist"
		default n
		help
			enable AP and monitor coexist

	config CONNECT_THROUGH_PSK_OR_SAE_PASSWORD
		bool"Enable connect through psk or sae password"
		default n

	config WIFI_FAST_CONNECT
		bool "Enable Wifi Fast Connect"
		default n

	config EASY_FLASH_FAST_CONNECT
		depends on EASY_FLASH_V4 && (WIFI_FAST_CONNECT || CONNECT_WITH_MFP_DEAUTH)
		bool "Enable Wifi Fast Connect with easy flash"
		default n

	config FAST_CONNECT_RESTORE_CHAN
		depends on EASY_FLASH_V4 && WIFI_FAST_CONNECT
		bool "Enable Wifi Fast Connect Restore Channel Info"
		default y

	config FAST_FLUSH_SCAN_RESULTS
		bool "Enable Wifi Fast Flush Scan Results"
		default y

	config BSSID_CONNECT
		depends on WIFI_ENABLE
		bool "Enable Bssid Connect"
		default n
		help
			enable WiFi BSSI connect

	config WFA_CERT
		bool "Enable Wfa Cert"
		default n
		help
			enable WiFi WFA Certification

	config LESS_MEMERY_IN_RWNX
		bool "Enable Less Memory In Rwnx"
		default n

	config STA_PS
		bool "Enable Sta Ps"
		default y if !RF_OTA_TEST
		default n if RF_OTA_TEST

	config MAC_BSSID
		depends on WIFI_ENABLE
		bool "Enable Mac Bssid"
		default n

	config COMPONENTS_STA_VSIE
		depends on WIFI_ENABLE
		bool "Enable Components Sta Vsie"
		default n

	config AP_STATYPE_LIMIT
		depends on WIFI_ENABLE && COMPONENTS_STA_VSIE
		bool "Enable Ap mode Sta Type Limit"
		default n
	
	config RECEIVE_BCMC_IN_DTIM10
		bool "Enable Station to Receive BCMC frame in Dtim10"
		default n

	config NOT_CHECK_SSID_CHANGE
		bool "Enable not check beacon ssid changes"
		default n

	config NET_PARAM
		bool "Enable Net Param"
		default y

	config DEAUTH_BEFORE_CONNECT
		bool "send deauth before connect"
		default n

	config IMPROVE_HE_TB_ENABLE
		bool "improve he tb enable"
		default n

	config CLOSE_COEXIST_CSA
		bool "Close coexist csa"
		default n

	config SCAN_SPEED_LEVEL
		int "set scan speed level"
		range 1 3
		default 3

	config NETWORK_FOUND_EVENT_ENABLE
		bool "Enable network found event"
		default n

	config POWER_TABLE
		bool "Enable POWER TABLE"
		default n

	config PM_V2
        	bool "Enable PM V2"
        	default y
        	help
            		Enable power manager V2

	config WIFI_KMSG_TASK_PRIO
		int "Set WiFi Kmsg Task Prio"
		range 1 10
		default 3
		help
			Priority of WiFi kernel message task

	config WIFI_KMSG_TASK_STACK_SIZE
		int "Set Wifi Kmsg Task Stack Size"
		default 4096
		help
			Stack size of WiFi kernel message task

	config WIFI_CORE_TASK_PRIO
		int "Set Wifi Core Task Prio"
		range 1 10
		default 2
		help
			Priority of WiFi core task

	config WIFI_CORE_TASK_STACK_SIZE
		int "Set Wifi Core Task Stack Size"
		default 2048
		help
			Stack size of WiFi core task

	config RWNX_QOS_MSDU
		bool "Enable RWNX Qos MSDU"
		default y
		help
			Enable QoS MSDU

	config WPA_TWT_TEST
		bool "Enable Wpa Twt Test"
		default n
		help
			TWT TEST

	config RWNX_PROTO_DEBUG
		bool "Enabel RWNX Proto Debug"
		default n

	config FIXED_NETIF
		bool "Enable Fixed netif for softap and sta"
		default y

	config RWNX_SW_TXQ
		depends on WIFI6_CODE_STACK
		bool "Enable RWNX SW TXQ"
		default y
		help
			Enable Software Transmit Queue, recommend to enable this feature

	config RWNX_TD
		bool "Enable RWNX TD"
		default y

	config RWNX_MULTIPLE_SSID_STA_MODE
		depends on WIFI6_CODE_STACK
		bool "Enable RWNX MULTIPLE SSID STA MODE"
		default n

	config MINIMUM_SCAN_RESULTS
		depends on WIFI6_CODE_STACK
		bool "Enable minimum scan results"
		default n

	config CUSTOM_MAX_SCAN_RST_NUM
		depends on WIFI6_CODE_STACK
		int "Maximum number of scan results"
		range 1 255
		default 120
		help
			Configure the maximum number of WiFi scan results that can be stored.
			Increasing this value allows more scan results to be retained, but
			consumes more memory. Valid range is 1-255.

	config BK_MEM_DYNA_APPLY_EN
		bool "Enable BK Mem Dyna Apply En"
		default y
		help
			mem dyna app enable

	# bk_hostapd
	config BK_HOSTAPD
		depends on WIFI_ENABLE
		bool "Enable Bk Hostapd"
		default y
		help
			Enable bk hostapd

	config RWNX_FAST_CONNECT
		depends on WIFI6_CODE_STACK
		bool "Enable WiFi Fast Connect"
		default n
		help
			Skip WiFi Join Network procedure to reduct network connection time
			when supplicant passes beacon ies to Umac.

	config P2P
		bool "Enable P2P"
		default n

	config P2P_GO
	    bool "Enable P2P Go"
		default n

	config TX_BUFING
		bool "Enable Tx Bufing"
		default n
		help
			Enable wifi tx bufing

	config AP_PS
		bool "Enable AP PS"
		default n
		help
			enable use ap ps

	config USE_P2P_PS
		bool "Enable Use P2P PS"
		default n

	config AP_PROBEREQ_CB
		bool "Enable AP Probereq Cb"
		default n
		help
			Enable AP probe request callback

	config SPECIAL_TX_TYPE
		depends on WIFI6_CODE_STACK
		bool "Enable Special Tx Type"
		default y
		help
			Enable snd special tx frame

	config MAC_SFRAME_SOFTWARE_RETRY
		bool "Enable Mac Sframe Software Retry"
		default y
		help
			software retry

	config WIFI_FTM
		bool "Enable wifi FTM feature"
		default n

	config WIFI_MAC_SUPPORT_STAS_MAX_NUM
		int "Set Wifi MAC Support STAs Max Num"
		range 2 10
		default 2

	config CALI_DATA_PRINT
		bool "Enable cal data print"
		default n

	config RX_OPTIMIZE
		bool "Optimize rx current"
		default n

	config DEFAULT_COUNTRY_CODE
		string "Default country code"
		default "00"
		help
			Specifiy default country code, "00" is world regulatory domain.

	config WIFI_REGDOMAIN
		bool "Enable Wifi regulatory domain (802.11d)"
		default n
		help
			Enable regulatory domain.

	config WIFI_REGDOMAIN_WMM
		bool "Enable 802.11d WMM rules"
		depends on WIFI_REGDOMAIN
		default n
		help
			Enable 802.11d wmm rules.

	config WIFI_REGDOMAIN_FWDB
		bool "Enable 802.11d WMM rules"
		depends on WIFI_REGDOMAIN
		default y
		help
			Enable binary regulatory db instead of human readable rules.
			Enable this feature to save flash usage.
	config WIFI_RADAR_SUPPORT
		bool "Enable radar support"
		default n
		help
			Enable regulatory radar support.

	config WIFI_CFG_DFT_MIN_RSV_MEM
		int "Set WiFi Default Minimum Reserved Memory (bytes)"
		range 0 30720
		default 10240
		help
			Default minimum heap memory size that Wi-Fi should reserve.
			Default value is 10KB (10240 bytes).

	config BK_TIZEN_IPERF_PROJECT
		bool "To easily distinguish if it's an iperf project"
		default n
	
	config WIFI_WAKEUP_CHANGE_TO_WIFI_PLL
		bool "Enable wifi wakeup change to wifipll"
		default n

	config UPDATE_POWER_WITH_RSSI
		bool "Enable update power with RSSI"
		default y
		help
			Enable update power with RSSI
endmenu
```

## os/board/bk7239n/src/components/cmsis/Kconfig
```kconfig
menu "Cmsis"

	config CMSIS
		bool "Enable Cmsis"
		default n

	menu "Modify Cmsis Config"
		depends on CMSIS

		config DEFAULT_CMSIS_START
			bool "Enable Default Cmsis Start"
			default y

		config DCACHE
			bool "Enable Dcache"
			default y
			help
				Enable data cache

		config ICACHE
			bool "Enable Icache"
			default y
			help
				Enable code cache

	endmenu

endmenu
```

## os/board/bk7239n/src/components/easy_flash/Kconfig
```kconfig
menu "Easy_flash"
	config EASY_FLASH
		depends on FLASH
		bool "Enable Easy Flash"
		default y

	menu "Modify Easy Flash Config"
		depends on EASY_FLASH

		choice EASY_FLASH_VER
			prompt "Select Easy Flash Version"
			default EASY_FLASH_V4

			config EASY_FLASH_V4
				bool "EASY_FLASH_V4"
				help
					EASY_FLASH v4.1.0
		endchoice
	endmenu
endmenu
```

## os/board/bk7239n/src/components/psa_mbedtls/Kconfig
```kconfig
menu "PSA Mbedtls"
	config PSA_MBEDTLS
		bool "Enable mbedtls v3.5.2"
		default n

	config PSA_MBEDTLS_TEST
		depends on PSA_MBEDTLS
		bool "Enable psa mbedtls test"
		default n
	config PSA_CUSTOMIZATION_TZ_L
		bool "Enable adapt customization interface"
		default n
	config PSA_CUSTOMIZATION_TEST
		bool "Enable psa customization test"
		default n
	config PSA_MBEDTLS_FORWARD_COMPATIBILITY
		bool "forward compatibility"
		default n
	config MBEDTLS_USE_PSA_CRYPTO
		bool "use hardware accelerator"
		default n
	config PSA_RSA_TEST
		bool "Enable psa RSA test"
		default n
	config MBEDTLS_SELF_TEST
		bool "Enable mbedtls self test"
		default n
endmenu
```

## os/board/bk7239n/src/components/psa_mbedtls/customization/Kconfig
```kconfig
menu "PSA Mbedtls"
	config PSA_MBEDTLS
		bool "Enable mbedtls v3.5.2"
		default n

	config PSA_MBEDTLS_TEST
		bool "Enable psa mbedtls test"
		default n
	config PSA_CUSTOMIZATION_TZ_L
		bool "Enable adapt customization interface"
		default n
	config PSA_CUSTOMIZATION_TEST
		bool "Enable psa customization test"
		default n
endmenu
```

## os/board/bk7239n/src/components/temp_detect/Kconfig
```kconfig
menu "sensor_detect"
	config TEMP_DETECT
		bool "Enable Temp Detect"
		default n
		help
			Enable temperature detect

	config SDMADC_TEMP
		bool "Enable Sdmadc temp"
		default n
		help
			Use Sigma Delta ADC to detect temperature

	config VOLT_DETECT
		bool "Enable voltage detect"
		default n

	config VBAT_5V
		bool "5V Enable"
		default n

	config TEMPERATURE_HIGH_VOLT
		bool "Switch code25 temp"
		default n
		help
			Use low-voltage temp_code if the scenario involves operations from low voltage to high voltage
			Use temp_code if it consistently works at high voltage (Vbat >= 2.8V)

endmenu
```
