## os/board/bk7239n/src/components/bk_cli/Kconfig
```kconfig
menu "Beken_cli"

	menu "Modify Cli Config"

		config CLI
			bool "Enable Cli"
			default y

		config BK_CLI_USE_SEPRATE_UART
			depends on CLI
			bool "Enable Cli Use Seprate Uart"
			default y
			help
				Enable Cli Use Seprate Uart

		config CLI_USER_CONFIG
			depends on CLI
			bool "Enable Cli User Config"
			default n
			help
				support cli user configuration header

		config CLI_USER_CONFIG_DIR
			depends on CLI_USER_CONFIG
			string "Define Cli User Config Dir"
			default ""
			help
				cli user configuration header directory

		config CLI_CODE_SIZE_OPTIMIZE_ENABLE
			depends on CLI
			bool "Enable Cli Code Size Optimize"
			default n
			help
				Enable Cli Code Size Optimize

		config BKREG
			depends on CLI
			bool "Enable Bkreg"
			default y
			help
				Enable BK Reg read/write

		config BKREG_SHOW_CALI
			depends on BKREG
			bool "Enable Show Cali Table"
			default n
			help
				Enable Show Cali Table

		config MAX_COMMANDS
			depends on CLI
			int "Set Max Commands"
			range 0 65535
			default 255
			help
				MAX number of commands is configured by default

		config IPERF_TEST
			depends on CLI && WIFI_ENABLE
			bool "Enable Iperf Test"
			default y
			
		config WIFI_CLI_ENABLE
			depends on CLI && WIFI_ENABLE
			bool "Enable Wifi Cli Enable"
			default y
			
		config TCP_SERVER_TEST
			depends on CLI
			bool "Enable Tcp Server Test"
			default n
		
		config BK_DUMP_FLASH_TEST
			depends on CLI
			bool "Enable Dump To Flash Test"
			default n

		config NIST_TEST
			depends on CLI
			bool "Enable Security Algorithm Nist Test"
			default n

		config SECURE_TEST
			depends on CLI
			bool "Enable Security Test"
			default n

		config AIRKISS_TEST
			depends on CLI
			bool "Enable Airkiss Test"
			default n

		config WIFI_RAW_TX_TEST
			depends on CLI
			bool "Enable Wifi Raw Tx Test"
			default n

		config WIFI_CLI_RAW_LINK_ENABLE
			depends on CLI
			bool "Enable Wifi CLI Raw Link enable"
			default n

		config CONNECT_THROUGH_PSK_OR_SAE_PASSWORD
			depends on CLI
			bool "Enable connect through psk or sae password"
			default n

		config VFS_TEST
			depends on CLI
			bool "Enable Vfs Test"
			default n

		#TODO Exculsive??
		config I2C1_TEST
			depends on CLI
			bool "Enable I2C1 Test"
			default n

		config I2C2_TEST
			depends on CLI
			bool "Enable I2C2 Test"
			default n

		config UART_TEST
			depends on CLI
			bool "Enable Uart Test"
			default n

		config SPI_TEST
			depends on CLI
			bool "Enable SPI Test"
			default n

		config LCD_QSPI_TEST
			depends on LCD_QSPI
			bool "Enable Lcd Qspi Test"
			default n

		config PERI_TEST
			depends on CLI
			bool "Enable Peri Test"
			default n

		config RF_OTA_TEST
			depends on CLI
			bool "Enable Rf Ota Test"
			default n

		config SHELL_ASYNCLOG
			bool "Enable Shell Asynclog"
			default n
			help
				Enable Shell and Async log optimize
				
		config UART_RING_BUFF
			depends on SHELL_ASYNCLOG
			bool "Enable uart ring buffer"
			default n
			help
				Enable uart ring buffer

		config EX_DYNAMIC_LOG_BUFF
			depends on SHELL_ASYNCLOG
			bool "Enable dynamic log buffer"
			default n
			help
				Enable dynamic log buffer

		config TOUCH_TEST
			depends on CLI
			bool "Enable Touch Test"
			default n

		config SBC_TEST
			depends on CLI
			bool "Enable Sbc Test"
			default n

		config AUDIO
			depends on CLI
			bool "Enable Audio"
			default n

		config PSRAM_TEST
			depends on CLI && PSRAM
			bool "Enable Psram Test"
			default n

		config DVP_CAMERA_TEST
			depends on CLI && DVP_CAMERA
			bool "Enable dvp Camera Test"
			default n

		config INTERRUPT_TEST
			depends on CLI
			bool "Enable Interrupt Test"
			default n

		config AON_PMU_TEST
			depends on CLI
			bool "Enable Aon Pmu Test"
			default n

		config SDMADC_TEST
			depends on CLI
			bool "Enable Sdmadc Test"

		config PM_TEST
			depends on CLI
			bool "Enable Pm Test"
			default n

		config VIDEO_TRANSFER_DEMO
			depends on CLI
			bool "Enable H264 DEMO"
			default n

		config PUF_TEST
			depends on CLI
			bool "Enable PUF Test"
			default n

		config EFUSE
			bool "Enable Efuse"
			default y

		config ICU
			bool "Enable Icu"
			default y

		config SECURITYIP
			bool "Enable Securityip"
			default n
			help
				Enable SecurityIP

		config MBEDTLS_TEST
			depends on MBEDTLS
			bool "Enable mbedtls test"
			default n
			help
				Enable mbedtls test

		config KEYVALUE
			bool "Enable Keyvalue"
			default n

		config IDLE_UART_OUT_TEST
			bool "Enable Idle Uart Out Test"
			default n

		config COMPONENTS_WPA2_ENTERPRISE
			bool "Enable Components Wpa2 Enterprise"
			default n

		config COMPONENTS_WPA_TWT_TEST
			bool "Enable Wpa Twt Test"
			default n

		config COMPONENTS_WFA_CA
			bool "Enable Components Wfa Ca"
			default n

		config ENABLE_WIFI_DEFAULT_CONNECT
			bool "Enable Wifi Default Connect"
			default n

		config RTC_TIMER_PRECISION_TEST
			bool "Enable RTC Timer precision test"
			default n

		config RTC_TIMER_PRECISION_TEST_BY_GPIO
			bool "Enable RTC Timer precision test"
			default n

		config EFUSE
			bool "Enable Efuse"
			default y

		config ICU
			bool "Enable Icu"
			default y

		config RWNX_PROTO_DEBUG
			bool "Enable Rwnx Proto Debug"
			default n

		config AUDIO_TEST
			depends on AUDIO
			bool "Enable Audio driver test"
			default n

		config AUDIO_ATE_TEST
			depends on AUDIO_ADC
			depends on AUDIO_DAC
			depends on I2S
			bool "Enable Audio ate test"
			default n

		config FFT_TEST
			depends on FFT
			bool "Enable FFT Test"
			default n

		config I2S_TEST
			depends on I2S
			bool "Enable I2S Test"
			depends on I2S
			default n

		config SLCD_TEST
			depends on SLCD
			bool "Enable SLCD Test"
			default n

		config INJECT_KEY
			bool "Enable Inject Key"
			default n
		
		config BLE_CLI_ENABLE
			depends on CLI && ARMINO_BLE
			bool "Enable BLE Cli Enable"
			default y

	endmenu
endmenu
```

## os/board/bk7239n/src/components/bk_cli/uart_debug/Kconfig
```kconfig
menu "modules::uart_debug"
	config UART_DEBUG
		bool "Enable Uart Debug"
		default n

	config ATE
		bool "Enable ATE"
		default y

	config ATE_TEST
		depends on ATE
		bool "Enable ATE Test"
		default n
endmenu
```

## os/board/bk7239n/src/components/bk_phy/Kconfig
```kconfig
#TODO optimize it
menu "Bk_Phy"
	config NON_SIGANL_PHY_ENABLE
		bool "Enable non signal phy"
		default y

	config PHY_LOG_ENABLE
		bool "Enable voltage detect"
		default n

	config RF_FIRMWARE_DYNAMIC_PARTITION
		bool "Enable rf firmware partition dynamic"
		default y

endmenu
```

## os/board/bk7239n/src/components/bk_pm/Kconfig
```kconfig
menu "PM"
	config PM_ENABLE
		bool "pm enable"
		default n

	config PM_CLIENT
		bool "indicate the current cpu running as pm client core, otherwise running as pm server core"
		default n

	config PM_SUPER_DEEP_SLEEP
		bool "Enable super deep sleep"
		default n

	config PM_EXTEND_CPU_FREQ
		bool "Extend cpu freq"
		default n

	config PM_LV_TIME_COST_DEBUG
		bool "Enable low voltage sleep time cost debug"

	config PM_ENTER_LV_TIME_OUT_PERIOD_MS
		int "Enter LV time out"
		default 30000
		help
			enter LV time out time(unit:ms)

	config PM_LV_WDT_PROTECTION
		bool "add protection for hardware enter low voltage fail when application abnormal operate, using wdt to reboot"
		default n

	config PM_CPU_FRQ_HIGHEST
		int "config highest cpu frequency"
		default 4
		help
		   config highest cpu frequency(0:xtal;1:60M;2:80M;3:120M;4:160M;5:240M;)

	config PM_CPU_FRQ_DEFAULT
		int "config default cpu frequency"
		default 3
		help
		   config default cpu frequency(0:xtal;1:60M;2:80M;3:120M;4:160M;5:240M;)

	config PM_PROTECT_TIME_CHECK
		bool "Primarily protect time check"
		default n
		help
			Primarily protect the BT sleep time until re-entering the sleep scenario

	config PM_LOWEST_POWER_MODE
		int "config lowest power mode"
		default 0
		help
		   config lowest power mode(0:normal sleep;1:low voltage sleep;2:deep sleep;3:super deep sleep;)

	config PM_CPU_FIXED_FREQ
		int "config fixed cpu frequency"
		default 3
		help
		   config default cpu frequency(0:xtal;1:60M;2:80M;3:120M;4:160M;5:240M;)

	config PM_CPU_FIXED_FREQ_ENABLE
		bool "enable fixed cpu frequency, if enable, the cpu frequency will be fixed to the value of PM_CPU_FIXED_FREQ"
		default n
		help
		   enable fixed cpu frequency

	config PM_VDDDIG_FIXED_VOLTAGE
		int "config fixed vdddig voltage"
		default 8
		help
		   Set Low power voltage default value 0.8v(0.6+0.025*8)
		   This value should not be configured arbitrarily. Prior discussion with the chip vendor's support engineers is required before configuration

	config DEEP_LV
		bool "Enable deep low voltage"
		default n

endmenu
```

## os/board/bk7239n/src/components/bk_rtos/Kconfig
```kconfig
menu "Bk_rtos"

	config CUSTOMIZE_HEAP_SIZE
		int "Set Customize Heap Size"
		default 163840
		help
			customize heap size, default 160k
	
	config SIZE_OPTIMIZE
			bool "Optimize flash size"
			default n

	menu "Modify FreeRTOS Config"
		config FREERTOS
			bool "Enable FreeRTOS"
			default y

		config FREERTOS_USE_QUEUE_SETS
			depends on FREERTOS
			bool "Enable FreeRTOS Queue_Sets"
			default n

		config MEM_MGMT
			bool "Enable Mem Mgmt"
			default n
			help
				Enable heap management module

		choice FREERTOS_VER
			depends on FREERTOS
			prompt "Select FreeRTOS Version"
			default FREERTOS_V9

			config FREERTOS_V9
				bool "FreeRTOS v9.0.0"
			config FREERTOS_V10
				bool "FreeRTOS v10"
			config FREERTOS_SMP
				bool "FreeRTOS SMP v10"
		endchoice

		config FREERTOS_POSIX
			depends on FREERTOS_V10 || FREERTOS_SMP
			bool "Enable FreeRTOS Posix"
			default n

		config FREERTOS_TRACE
			depends on FREERTOS_V10
			bool "FreeRTOS Trace"
			default n

		config TASK_STACK_IN_PSRAM
			depends on FREERTOS_V10
			bool "Create FreeRTOS Task stack in psram"
			default n
		
		config QUEUE_IN_PSRAM
			depends on FREERTOS_V10
			bool "Create FreeRTOS queue in psram"
			default n

		config FREERTOS_ALLOW_OS_API_IN_IRQ_DISABLED
			depends on FREERTOS_SMP
			bool "Allow Call OS API in IRQ disabled"
			default n
			help
				Allow call some OS API in irq disabled, and scheduler will not enable
				the irq but left the user app to restore previous irq status.

		config FREERTOS_SMP_TEMP
			depends on FREERTOS_SMP
			bool "SMP TEMP code"
			default n

		config FREERTOS_RTT_MONITOR
			depends on FREERTOS_SMP
			bool "FreeRTOS Segger Real-Time Transfer"
			default n

		config FREERTOS_USE_TICKLESS_IDLE
			depends on FREERTOS_V10 || FREERTOS_SMP
			int "Set FreeRTOS Use Tickless Idle"
			default 2
			help
				Use tickless idle, can be 0/1/2

        config FREERTOS_USE_RECURSIVE_MUTEXES
            bool "FreeRTOS recursive mutex"
            default n

		config FREERTOS_TICK_RATE_HZ
			depends on FREERTOS
			int "Set FreeRTOS tick count per second"
			default 500
			help
				System tick count per second, can be 1-1000

	endmenu

	menu "Modify LITEOS_M Config"

		config LITEOS_M
			bool "Enable Liteos_m"
			default n

		config LITEOS_M_V3
			bool "Enable Liteos_m_v3"
			default n
			help
				liteos_m v3.0.1-LTS

		config LITEOS_M_BK
			depends on LITEOS_M_V3
			bool "Enable Liteos_m_bk"
			default n
			help
				liteos_m bk adapter

	endmenu

	menu "Modify NON_OS Config"

		config NON_OS
			bool "Enable Non_os"
			default n

	endmenu

	menu "Modify Memory Debug Config"

		config MALLOC_STATIS
			bool "Enable Malloc Statis"
			default n
			help
				enable malloc statistics

		config MEM_DEBUG
			bool "Enable Mem Debug"
			default n
			help
				When this option is enable, more memory will be consumed because
				a fixed length debug block will be appended to every memory allocated
				from heap.
				Moreover, suggest disable task/watchdog when this option is enabled
				in case os_dump_memory_stats() triggers watchdog.

		config MEM_DEBUG_FUNC_NAME
			depends on MEM_DEBUG
			bool "Enable Mem Debug Func Name"
			default y

		config MEM_DEBUG_FUNC_NAME_LEN
			depends on MEM_DEBUG_FUNC_NAME
			int "Set Mem Debug Func Name Len"
			default 16
			help
				set memory debug function name length

		config MEM_DEBUG_TASK_NAME
			depends on MEM_DEBUG
			bool "Enable Mem Debug Task Name"
			default y

		config MEM_DEBUG_TASK_NAME_LEN
			depends on MEM_DEBUG_TASK_NAME
			int "Set Mem Debug Task Name Len"
			default 8
			help
				set memory debug task name length

	endmenu

endmenu
```

## os/board/bk7239n/src/components/bk_startup/Kconfig
```kconfig
menu "Bk_startup"

	config APP_MAIN_TASK_PRIO
		int "Set App Main Task Prio"
		range 1 10
		default 4
		help
			priority of application main task

	config APP_MAIN_TASK_STACK_SIZE
		int "Set App Main Task Stack Size"
		default 4096
		help
			stack size of application main task

	config MATTER_START
		bool "Enable Matter Start"
		default n
		help
			enable matter auto start

endmenu
```

## os/board/bk7239n/src/components/bk_system/Kconfig
```kconfig
#TODO may need to remove this component!
menu "BK_system"

	menu "Mac Config"
		choice BASE_MAC_SRC
			prompt "Select Base Mac Source"
			default NEW_MAC_POLICY

			config NEW_MAC_POLICY
				bool "NEW_MAC_POLICY"
			config BASE_MAC_FROM_OTP2
				bool "BASE_MAC_FROM_OTP2"
		endchoice

		config RANDOM_MAC_ADDR
	        bool "Enable Random Mac Addr"
	        default n

		config BK_MAC_ADDR_CHECK
			bool "Enable Beken Mac Addr Check"
			default n

		config CUS_MAC_MASK
			hex "Set Customize Mac Address Mask"
			default 0
	endmenu

	menu "Print Config"
		choice SYSTEM_PRINT_DEVICE
			prompt "System print device"
			default SYS_PRINT_DEV_UART

			config SYS_PRINT_DEV_UART
				bool "System print by uart"

			config SYS_PRINT_DEV_MAILBOX
				bool "System print by mailbox"

			config SYS_PRINT_DEV_NULL
				bool "Close system print"
		endchoice

		config FWD_CMD_TO_CPUx
			depends on MAILBOX
			bool "Forward cpu1/cpu2 cmd by mailbox"
			default y

		config WIFI_DEBUG_LOG
			bool "enable wifi debug log"
			default n

		config BT_DEBUG_LOG
			bool "enable bluetooth debug log"
			default n

		config SMP_SYNC_PRINTF
			bool "smp sync printf"
			default n

		config UART_PRINT_BAUD_RATE
			depends on SYS_PRINT_DEV_UART
			int "uart print baud rate"
			default "115200"
	endmenu

	menu "System Config"
		config BEKEN_EVB
			bool "Enable Beken EVB Mode"
			default y
			help
				When this macro is enabled, the internal code will automatically adapt to the BEKEN EVB environment.
	endmenu

	menu "SWD Debug Config"
		config SWD_DEBUG_MODE
			bool "Enable SWD Debug Mode"
			default n
            help
				After enabling this marco,the SWD function will be configured by default in the 
				code,and the board can be connected via Jlink.

		config SWD_DEBUG_MODE_PIN_DIO
			int "SWD Debug Mode Pin TMS Configuration "
			default 16
			depends on BEKEN_EVB
			help 
				Set the default pins for SWDIO

		config SWD_DEBUG_MODE_PIN_CLK
			int "SWD Debug Mode Pin TCK Configuration "
			default 17
			depends on BEKEN_EVB
			help 
				Set the default pins for SWDCLK
	endmenu
endmenu
```
