## os/board/bk7239n/src/components/tfm/Kconfig
```kconfig
menu "Tfm"
	config TFM
		bool "Enable TFM"
		default n

	menu "Modify TFM Info"
		depends on TFM

		config TFM_PROFILE
			string "Define Tfm Profile"
			default "profile_medium"
			help
				psa level:0(profile_small) 1(profile_medium) 2(profile_large)

		config TFM_BUILD_TYPE
			string "Define Tfm Build Type"
			default "minsizerel"
			help
				build type: debug, release or minsizerel

		config TFM_FPGA
			string "Enable FPGA: ON/OFF"
			default "OFF"

		config TFM_FWU
			bool "Enable Firmware Update"
			default n
			help
				Enable FWU: ON/OFF

		config TFM_SYSTEM_CLOCK
			bool "Enable TFM system clock ctrl"
			default n
			help
				Enable TFM_SYSTEM_CLOCK: ON/OFF

		config TFM_CRYPTO
			bool "Enable TFM CRYPTO"
			default n
			help
				Enable CRYPTO: ON/OFF

		config TFM_PS
			bool "Enable TFM PS"
			default n
			help
				Enable PS: ON/OFF

		config TFM_TEST_S
			string "Define Tfm Test S"
			default "OFF"
			help
				Enable to TFM secure bin test: ON/OFF

		config TFM_TEST_NS
			string "Define Tfm Test NS"
			default "OFF"
			help
				Enable to TFM non-secure bin test: ON/OFF

		config TFM_LOG_LEVEL
			string "Define Tfm Log Level"
			default "INFO"
			help
				Set TFM log level: OFF/ERROR/WARNING/INFO/DEBUG

		config TFM_BL2_LOG_LEVEL
			string "Define Tfm Bl2 Log Level"
			default "INFO"
			help
				Set BL2 log level: OFF/ERROR/WARNING/INFO/DEBUG

		config TFM_BL2
			string "Define Tfm Bl2"
			default "OFF"
			help
				Enable BL2: ON/OFF

		config TFM_BL2_DOWNLOAD
			bool "Enable BL2 download"
			default y
			help
				Enable BL2 Download

		config TFM_SECURE_DEBUG
			bool "Enable Secure Debug"
			default n
			help
				Enable Secure Debug

		config OTP_NV_COUNTERS_RAM_EMULATION
			string "Define Otp Nv Counters Ram Emulation"
			default "OFF"
			help
				Enable OTP/NV counter RAM emulation: ON/OFF

		config PLATFORM_DEFAULT_OTP_WRITEABLE
			string "Define Platform Default Otp Writeable"
			default "ON"
			help
				Enable platform default OTP writable: ON/OFF

		config TFM_SYS_LL_NSC
			bool "Enable system_ll nsc"
			default n

		config TFM_AON_PMU_LL_NSC
			bool "Enable aon_pmu_ll nsc"
			default n

		config BL2_UPGRADE_STRATEGY
			string "Define mcuboot upgrade strategy"
			default "SWAP_USING_SCRATCH"
			help
				The MCUBOOT upgrade strategy can be:
				OVERWRITE_ONLY, SWAP_USING_SCRATCH, SWAP_USING_MOVE.

		config TFM_BK7236_V5
			bool "Use BK7236 v5"
			default y

		config TFM_REG_ACCESS_NSC
			bool "Enable security registers access"
			default n
			help
				Enable read/write security registers from non-security world.
				Should be disabled in release version!

		config TFM_MPC_NSC
			bool "Enable MPC NSC api"
			default n
			help
				Enable configure MPC from non-security, for chip verification only.
				Should be disabled in release version!

		config TFM_FLASH_NSC
			bool "Enable flash NSC api"
			default n
			help
				Enable flash API for non-security, for chip verification only.
				Should be disabled in release version!

        config TFM_READ_FLASH_NSC
			bool "Enable read flash NSC by cbus api"
			default n
			help
				Enable flash API for non-security, read flash by cbus.

		config TFM_DUBHE_KEY_LADDER_NSC
			bool "Enable dubhe key ladder NSC api"
			default n
			help
				Enable dubhe key ladder API for non-security

		config TFM_OTP_NSC
			bool "Enable otp NSC api"
			default n
			help
				Enable otp API for non-security

		config TFM_INT_TARGET_NSC
			bool "Enable interrupt target NSC api"
			default n
			help
				Enable interrupt target API for non-security, for chip verification only.
				Should be disabled in release version!

		config PM_NSC
			bool "Enable pm NSC api"
			default n
			help
				Enable PM API for non-security

		config TFM_AES_GCM_NSC
			bool "Enable do security aes gcm"
			default n
			help
				Enable do security aes gcm encrypt and decrypt.
				Should be disabled in release version!

		config TFM_ECP_NSC
			bool "Enable ecp calculation NSC api"
			default n
			help
				Enable ecp calculation for non-security.

		config TFM_ASYM_ALGO_NSC
			bool "Enable asym algo NSC api"
			default n
			help
				Enable asym algo API for non-security

		config TFM_HKDF_NSC
			bool "Enable HKDF calculation NSC api"
			default n
			help
				expose HKDF api to reduce app size.

		config TFM_DRBG_NSC
			bool "Enable DRBG NSC api"
			default n
			help
				expose DRBG api to reduce app size.

		config TFM_DH_NSC
			bool "Enable DH NSC api"
			default n
			help
				adapt the DH alg.
				expose DH api to reduce app size.

		config TFM_25519_NSC
			bool "Enable 25519 NSC api"
			default n
			help
				adapt the 25519 alg.
				expose 25519 api to reduce app size.

		config TFM_SCA_AES_NSC
			bool "Enable SCA AES NSC api"
			default n
			help
				Enable SCA AES NSC alg.

		config TFM_MPU
			bool "Enable TFM official MPU"
			default n
			help
				Enable TFM official MPU

		config TFM_PANIC_DEAD_LOOP
			bool "TFM panic trigger dead loop"
			default n
			help
				Enable TFM dead loop panic

		config XIP_NO_VERSION
			bool "xip without security counter and version"
			default n

		config BL2_SKIP_VALIDATE
			bool "Bl2 skip validate"
			default n

		config BL2_VALIDATE_ENABLED_BY_EFUSE
			bool "BL2 validate is enabled by eFuse"
			default y

		config BL2_WDT
			bool "Enable BL2 watchdog"
			default n

		config TFM_HEAP_SIZE
			hex "TFM heap size"
			default 0x1040

		config BL2_WDT_PERIOD
			hex "BL2 wdt timeout period"
			default 0x1F40

		config TFM_CRYPTO_IOVEC_BUFFER_SIZE
			hex "TFM_CRYPTO_IOVEC_BUFFER_SIZE"
			default 0x1400

		config INITIAL_ATTESTATION
			bool "Enable compile tfm initial attestation file"
			default n
			help
				Enable compile tfm initial attestation file

		config BL2_UPDATE_WITH_PC
			bool "update BL2 with pc"
			default n
			help
				update BL2 with pc

		config TFM_MBEDTLS_RSA_C
			bool "enable rsa driver for hardware"
			default n
			help
				enable rsa driver for hardware: n/y

		config TFM_MBEDTLS_PKCS1_V15
			bool "enable MBEDTLS_PKCS1_V15"
			default n
			help
				enable MBEDTLS_PKCS1_V15: n/y
	endmenu
endmenu

config SECURITY_FIRMWARE
    bool "enable security firmware / no-security firmware"
    default n
    help
        enable security firmware / no-security firmware
	
config STARTUP_PERFORMANCE
    bool "startup_performance, include in bl2 / tfm / app"
    default n
    help
        startup_performance, include in bl2 / tfm / app
```

## os/board/bk7239n/src/components/tfm_mbedtls/Kconfig
```kconfig
menu "TFM Mbedtls"
	config MBEDTLS_ACCELERATOR
		bool "Enable mbedtls accelerator"
		default n

	config TE200_TEST
		bool "Enable TE200 test"
		default n

	config TE200_ENTROPY
		bool "Enable TE200 entropy"
		default n

endmenu
```

## os/board/bk7239n/src/components/wpa_supplicant-2.10/Kconfig
```kconfig
menu "modules::wpa_supplicant-2.10"

	config SELECT_PROPRIETARY_SUPPLICANT
		depends on WIFI_ENABLE
		bool "Enable BEKEN Wpa Supplicant 2.10"
		default y
		help
			Enable BEKEN wpa_supplicant-2.10

	menu "Modify Wpa Supplicant 2.10 Config"
		depends on SELECT_PROPRIETARY_SUPPLICANT

		config TASK_WPAS_PRIO
			int "Set Task Wpas Prio"
			range 1 10
			default 5
			help
				Priority of WPAS task

		config WPA3
			bool "Enable WPA3"
			default y
			help
				When WPA3 is enabled, the PMF should be enabled also!

		config SOFTAP_WPA3
			bool "Enable Softap WPA3"
			default n
			help
				Enable softap WPA3 SAE. This may costs some code size. Use mbedtls as
				the crypto suite may accelerate ECC caculation speed.

		config PMF
			bool "Enable PMF"
			default y if WPA3
			default n if !WPA3
			help
				Enable PMF(802.11w)

		config WPA2_PREFER_TO_SAE
			depends on WPA3 && PMF
			bool "Enable WPA2 Prefer To Sae"
			default y
			help
				Prefer WPA2 instead of WPA3 if BSS in WPA3 transition mode.
				WPA2(prefer to use non-mfp) will be used instead of wpa3-sae if bss is
				in WPA3 transistion mode, and wpa3 always sets to mfp capable to avoid
				disconnection with reason code set to "Robust managment frame policy
				viloation (0x001f)" even if bss sets mfp required bit to 0 (No Required).
				This feature eliminates AP's SA query prodecure and reduces connecting time
				with AP.

		config WIFI_OWE
			depends on WPA3 || SOFTAP_WPA3
			bool "Enable WiFi OWE"
			default n

		config AP_HT_IE
			bool "Enable AP HT IE"
			default n

		config AP_VHT
			bool "Enable AP VHT"
			default n

		config AP_HE
			depends on WIFI6
			bool "Enable AP HE"
			default n

		config AP_VSIE
			bool "Enable AP VSIE"
			default y
			help
				Enable AP Vendor Specific IE

		config STA_VSIE
			bool "Enable STA VSIE"
			default n
			help
				Enable STA Vendor Specific IE

		config STA_AUTO_RECONNECT
			bool "Enable STA Auto Reconnect"
			default n
			help
				Enable STA auto reconnect feature.
				Supplicant automatically reconnect with AP if connection fails or disconnected
				by AP. When this function is enabled, users can set auto reconnect max retry count
				and reconnect timeout, and enable or disable auto reconnect when disconnected by AP
				if STA is in COMPLETE state.

		config WPA_LOG
			bool "Enable WPA Log"
			default n

		config P2P
			bool "Enable P2P"
			default n

		config P2P_GO
			bool "Enable P2P Go"
			default n

		config WIFI_WPS
			bool "Enable WiFi WPS"
			default n

		config WPS
			bool "Enable WPS"
			default n

		config WPA2_ENTERPRISE
			bool "Enable Wpa2 Enterprise"
			default n

		config MOBILE_CONNECT_SAP_STATISTICS
			bool "Enable Mobile Connect Sap Statistics"
			default n
			help
				Statistics mobile connect sap time

		config USE_MBEDTLS
			bool "Enable MBEDTLS"
			default y
			help
				use mbedtls as tls transport.
				Use mbedtls as the crypto suite may accelerate ECC caculation speed.

		config WPA_PSK_CACHE
			bool "Enable WPA PSK Cache"
			default y
			help
				PSK cache enable.
				Caculate psk in advance, and store it in memory. Recommended to enable if 
				no hw accelerator exists.

		config WPA_PSK_CACHE_MULTI
			bool "Enable WPA PSK Cache Multi"
			default n
			help
				caculate multiple psk

		config SELECT_NETWORK_AFTER_PSK_SET
			bool "Enable Select Network After PSK Set"
			default n
			help
				connect to AP after psk is caculated

		config MINIMIZE_SCAN_RESULT_IE
			bool "Enable Minimize Scan Result IE"
			default n
			help
				minimize scan result memory usage
	
		config SAE_OVERCLOCK
			bool "Enable SAE Overclock"
			default n
			help
				change CPU freq when do SAE process

		config WIFI_OCV
			bool "Enable WiFi OCV"
			default n

		config MINIMUM_SCAN_RESULTS
			bool "Enable minimum scan results"
			default n
	endmenu

	config WIFI_FAST_CONNECT
		bool "Enable Wifi Fast Connect"
		default n
		help
			use fast connect

	config WIFI_FAST_DHCP
		depends on WIFI_FAST_CONNECT
		bool "Enable WiFi Fast DHCP"
		default n
		help
			use previous dhcp ip address

	config WIFI_WNM
		depends on SELECT_PROPRIETARY_SUPPLICANT
		bool "WNM"
		default n

	config WLAN_FAST_CONNECT_WITHOUT_SCAN
		bool "Enable Wlan Fast Connect Without Scan"
		default n
		help
			fast connect with scan.
			wpa_supplicant will use beacon/probersp IEs from fci, and connect with
			AP without any scan.

	config WLAN_FAST_CONNECT_DEAUTH_FIRST
		bool "Enable Wlan Fast Connect Default First"
		default n
		help
			send deauth to AP before connect with AP.
			Recommend to enable if AP enables MFP. deauth frame is sent in encryted or
			unencrypt format to AP according to pmf value from fci.

	config WLAN_FAST_CONNECT_WPA3
		bool "Enable Wlan Fast Connect WPA3"
		default n
		help
			WPA3 fast connect support.
			After STA has connected with AP, fci will stores additional pmk, pmkid, and
			after reboot, supplicant will use open auth algo instread of sae. Recommends
			to enable WLAN_FAST_CONNECT_DEAUTH_FIRST.

	config FAST_CONNECT_INFO_ENC_METHOD
		int "Enable Fast Connect Info Enc Method"
		default 1
		help
			fci encryption method.
			1 for NULL, 2 for XOR, 3 for AES.

	config WPA_AUTH_TIMEOUT
		int "Enable WPA Auth Timeout"
		default 1 if MIDEA
		default 2 if !MIDEA
		help
			auth timeout for wpa/802.1x authentication

	config WIFI_ROAMING
		bool "Enable 802.11R Roaming"
		default n

	config BK_SUPPLICANT_OPTIMIZE_CONNECTION
		bool "Enable BK Connection Optimize"
		default n
	
	config AP_STATYPE_LIMIT
		bool "Enable Ap mode Sta Type Limit num"
		default n

endmenu
```

## os/board/bk7239n/src/libs/Kconfig
```kconfig
#TODO remove all kconfigs which are defined in armino libs

menu "Bk_libs"

	config MCU_PS
		bool "Enable Mcu Ps"
		default y
		help
			support mcu sleep

	config DEEP_PS
		bool "Enable Deep Ps"
		default y
		help
			support deep sleep

	config TICK_CALI
		bool "Enable Tick Cali"
		default y
		help
			support tick time calibration

	config STA_PS
		bool "Enable Sta Ps"
		default y if !RF_OTA_TEST
		default n if RF_OTA_TEST

endmenu
```

## os/board/bk7239n/src/middleware/arch/cm33/Kconfig
```kconfig
menu "Arch::Cm33"
	config ARCH_CM33
		bool "Enable Cortex-M33"
		default n
	
	menu "Modify Arch Cm33 Config"
		depends on ARCH_CM33

		config FPGA
			bool "Enable FPGA"
			default n

		config MPU
			bool "Enable Memory Protect Unit Feature"
			default n
	
		config CPU_FREQ_HZ
			int "Set Cpu Freq Hz"
			default 120000000
			help
				CPU frequency

		config ARCH_INT_STATIS
			bool "Enable Arch Int Statis"
			default n
			help
				Enable interrupt statis

		config SYSTICK_32K
			bool "Systick use external 32K clock"
			default n
			
		config CACHE_ENABLE
                	depends on MPU
			bool "Enable DCache"
			default n
			help
				Enable DCache

		config HEAP_IN_CACHE
			depends on CACHE_ENABLE
			bool "Enable Heap in Cache"
			default y
			help
				Custom enable heap in Cache

		config DUMP_ENABLE
			bool "Enable Dump Feature"
			default n
			help
				Dump all memory when exception happen

		config MEMDUMP_ALL
			bool "Enable Memdump All"
			default y
			help
				Dump all memory when exception happen

		config TFM_S_TO_NS_DUMP_ENABLE
			depends on TFM
			bool "Security to nosecurity dump"
			default y
			help
				Dump memory when Secure Fault
	endmenu
endmenu
```

## os/board/bk7239n/src/middleware/boards/bk7239n/vnd_cal/Kconfig
```kconfig
menu "VENDOR CAL CONFIG"
	config VND_CAL
		bool "Enable vendor cal"
		default n

	config BLE_USE_HIGH_POWER_LEVEL
		bool "Enable high power level"
		default n
endmenu
```
