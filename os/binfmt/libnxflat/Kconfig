## os/board/bk7239n/src/components/controlappc/Kconfig
```kconfig
menu "controlappc"
	config QUICK_TRACK
		bool "Enable wfa quicktrack"
		default n
	config QUICK_TRACK_UART_PORT
		int "quicktrack uart port"
		default 1
		help
			0: uart0, 1: uart1, etc.
endmenu
```

## os/board/nucleo-f446re/Kconfig
```kconfig
#
# For a description of the syntax of this configuration file,
# see kconfig-language at https://www.kernel.org/doc/Documentation/kbuild/kconfig-language.txt
#

if ARCH_BOARD_NUCLEO_F446RE

config NUCLEO_F446RE_USERLED
	bool "Nucleo F446RE User LED"
	default y
	---help---
		Enable support for the on-board User LED (LD2).

config NUCLEO_F446RE_USER_BUTTON
	bool "Nucleo F446RE User Button"
	default y
	---help---
		Enable support for the on-board User Button (B1).

endif
```

## os/drivers/Kconfig
```kconfig
#
# For a description of the syntax of this configuration file,
# see kconfig-language at https://www.kernel.org/doc/Documentation/kbuild/kconfig-language.txt
#

config SPECIFIC_DRIVERS
	bool "Board Specific drivers"
	default n

source "drivers/crypto/Kconfig"
source "drivers/loop/Kconfig"
source "drivers/i2c/Kconfig"
source "drivers/spi/Kconfig"
source "drivers/i2s/Kconfig"
source "drivers/timers/Kconfig"
source "drivers/analog/Kconfig"
source "drivers/audio/Kconfig"
source "drivers/video/Kconfig"
source "drivers/bch/Kconfig"
source "drivers/input/Kconfig"
source "drivers/ioexpander/Kconfig"
source "drivers/lcd/Kconfig"
source "drivers/misc/Kconfig"
source "drivers/mtd/Kconfig"
source "drivers/net/Kconfig"
source "drivers/note/Kconfig"
source "drivers/pipes/Kconfig"
source "drivers/power/Kconfig"
source "drivers/sensors/Kconfig"
source "drivers/serial/Kconfig"
source "drivers/usbdev/Kconfig"
source "drivers/usbhost/Kconfig"
source "drivers/usbmisc/Kconfig"
source "drivers/usbmonitor/Kconfig"
source "drivers/wireless/Kconfig"
source "drivers/syslog/Kconfig"
source "$BINDIR/drivers/platform/Kconfig"

#
# TizenRT drivers that NuttX does not have
#

config VIRTKEY
	bool "Enable virtual key driver"
	default n
	depends on NFILE_DESCRIPTORS != 0

if VIRTKEY
config VIRTKEY_QUEUE_LEN
	int "Virtual key event queue length"
	default 1024
	---help---
		Use this to specify length of event queue for virtual keyboard driver,
		Event generator will write to the queue and receiver will read from it.
endif

source "drivers/mipidsi/Kconfig"

source drivers/wifi_csi/Kconfig

source "drivers/memory/Kconfig"
source "drivers/prodconfig/Kconfig"

source drivers/os_api_test/Kconfig
source drivers/iotdev/Kconfig

source "drivers/bluetooth/Kconfig"

source "drivers/otp/Kconfig"

source drivers/seclink/Kconfig
```

## os/drivers/bluetooth/Kconfig
```kconfig
#
# For a description of the syntax of this configuration file,
# see kconfig-language at https://www.kernel.org/doc/Documentation/kbuild/kconfig-language.txt
#

menuconfig DRIVERS_BLUETOOTH
	bool "Bluetooth Device Support"
	default n
	---help---
		Drivers for various bluetooth devices.

if DRIVERS_BLUETOOTH
config DRIVERS_BR_EDR
	bool "Enable BR/EDR"
	---help---
		Enable Bluetooth Basic Rate/Enhanced Data Rate(BR/EDR)

config DRIVERS_BLE
	bool "Enable BLE"
	---help---
		Enable Bluetooth with low energy(BLE)

endif # DRIVERS_BLUETOOTH

if DRIVERS_BLE && DRIVERS_BR_EDR

choice
	prompt "Bluetooth Driver"
	default BLUETOOTH_NULL

config BLUETOOTH_NULL
	bool "NULL Bluetooth device"
	---help---
		A do-nothing Bluetooth device driver to permit some basic testing of
		the Bluetooth stack on the simulator.  This driver just "closes the
		loop" and nothing more:  It is a just a bit-bucket for outgoing
		packets; it generates no incoming packets.

endchoice # Bluetooth driver choice

endif


if DRIVERS_BLE && !DRIVERS_BR_EDR

choice
	prompt "BLE Driver"
	default VIRTUAL_BLE

config VIRTUAL_BLE
	bool "Virtual BLE Driver"

config RTK_BLE
	bool "Enable RTK BLE Module"

config BK_BLE
	bool "Enable Beken BLE Module"

endchoice # BLE driver choice

endif


if RTK_BLE

source drivers/bluetooth/realtek_ble/Kconfig

endif
if BLUETOOTH_NULL

source drivers/bluetooth/bt_null/Kconfig

endif
if VIRTUAL_BLE

source drivers/bluetooth/virtual_ble/Kconfig

endif
```

## os/drivers/mipidsi/Kconfig
```kconfig
#
# For a description of the syntax of this configuration file,
# see kconfig-language at https://www.kernel.org/doc/Documentation/kbuild/kconfig-language.txt
#


menuconfig MIPI_DSI
        bool "MIPI Driver Support"
        default n
        ---help---
                This selection enables selection of MIPI upper half driver.  This option
                should be enabled by all platforms that support MIPI interfaces.
                See include/tinyara/mipidsi/mipi_dsi.h for further MIPI driver information.

if MIPI_DSI

config MIPI_DSI_DRIVER
	bool "MIPI DSI Character Driver"
	default n

endif
```

## os/drivers/otp/Kconfig
```kconfig
#
# For a description of the syntax of this configuration file,
# see kconfig-language at https://www.kernel.org/doc/Documentation/kbuild/kconfig-language.txt
#

config OTP
	bool "OTP Driver Support"
	default n
	depends on NFILE_DESCRIPTORS != 0
	---help---
		This selection enables building of the "upper-half" OTP
		driver. See include/tinyara/otp.h for further OTP driver
		information.

if OTP
config OTP_NULL
	bool "OTP Null device"
	default n
	---help---
		Virtual OTP device
endif
```

## os/drivers/power/Kconfig
```kconfig
#
# For a description of the syntax of this configuration file,
# see kconfig-language at https://www.kernel.org/doc/Documentation/kbuild/kconfig-language.txt
#

menuconfig POWER
	bool "Power Management Support"
	default n
	---help---
		Enable building of power-related devices (battery monitors, chargers,
		etc).

if POWER

config BATTERY_CHARGER
	bool "Battery Charger support"
	default n

config BATTERY_GAUGE
	bool "Battery Fuel Gauge support"
	default n

endif # POWER
```

## os/drivers/sensors/Kconfig
```kconfig
#
# For a description of the syntax of this configuration file,
# see kconfig-language at https://www.kernel.org/doc/Documentation/kbuild/kconfig-language.txt
#

menuconfig SENSOR
	bool "Sensor Driver Support"
	default n
	---help---
		This selection enables building of the sensor driver.

if SENSOR

config SENSOR_PPD42NS
	bool "Shinyei PPD42NS Dust Sensor"
	default n
	select GPIO
	---help---
		Enable driver support for the Shinyei PPD42NS Dust Sensor

if SENSOR_PPD42NS
config SENSOR_PPD42NS_GPIO_NUM
	int "PPD42NS GPIO Pin Number"
	default 58
	---help---
		the pin number of GPIO that is connected to PPD42NS's Dust Signal Pin

config SENSOR_PPD42NS_DEBUG
	bool "PPD42NS driver debug message"
	default n
	---help---
		enable PPD42ns dust sensor driver's debug message

endif # SENSOR_PPD42NS

endif # SENSOR
```

## os/fs/event/Kconfig
```kconfig
#
# For a description of the syntax of this configuration file,
# see kconfig-language at https://www.kernel.org/doc/Documentation/kbuild/kconfig-language.txt
#

config FS_NAMED_EVENTS
	bool "Named event group support"
	default n
	depends on SCHED_EVENTS
	---help---
		Include support for named event group.

if FS_NAMED_EVENTS

config FS_NAMED_EVENTS_VFS_PATH
	string "Path to event group storage"
	default "/var/event"
	---help---
		The path to where named event group will exist in the VFS namespace.

endif # FS_NAMED_EVENTS
```

## os/fs/rpmsgfs/Kconfig
```kconfig
#
# For a description of the syntax of this configuration file,
# see kconfig-language at https://www.kernel.org/doc/Documentation/kbuild/kconfig-language.txt
#

config FS_RPMSGFS
	bool "RPMSG File System"
	default n
	depends on RPMSG
	---help---
		Use RPMSG file system to mount remote directories to local.
		This the method for user to use remote file like own core.

config FS_RPMSGFS_SERVER
	bool "RPMSG File Server"
	default n
	depends on RPMSG
	---help---
		Initialize RPMSG file system server automatically.
```

## os/fs/shm/Kconfig
```kconfig
#
# For a description of the syntax of this configuration file,
# see kconfig-language at https://www.kernel.org/doc/Documentation/kbuild/kconfig-language.txt
#

config FS_SHMFS
	bool "Shared memory support"
	default n
	select ARCH_VMA_MAPPING if BUILD_KERNEL
	---help---
		Include support for shm_open() and shm_close.

if FS_SHMFS

config FS_SHMFS_VFS_PATH
	string "Path to shared memory object storage"
	default "/var/shm"
	---help---
		The path to where shared memory objects will exist in the VFS
		namespace.

endif # FS_SHMFS
```

## os/libs/libc/gdbstub/Kconfig
```kconfig
#
# For a description of the syntax of this configuration file,
# see kconfig-language at https://www.kernel.org/doc/Documentation/kbuild/kconfig-language.txt
#

config LIB_GDBSTUB
	tristate "GDBSTUB"
	depends on ARCH_HAVE_TCBINFO
	---help---
		Enable support for gdbstub.

if LIB_GDBSTUB

config LIB_GDBSTUB_DEBUG
	bool "Gdbstub Debug Info"
	default n
	---help---
		Add debug info to gdbstub

config LIB_GDBSTUB_PKTSIZE
	int "Gdbstub packet size"
	default 32768
	---help---
		The size of the gdbstub packet buffer.

endif # LIB_GDBSTUB
```

## os/libs/libc/machine/arm/Kconfig
```kconfig
#
# For a description of the syntax of this configuration file,
# see kconfig-language at https://www.kernel.org/doc/Documentation/kbuild/kconfig-language.txt
#

if ARCH_ARM7TDMI || ARCH_ARM920T || ARCH_ARM926EJS || \
   ARCH_ARM1136J || ARCH_ARM1156T2 || ARCH_ARM1176JZ
endif

if ARCH_ARMV7A
source "libs/libc/machine/arm/armv7-a/Kconfig"
endif

if ARCH_ARMV7R
source "libs/libc/machine/arm/armv7-r/Kconfig"
endif

if ARCH_ARMV6M
endif

if ARCH_ARMV7M
source "libs/libc/machine/arm/armv7-m/Kconfig"
endif

if ARCH_ARMV8M
source "libs/libc/machine/arm/armv8-m/Kconfig"
endif

if ARCH_ARMV8R
endif

config LIBC_ARCH_CRC32
	bool "Enable optimized crc32 for ARM"
	default n
	depends on ARCH_HAVE_CRC32
	---help---
		Enable optimized arm neon specific crc32 library function
```

## os/libs/libc/pthread/Kconfig
```kconfig
#
# For a description of the syntax of this configuration file,
# see kconfig-language at https://www.kernel.org/doc/Documentation/kbuild/kconfig-language.txt
#

menu "pthread support"
	depends on !DISABLE_PTHREAD

config PTHREAD_SPINLOCKS
	bool "pthread spinlock support"
	default n
	depends on SPINLOCK && (BUILD_FLAT || BOARDCTL)
	select BOARDCTL_SPINLOCK
	---help---
		Enable support for pthread spinlocks.

config PTHREAD_ATFORK
	bool "pthread_atfork support"
	default n
	---help---
		Enable support for pthread_atfork.

endmenu # pthread support
```
