## os/board/Kconfig
```kconfig
#
# For a description of the syntax of this configuration file,
# see kconfig-language at https://www.kernel.org/doc/Documentation/kbuild/kconfig-language.txt
#

choice
	prompt "Select target board"
	default ARCH_BOARD_SIDK_S5JT200
	---help---
		Select the board hosting the architecture.  You must first select the
		exact MCU part number, then the boards supporting that part will
		be available for selection.  Use ARCH_BOARD_CUSTOM to create a new
		board configuration.

config ARCH_BOARD_ARTIK053
	bool "Samsung ARTIK-053 Starter Kit"
	depends on ARCH_CHIP_S5JT200
	select ARCH_BOARD_ARTIK05X_FAMILY
	select ARCH_BOARD_HAVE_FLASH
	---help---
		Samsung ARTIK-053 Starter Kit based on S5JT200 IoT WiFi MCU

config ARCH_BOARD_ARTIK053S
	bool "Samsung ARTIK-053S Starter Kit"
	depends on ARCH_CHIP_S5JT200
	select ARCH_BOARD_ARTIK05X_FAMILY
	select ARCH_BOARD_HAVE_FLASH
	---help---
		Samsung ARTIK-053S Starter Kit based on S5JT200 IoT WiFi MCU

config ARCH_BOARD_ARTIK055S
	bool "Samsung ARTIK-055S Starter Kit"
	depends on ARCH_CHIP_S5JT200
	select ARCH_BOARD_ARTIK05X_FAMILY
	select ARCH_BOARD_HAVE_FLASH
	---help---
		Samsung ARTIK-055S Starter Kit based on S5JT200 IoT WiFi MCU

config ARCH_BOARD_BK7239N
	bool "Beken BK7239N board"
	depends on ARCH_CHIP_BK7239N
	select ARCH_BOARD_HAVE_FLASH
	select ARCH_HAVE_RAM_KERNEL_TEXT
	---help---
		Beken BK7239N board based on the Beken BK7239N MCU.

config ARCH_BOARD_LM3S6965EK
	bool "Stellaris LM3S6965 Evaluation Kit"
	depends on ARCH_CHIP_LM3S6965
	select ARCH_HAVE_LEDS
	---help---
		Stellaris LM3S6965 Evaluation Kit.  This board is based on the
		an ARM Cortex-M3 MCU, the Luminary/TI LM3S6965.

config ARCH_BOARD_SIDK_S5JT200
	bool "Samsung S5JT200 sidk board"
	depends on ARCH_CHIP_S5JT200
	select ARCH_HAVE_BUTTONS
	select ARCH_HAVE_IRQBUTTONS
	select ARCH_BOARD_HAVE_FLASH
	---help---
		Samsung S5JT200 IoT wifi MCU

config ARCH_BOARD_CY4390x
	bool "Cypress 4390x board"
	depends on ARCH_CHIP_BCM4390X
	---help---
		Cypress 4390x IoT wifi MCU

config ARCH_BOARD_STM32F407_DISC1
	bool "STMicro STM32F407-Discovery board"
	depends on ARCH_CHIP_STM32
	select ARCH_HAVE_LEDS
	select ARCH_HAVE_BUTTONS
	select ARCH_HAVE_IRQBUTTONS
	---help---
		STMicro STM32F407-DISC1 board based on the STMicro STM32F407VG MCU.

config ARCH_BOARD_STM32F429I_DISCO
	bool "STMicro STM32F429I-Discovery board"
	depends on ARCH_CHIP_STM32
	select ARCH_HAVE_LEDS
	select ARCH_HAVE_BUTTONS
	select ARCH_HAVE_IRQBUTTONS
	---help---
		STMicro STM32F429I-Discovery board based on the STMicro STM32F429ZIT6 MCU.

config ARCH_BOARD_ESP32_DEVKITC
	bool "Espressif ESP32-DevKitC board"
	depends on ARCH_CHIP_ESP32
	select ARCH_BOARD_ESP32_FAMILY
	select ARCH_BOARD_HAVE_FLASH
	---help---
		Espressif esp32 WIFI/BLE MCU

config ARCH_BOARD_ESP_WROVER_KIT
	bool "Espressif ESP-WROVER-KIT board"
	depends on ARCH_CHIP_ESP32
	select ARCH_BOARD_ESP32_FAMILY
	select ARCH_BOARD_HAVE_FLASH
	---help---
		Espressif esp32 WIFI/BLE LCDs MCU
		
config ARCH_BOARD_IMXRT1020_EVK
	bool "NXP i.MX RT 1020 EVK"
	depends on ARCH_CHIP_FAMILY_IMXRT102x
	select ARCH_HAVE_LEDS
	select ARCH_HAVE_BUTTONS
	select ARCH_HAVE_IRQBUTTONS
	select AUTOGEN_MEMORY_LDSCRIPT if BUILD_PROTECTED
	select ARCH_BOARD_HAVE_FLASH
	---help---
		This is the board configuration for the port of TinyARA to the NXP i.MXRT
		evaluation kit, MIMXRT1020-EVKB.  This board features the MIMXRT1021CAF4A MCU.

config ARCH_BOARD_IMXRT1050_EVK
	bool "NXP i.MX RT 1050 EVK"
	depends on ARCH_CHIP_FAMILY_IMXRT105x
	select ARCH_HAVE_LEDS
	select ARCH_HAVE_BUTTONS
	select ARCH_HAVE_IRQBUTTONS
	select AUTOGEN_MEMORY_LDSCRIPT if BUILD_PROTECTED
	select ARCH_BOARD_HAVE_FLASH
	---help---
		This is the board configuration for the port of TinyARA to the NXP i.MXRT
		evaluation kit, MIMXRT1050-EVKB.  This board features the MIMXRT1052DVL6A MCU.

config ARCH_BOARD_STM32L4R9AI_DISCO
	bool "STMicro STM32L4R9AI-Discovery board"
	depends on ARCH_CHIP_STM32L4
	select ARCH_HAVE_LEDS
	select ARCH_HAVE_BUTTONS
	select ARCH_HAVE_IRQBUTTONS
	select ARCH_BOARD_HAVE_FLASH
	---help---
		STMicro STM32L4R9AI-Discovery board based on the STMicro STM32L4R9AI MCU.

config ARCH_BOARD_RTL8730E
	bool "Realtek RTL8730E-Discovery board"
	depends on ARCH_CHIP_RTL8730E
	select ARCH_HAVE_BUTTONS
	select ARCH_HAVE_IRQBUTTONS
	select ARCH_BOARD_HAVE_FLASH
	select ARCH_HAVE_RAM_KERNEL_TEXT
	---help---
		Realtek RTL8730E-Discovery board based on the Realtek RTL8730E MCU.

config ARCH_BOARD_RTL8721CSM
	bool "Realtek RTL8721CSM-Discovery board"
	depends on ARCH_CHIP_RTL8721CSM
	select ARCH_HAVE_BUTTONS
	select ARCH_HAVE_IRQBUTTONS
	select ARCH_BOARD_HAVE_FLASH
	select ARCH_HAVE_RAM_KERNEL_TEXT
	---help---
		Realtek RTL8721CSM-Discovery board based on the Realtek RTL8721CSM MCU.		

config ARCH_BOARD_STM32H745ZI_NUCLEO
	bool "STMicro STM32H745ZI-Nucleo board"
	depends on ARCH_CHIP_STM32H745
	select ARCH_HAVE_LEDS
	select ARCH_HAVE_BUTTONS
	select ARCH_HAVE_IRQBUTTONS
	select ARCH_BOARD_HAVE_FLASH
	---help---
		STMicro STM32H745ZI-Nucleo board based on the STMicro STM32H745ZI MCU.

config ARCH_BOARD_SABRE_6QUAD
 	bool "SABRE_6QUAD"
	depends on ARCH_CHIP_IMX6
	select ARCH_HAVE_BUTTONS
	select ARCH_BUTTONS
	select ARCH_HAVE_IRQBUTTONS
	select ARCH_HAVE_RAM_KERNEL_TEXT
 
config ARCH_BOARD_QEMU_ARMV7A
	bool "Qemu ARMv7a CPUs board"
	depends on ARCH_CHIP_QEMU_ARM
	select ARCH_HAVE_IRQBUTTONS
	---help---
		This options selects support for NuttX on the QEMU ARMv7a + virt
		board featuring the qemu ARMv7a CPUs.

config ARCH_BOARD_QEMU_ARMV7R
	bool "Qemu ARMv7r CPUs board"
	depends on ARCH_CHIP_QEMU_ARM
	select ARCH_HAVE_IRQBUTTONS
	---help---
		This selects support for NuttX on the QEMU ARMv7r + virt
		board featuring the qemu ARMv7r CPUs.

config ARCH_BOARD_MPS2_AN500
	bool "Arm MPS2 AN500"
	depends on ARCH_CHIP_MPS2_AN500
	select ARCH_HAVE_IRQBUTTONS
	---help---
		This options selects support for NuttX on the MPS2 AN500
		board featuring the Cortex-M7.

config ARCH_BOARD_MPS2_AN521
	bool "Arm MPS2 AN521"
	depends on ARCH_CHIP_MPS2_AN521
	select ARCH_HAVE_IRQBUTTONS
	---help---
		This options selects support for NuttX on the MPS2 AN521
		board featuring the Cortex-M33.

endchoice

config ARCH_BOARD_ARTIK05X_FAMILY
    bool
    default n

config ARCH_BOARD_ESP32_FAMILY
    bool
    default n

config ARCH_BOARD
	string
	default "artik05x"           if ARCH_BOARD_ARTIK05X_FAMILY
	default "lm3s6965-ek"        if ARCH_BOARD_LM3S6965EK
	default "sidk_s5jt200"       if ARCH_BOARD_SIDK_S5JT200
	default "bk7239n"            if ARCH_BOARD_BK7239N
	default "cy4390x"            if ARCH_BOARD_CY4390x
	default "stm32f407-disc1"    if ARCH_BOARD_STM32F407_DISC1
	default "stm32f429i-disco"   if ARCH_BOARD_STM32F429I_DISCO
	default "esp32_devkit"       if ARCH_BOARD_ESP32_FAMILY
	default "imxrt1020-evk"      if ARCH_BOARD_IMXRT1020_EVK
	default "imxrt1050-evk"      if ARCH_BOARD_IMXRT1050_EVK
	default "stm32l4r9ai-disco"  if ARCH_BOARD_STM32L4R9AI_DISCO
	default "rtl8730e"           if ARCH_BOARD_RTL8730E
	default "rtl8721csm"         if ARCH_BOARD_RTL8721CSM
	default "stm32h745zi-nucleo" if ARCH_BOARD_STM32H745ZI_NUCLEO
	default "sabre-6quad"	     if ARCH_BOARD_SABRE_6QUAD	
	default "qemu-armv7a"        if ARCH_BOARD_QEMU_ARMV7A
	default "qemu-armv7r"        if ARCH_BOARD_QEMU_ARMV7R
	default "mps2-an500"         if ARCH_BOARD_MPS2_AN500
	default "mps2-an521"         if ARCH_BOARD_MPS2_AN521

comment "Common Board Options"

config ARCH_HAVE_LEDS
	bool

config ARCH_LEDS
	bool "Board LED Status support"
	default y
	depends on ARCH_HAVE_LEDS
	---help---
		Use board LEDs to show NuttX execution status state. Unique to boards that have LEDs

if ARCH_LEDS
config ARCH_LEDS_CPU_ACTIVITY
	bool "Use LED for CPU activities"
	default n
	depends on ARCH_LEDS
	---help---
		Use board LEDs to show CPU activities
endif

config ARCH_HAVE_BUTTONS
	bool

config ARCH_BUTTONS
	bool "Board button support"
	default n
	depends on ARCH_HAVE_BUTTONS
	---help---
		"Support interfaces to use buttons provided by the board."

config ARCH_HAVE_IRQBUTTONS
	bool

config ARCH_IRQBUTTONS
	bool "Button interrupt support"
	default n
	depends on ARCH_BUTTONS && ARCH_HAVE_IRQBUTTONS
	---help---
		"Support interrupts on button presses and releases."

comment "Board-Common Options"

config ARCH_BOARD_COMMON
	bool "Board common logic"
	default n
	---help---
		Board common logic located in each board/common folder.

choice
	prompt "BOARD crashdump method"
	default BOARD_CRASHDUMP_NONE
	---help---
		If selected up_assert will call out to board_crashdump, in the case
		of an assertion failure, prior to calling exit. Or in the
		case of a hardfault prior to looping indefinitely. board_crashdump
		then has a chance to save the state of the machine.

		The purpose of board_crashdump is to save as much information as it can
		about the cause of the fault and then most likely reset the system.

		N.B. There is limited system resources that can be used, who knows
		what memory is trashed? So all we can expect to do is save the
		"machine state" in a place where on the next reset can write it
		to more sophisticated storage in a sane operating environment.

config BOARD_COREDUMP_SYSLOG
	bool "Enable Core dump to syslog"
	depends on COREDUMP
	---help---
		Enable put coredump to syslog when crash.

config BOARD_COREDUMP_BLKDEV
	bool "Enable Core Dump to block device"
	depends on COREDUMP
	---help---
		Enable save coredump to block device when crash.

config BOARD_COREDUMP_MTDDEV
	bool "Enable Core Dump to mtd device"
	depends on COREDUMP
	---help---
		Enable save coredump to mtd device when crash.

config BOARD_CRASHDUMP_CUSTOM
	bool "Enable Core Dump with custom method"
	---help---
		Enable save coredump with custom method. only work with
		board_crashdump api.

config BOARD_CRASHDUMP_NONE
	bool "No Board level crash dump"

endchoice # BOARD crashdump method

config BOARD_COREDUMP_DEVPATH
	string "Save Core Dump data with device PATH"
	depends on BOARD_COREDUMP_BLKDEV || BOARD_COREDUMP_MTDDEV
	---help---
		Save coredump file into block/mtd device path.

config BOARD_COREDUMP_FULL
	bool "Core Dump all thread registers and stacks"
	default y
	depends on !BOARD_CRASHDUMP_NONE
	---help---
		Enable to support for the dump all task registers and stacks.

config BOARD_COREDUMP_COMPRESSION
	bool "Enable Core Dump compression"
	default BOARD_COREDUMP_SYSLOG
	depends on LIBC_LZF && !BOARD_CRASHDUMP_NONE
	---help---
		Enable LZF compression algorithm for core dump content

config BOARD_COREDUMP_BASE64STREAM
	bool "Enable base64 encoding for output stream"
	default n
	depends on BOARD_COREDUMP_SYSLOG
	---help---
		Enable based64 encoded stream instead of default hexstream.

config BOARD_ENTROPY_POOL
	bool "Enable Board level storing of entropy pool structure"
	default n
	depends on CRYPTO_RANDOM_POOL
	---help---
		Entropy pool structure can be provided by board source.
		Use for this is, for example, to allocate entropy pool
		from special area of RAM which content is kept over
		system reset.

config BOARD_INITRNGSEED
	bool "Enable Board level initial seeding of entropy pool RNG"
	default n
	depends on CRYPTO_RANDOM_POOL
	---help---
		If enabled, entropy pool random number generator will call
		board_init_rndseed() upon initialization. This function
		can then provide early entropy seed to the pool through
		entropy injection APIs provided at 'nuttx/random.h'.

config BOARDCTL
	bool "Enable boardctl() interface"
	default n
	---help---
		Enables support for the boardctl() interface.  Architecture
		specific logic must provide board_app_initialize() interface.

if BOARDCTL

config BOARDCTL_FINALINIT
	bool "Enable board app final init"
	default n
	---help---
		Enables support for the BOARDIOC_FINALINIT boardctl() command.
		Architecture specific logic must provide board_app_finalinitialize()
		interface.

config BOARDCTL_POWEROFF
	bool "Enable power off interfaces"
	default n
	depends on ARCH_HAVE_POWEROFF
	---help---
		Enables support for the BOARDIOC_POWEROFF boardctl() command.
		Architecture specific logic must provide the board_power_off()
		interface.

config BOARDCTL_RESET
	bool "Enable reset interfaces"
	default n
	depends on ARCH_HAVE_RESET
	---help---
		Enables support for the BOARDIOC_RESET boardctl() command.
		Architecture specific logic must provide the board_reset()
		interface.

config BOARD_RESET_ON_ASSERT
	int "Enable Board Reset after assert"
	default 0
	depends on BOARDCTL_RESET
	---help---
		== 0 up_assert never reset the machine
		>= 1 up_assert from interrupt handler or kernel thread will reset
		     the machine
		>= 2 up_assert from user or kernel thread will reset the machine.
		     The default behavior just kill the asserting thread.

config BOARD_ASSERT_RESET_VALUE
	int "Board reset argument"
	default 1
	depends on BOARDCTL_RESET
	---help---
		Parameter that will be passed to board_reset() by when an
		assertion occurs.  This may be used by board_reset()
		implementations to handle the reset differently for the
		case of a crash.

config BOARDCTL_RESET_CAUSE
	bool "Return reset cause"
	default n
	depends on ARCH_HAVE_RESET
	---help---
		Enables support for the BOARDIOC_RESET_CAUSE boardctl() command.
		Architecture specific logic must provide the board_reset_cause()
		interface.

config BOARDCTL_UNIQUEID
	bool "Return board unique ID"
	default n
	---help---
		Enables support for the BOARDIOC_UNIQUEID boardctl() command.
		Architecture specific logic must provide the board_uniqueid()
		interface.

config BOARDCTL_UNIQUEID_SIZE
	int "Size of the board unique ID (bytes)"
	default 16
	depends on BOARDCTL_UNIQUEID
	---help---
		Provides the size of the memory buffer that must be provided by the
		caller of board_uniqueid() in which to receive the board unique ID.

config BOARDCTL_UNIQUEKEY
	bool "Return board unique KEY"
	default n
	---help---
		Enables support for the BOARDIOC_UNIQUEKEY boardctl() command.
		Architecture specific logic must provide the board_uniquekey()
		interface.

config BOARDCTL_UNIQUEKEY_SIZE
	int "Size of the board unique KEY (bytes)"
	default 16
	depends on BOARDCTL_UNIQUEKEY
	---help---
		Provides the size of the memory buffer that must be provided by the
		caller of board_uniquekey() in which to receive the board unique KEY.

config BOARDCTL_SWITCH_BOOT
	bool "Enable switch boot system support"
	default n
	---help---
		BOARDIOC_SWITCH_BOOT is required to communicate the boot partition
		from userspace (OTA subsystem) to board for A/B boot or single boot
		case. It can be used to change the system boot behavior. For instance,
		once a firmware updated successfully, this boardctl can be used to
		modify FLASH bank selection.

config BOARDCTL_BOOT_IMAGE
	bool "Boot a new application firmware image"
	default n
	---help---
		Boot a new application firmware image.
		Architecture-specific logic must provide the board_boot_image()
		interface for executing the required actions for booting a new
		application firmware image (e.g. deinitialize peripherals, load the
		Program Counter register with the application firmware image entry
		point address).

config BOARDCTL_MKRD
	bool "Enable application space creation of RAM disks"
	default n
	select DRVR_MKRD
	depends on !DISABLE_MOUNTPOINT
	---help---
		Enables support for the BOARDIOC_MKRD boardctl() command.

config BOARDCTL_ROMDISK
	bool "Enable application space creation of ROM disks"
	default n
	depends on !DISABLE_MOUNTPOINT
	---help---
		Enables support for the BOARDIOC_MKRD boardctl() command.

config BOARDCTL_APP_SYMTAB
	bool "Enable application symbol table interfaces"
	default n
	depends on LIBC_EXECFUNCS
	---help---
		Enables support for the BOARDIOC_APP_SYMTAB boardctl() command.

config BOARDCTL_OS_SYMTAB
	bool "Enable kernel module symbol table interfaces"
	default n
	depends on MODULE
	---help---
		Enables support for the BOARDIOC_OS_SYMTAB boardctl() command.

config BOARDCTL_USBDEVCTRL
	bool "Enable USB device controls"
	default n
	depends on USBDEV
	---help---
		Enables support for the BOARDIOC_USBDEV_CONTROL boardctl() command.

config BOARDCTL_SPINLOCK
	bool "spinlock specific operation"
	default n
	---help---
		Enables support for the BOARDIOC_SPINLOCK boardctl() command.

config BOARDCTL_IRQ_AFFINITY
	bool "Set an IRQ affinity to CPUs by software"
	default n
	depends on SMP
	---help---
		Enables support for Set an IRQ affinity to CPUs by software.

config BOARDCTL_START_CPU
	bool "Start slave cpu"
	default n
	---help---
		Enables support for the BOARDIOC_START_CPU boardctl() command.
		Architecture specific logic must provide the board_start_cpu()
		interface.

config BOARDCTL_MACADDR
	bool "Get network MAC address"
	default n
	---help---
		Enables support for the BOARDIOC_MACADDR boardctl() command.
		Architecture specific logic must provide the board_macaddr()
		interface.

config BOARDCTL_IOCTL
	bool "Board-specific boardctl() commands"
	default n
	---help---
		Enables support for board-specific boardctl() commands.
		Architecture specific logic must provide board_ioctl() interface.

endif # BOARDCTL

config BOARD_USBDEV_SERIALSTR
	bool "Board-specific usbdev serial string"
	default n
	---help---
		Use board unique serial number to iSerialNumber in the device descriptor.

config BOARD_USBDEV_PIDVID
	bool "Board-specific usbdev pid/vid"
	default n
	---help---
		Use board unique pid/vid.

config BOARD_MEMORY_RANGE
	string "Board memory range"
	default ""
	---help---
		Memory range of board. format: <start>,<end>,<flags>,....
		start: start address of memory range
		end: end address of memory range
		flags: Executable 0x1, Writable 0x2, Readable 0x4
		example:{0x1000,0x2000,0x4},{0x2000,0x3000,0x6},{0x3000,0x4000,0x7} ... {0x0,0x0,0x0}


#
# TizenRT board options that NuttX does not have
#

config ARCH_HAVE_RAM_KERNEL_TEXT
	bool
	default n
	---help---
		To support kernel text checks for RAM regions for supported boards.

config BOARD_CRASHDUMP
	bool "Enable Board level logging of crash dumps"
	default n
	---help---
		If selected up_asseert will call out to board_crashdump, in the case
		of an assertion failure, prior to calling exit. Or in the
		case of a hardfault prior to looping indefinitely. board_crashdump
		then has a chance to save the state of the machine.

		The purpose of board_crashdump is to save as much information as it can
		about the cause of the fault and then most likely reset the system.

		N.B. There is limited system resources that can be used, who knows
		what memory is trashed? So all we can expect to do is save the
		"machine state" in a place where on the next reset can write it
		to more sophisticated storage in a sane operating environment.

config BOARD_ASSERT_AUTORESET
	bool "Reset a board on assert status automatically"
	default n
	depends on BOARDCTL_RESET
	---help---
		Some cases do not need to stay assert status. This supports
		board reset. When fault manager is enabled this will reset the
		system only when fault is in kernel context.

config BOARD_ASSERT_SYSTEM_HALT
	bool "Enable Infinite loop feature on fault status"
	default y
	depends on !BOARD_ASSERT_AUTORESET
	---help---
		When this is enabled irrespective of any fault, system will
		go in infinite loop. This can help to debug the system using Trace32.
		When this is disabled, a system will be blocked only if an assert in interrupt handler or idle thread happens.
		In the other case, a faulty task is terminated only and it can bring unexpected situation.

config LIB_BOARDCTL
	bool
	default BOARDCTL
	---help---
		TizenRT name of BOARDCTL, kept for the TizenRT code.

if LIB_BOARDCTL
config BOARDCTL_BOARD_HEADER
	bool
	default n
	---help---
		If selected, it will include a header with board specification values.

endif # LIB_BOARDCTL
if BOARD_CRASHDUMP
config BOARD_COREDUMP_FLASH
	bool "Enable crashlog dump to flash"
	default n
	---help---
		If selected it will dump the assert log information to flash.

config BOARD_RAMDUMP_FLASH
	bool "Enable ramdump to flash"
	default n
	---help---
		If selected it will dump the RAM contents to flash.

config BOARD_DUMP_UART
	bool "Enable dumping of RAM and FS contents via UART"
	default n
	---help---
		If selected it will allow sending RAM and FS dump via UART.
endif

comment "Board-Specific Options"

if ARCH_BOARD_ARTIK05X_FAMILY
source board/artik05x/Kconfig
endif
if ARCH_BOARD_BK7239N
source board/bk7239n/Kconfig
endif
if ARCH_BOARD_LM3S6965EK
source board/lm3s6965-ek/Kconfig
endif
if ARCH_BOARD_SIDK_S5JT200
source board/sidk_s5jt200/Kconfig
endif
if ARCH_BOARD_STM32F429I_DISCO
source board/stm32f429i-disco/Kconfig
endif
if ARCH_BOARD_ESP32_FAMILY
source board/esp32_devkit/Kconfig
endif
if ARCH_BOARD_IMXRT1020_EVK
source board/imxrt1020-evk/Kconfig
endif
if ARCH_BOARD_IMXRT1050_EVK
source board/imxrt1050-evk/Kconfig
endif
if ARCH_BOARD_STM32L4R9AI_DISCO
source board/stm32l4r9ai-disco/Kconfig
endif
if ARCH_BOARD_RTL8730E
source board/rtl8730e/Kconfig
endif
if ARCH_BOARD_RTL8721CSM
source board/rtl8721csm/Kconfig
endif
if ARCH_BOARD_STM32H745ZI_NUCLEO
source board/stm32h745zi-nucleo/Kconfig
endif
if ARCH_BOARD_QEMU_ARMV7A
source board/qemu-armv7a/Kconfig
endif
if ARCH_BOARD_QEMU_ARMV7R
source board/qemu-armv7r/Kconfig
endif
if ARCH_BOARD_MPS2_AN500
source board/mps2-an500/Kconfig
endif
if ARCH_BOARD_MPS2_AN521
source board/mps2-an521/Kconfig
endif

source board/common/Kconfig
```
