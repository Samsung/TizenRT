/*
 * Copyright (c) 2017-2022 Arm Limited. All rights reserved.
 *
 * Licensed under the Apache License, Version 2.0 (the "License");
 * you may not use this file except in compliance with the License.
 * You may obtain a copy of the License at
 *
 *     http://www.apache.org/licenses/LICENSE-2.0
 *
 * Unless required by applicable law or agreed to in writing, software
 * distributed under the License is distributed on an "AS IS" BASIS,
 * WITHOUT WARRANTIES OR CONDITIONS OF ANY KIND, either express or implied.
 * See the License for the specific language governing permissions and
 * limitations under the License.
 */

/***********  WARNING: This is an auto-generated file. Do not edit!  ***********/

/*
 * Customized region name prefix abbreviation:
 *  LR : A Load region.
 *  ER : A typical execution region.
 *  PT : An empty execution region used as position-tag/address-alignment.
 *
 * No applying customzied prefixes on linker/system reserved/intentional
 * names, such as 'ARM_LIB_STACK'.
 */

#include "region_defs.h"

LR_CODE S_CODE_START S_CODE_SIZE {
    PT_RO_START +0 ALIGN 32 EMPTY 0x0 {
        /* Position tag: code + RO-data */
    }

    /**** This initial section contains mainly the SPM code and RO-data */
    ER_VECTORS +0 ALIGN 32 S_CODE_VECTOR_TABLE_SIZE {
        *.o (RESET +First)
    }
#ifndef TFM_MULTI_CORE_TOPOLOGY
    ER_VECTORS_FILL +0 EMPTY (S_CODE_VECTOR_TABLE_SIZE - ImageLength(ER_VECTORS)) {
    }

    /*
     * Place the CMSE Veneers (containing the SG instruction) in a separate
     * 32 bytes aligned region so that the SAU can be programmed to
     * just set this region as Non-Secure Callable.
     */
    ER_VENEER +0 FIXED ALIGN 32 {
        *(Veneer$$CMSE)
    }
    /*
     * The Limit of the VENEER_ALIGN region should be 32 bytes aligned  so that
     * the SAU can set this region as Non-Secure Callable.
     */
    VENEER_ALIGN +0 ALIGN 32 EMPTY 0x0 {
    }
#endif

    ER_TFM_CODE +0 {
        *startup*(.text*)
        *libplatform_s* (+RO)
        *libtfm_spm* (+RO)
    }

    /**** Section for holding partition RO load data */
    TFM_SP_LOAD_LIST +0 ALIGN 4 {
        *(.part_load)
    }

    /**** PSA RoT CODE + RO-data starts here */
    ER_TFM_SP_ITS_RO +0 ALIGN 32 {
        *tfm_*partition_its.* (+RO-CODE, +RO-DATA)
        *(TFM_SP_ITS_PSA-ROT_ATTR_FN)
    }

    ER_TFM_SP_CRYPTO_RO +0 ALIGN 32 {
        *tfm_*partition_crypto.* (+RO-CODE, +RO-DATA)
        *(TFM_SP_CRYPTO_PSA-ROT_ATTR_FN)
    }

    ER_TFM_SP_PLATFORM_RO +0 ALIGN 32 {
        *tfm_*partition_platform.* (+RO-CODE, +RO-DATA)
        *(TFM_SP_PLATFORM_PSA-ROT_ATTR_FN)
    }

    ER_TFM_SP_INITIAL_ATTESTATION_RO +0 ALIGN 32 {
        *tfm_*partition_attestation.* (+RO-CODE, +RO-DATA)
        *(TFM_SP_INITIAL_ATTESTATION_PSA-ROT_ATTR_FN)
    }

    ER_TFM_SP_FWU_RO +0 ALIGN 32 {
        *tfm_*partition_fwu* (+RO-CODE, +RO-DATA)
        *(TFM_SP_FWU_PSA-ROT_ATTR_FN)
    }

    ER_TFM_SP_SYSTEM_CLOCK_RO +0 ALIGN 32 {
        *tfm_*partition_system_clock* (+RO-CODE, +RO-DATA)
        *(TFM_SP_SYSTEM_CLOCK_PSA-ROT_ATTR_FN)
    }

    /**** PSA RoT CODE + RO-data ends here */

    /**** APPLICATION RoT CODE + RO-data starts here */
    ER_TFM_SP_PS_RO +0 ALIGN 32 {
        *tfm_*partition_ps.* (+RO-CODE, +RO-DATA)
        *(TFM_SP_PS_APP-ROT_ATTR_FN)
    }

    /**** APPLICATION RoT CODE + RO-data ends here */

    /**** Unprivileged Secure code + RO-data starts here */
    TFM_UNPRIV_CODE +0 ALIGN 32 {
        *(SFN)
        * (+RO)
    }

    PT_RO_END +0 ALIGN 32 EMPTY 0x0 {
        /* Position tag */
    }

    /**** Base address of secure data area */
    PT_SECURE_DATA_START S_DATA_START EMPTY 0x0 {
        /* Position tag */
    }

    PT_PRIV_RWZI_START +0 ALIGN 32 EMPTY 0x0 {
        /* Position tag */
    }

    /* Shared area between BL2 and runtime to exchange data */
    TFM_SHARED_DATA +0 ALIGN 32 OVERLAY EMPTY BOOT_TFM_SHARED_DATA_SIZE {
    }

    /* MSP */
    ARM_LIB_STACK +0 ALIGN 32 OVERLAY EMPTY S_MSP_STACK_SIZE {
    }

    ARM_LIB_HEAP +0 ALIGN 8 EMPTY S_HEAP_SIZE {
    }

    ER_TFM_DATA +0 {
        * (+RW +ZI)
    }

    ER_PART_RT_POOL +0 ALIGN 4 {
        *(.bss.part_runtime)
    }

    ER_SERV_RT_POOL +0 ALIGN 4 {
        *(.bss.serv_runtime)
    }

    /**** PSA RoT RWZI starts here */

    PT_TFM_SP_ITS_PRIVATE_DATA_START +0 ALIGN 32 {
        /* Position tag */
    }

    ER_TFM_SP_ITS_RWZI +0 ALIGN 32 {
        *tfm_*partition_its.* (+RW +ZI)
        *(TFM_SP_ITS_PSA-ROT_ATTR_RW)
        *(TFM_SP_ITS_PSA-ROT_ATTR_ZI)
    }

    PT_TFM_SP_ITS_PRIVATE_DATA_END +0 ALIGN 32 {
        /* Position tag */
    }


    PT_TFM_SP_CRYPTO_PRIVATE_DATA_START +0 ALIGN 32 {
        /* Position tag */
    }

    ER_TFM_SP_CRYPTO_RWZI +0 ALIGN 32 {
        *tfm_*partition_crypto.* (+RW +ZI)
        *(TFM_SP_CRYPTO_PSA-ROT_ATTR_RW)
        *(TFM_SP_CRYPTO_PSA-ROT_ATTR_ZI)
    }

    PT_TFM_SP_CRYPTO_PRIVATE_DATA_END +0 ALIGN 32 {
        /* Position tag */
    }


    PT_TFM_SP_PLATFORM_PRIVATE_DATA_START +0 ALIGN 32 {
        /* Position tag */
    }

    ER_TFM_SP_PLATFORM_RWZI +0 ALIGN 32 {
        *tfm_*partition_platform.* (+RW +ZI)
        *(TFM_SP_PLATFORM_PSA-ROT_ATTR_RW)
        *(TFM_SP_PLATFORM_PSA-ROT_ATTR_ZI)
    }

    PT_TFM_SP_PLATFORM_PRIVATE_DATA_END +0 ALIGN 32 {
        /* Position tag */
    }


    PT_TFM_SP_INITIAL_ATTESTATION_PRIVATE_DATA_START +0 ALIGN 32 {
        /* Position tag */
    }

    ER_TFM_SP_INITIAL_ATTESTATION_RWZI +0 ALIGN 32 {
        *tfm_*partition_attestation.* (+RW +ZI)
        *(TFM_SP_INITIAL_ATTESTATION_PSA-ROT_ATTR_RW)
        *(TFM_SP_INITIAL_ATTESTATION_PSA-ROT_ATTR_ZI)
    }

    PT_TFM_SP_INITIAL_ATTESTATION_PRIVATE_DATA_END +0 ALIGN 32 {
        /* Position tag */
    }


    PT_TFM_SP_FWU_PRIVATE_DATA_START +0 ALIGN 32 {
        /* Position tag */
    }

    ER_TFM_SP_FWU_RWZI +0 ALIGN 32 {
        *tfm_*partition_fwu* (+RW +ZI)
        *(TFM_SP_FWU_PSA-ROT_ATTR_RW)
        *(TFM_SP_FWU_PSA-ROT_ATTR_ZI)
    }

    PT_TFM_SP_FWU_PRIVATE_DATA_END +0 ALIGN 32 {
        /* Position tag */
    }


    PT_TFM_SP_SYSTEM_CLOCK_PRIVATE_DATA_START +0 ALIGN 32 {
        /* Position tag */
    }

    ER_TFM_SP_SYSTEM_CLOCK_RWZI +0 ALIGN 32 {
        *tfm_*partition_system_clock* (+RW +ZI)
        *(TFM_SP_SYSTEM_CLOCK_PSA-ROT_ATTR_RW)
        *(TFM_SP_SYSTEM_CLOCK_PSA-ROT_ATTR_ZI)
    }

    PT_TFM_SP_SYSTEM_CLOCK_PRIVATE_DATA_END +0 ALIGN 32 {
        /* Position tag */
    }


    /**** PSA RoT RWZI ends here */
    PT_PRIV_RWZI_END +0 ALIGN 32 EMPTY 0x0 {
        /* Position tag */
    }


    PT_TFM_SP_PS_PRIVATE_DATA_START +0 ALIGN 32 {
        /* Position tag */
    }

    ER_TFM_SP_PS_RWZI +0 ALIGN 32 {
        *tfm_*partition_ps.* (+RW +ZI)
        *(TFM_SP_PS_APP-ROT_ATTR_RW)
        *(TFM_SP_PS_APP-ROT_ATTR_ZI)
    }

    PT_TFM_SP_PS_PRIVATE_DATA_END +0 ALIGN 32 {
        /* Position tag */
    }


#if defined(CONFIG_TFM_PARTITION_META)
    TFM_SP_META_PTR +0 ALIGN 32 {
        *(.bss.SP_META_PTR_SPRTL_INST)
    }
#endif

    PT_SRAM_WATERMARK +0 EMPTY 0x0 {
        /* Position tag */
    }

    /* Make sure that the sections allocated in the SRAM does not exceed the
     * size of the SRAM available.
     */
    ScatterAssert(ImageLimit(PT_SRAM_WATERMARK) <= S_DATA_START + S_DATA_SIZE)

#if defined(S_CODE_SRAM_ALIAS_BASE)
    /* eFlash driver code that gets copied from Flash to SRAM */
    ER_EFLASH_DRIVER_RO S_CODE_SRAM_ALIAS_BASE ALIGN 32 {
        Driver_GFC100_EFlash.o (+RO-CODE, +RO-DATA)
        gfc100_eflash_drv.o (+RO-CODE, +RO-DATA)
        musca_b1_eflash_drv.o (+RO-CODE, +RO-DATA)
    }
#endif
}

LR_NS_PARTITION NS_PARTITION_START {
    /* Reserved place for NS application.
     * No code will be placed here, just address of this region is used in the
     * secure code to configure certain HW components. This generates an empty
     * execution region description warning during linking.
     */
    ER_NS_PARTITION NS_PARTITION_START UNINIT NS_PARTITION_SIZE {
    }
}

#ifdef BL2
LR_SECONDARY_PARTITION SECONDARY_PARTITION_START {
    /* Reserved place for new image in case of firmware upgrade.
     * No code will be placed here, just address of this region is used in the
     * secure code to configure certain HW components. This generates an empty
     * execution region description warning during linking.
     */
    ER_SECONDARY_PARTITION SECONDARY_PARTITION_START \
        UNINIT SECONDARY_PARTITION_SIZE {
    }
}
#endif /* BL2 */
