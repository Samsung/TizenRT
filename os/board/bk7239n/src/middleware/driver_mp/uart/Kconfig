## os/drivers/audio/Kconfig
```kconfig
#
# For a description of the syntax of this configuration file,
# see kconfig-language at https://www.kernel.org/doc/Documentation/kbuild/kconfig-language.txt

config AUDIO_MAX_INPUT_CARD_NUM
	int "Max # of Input Audio Card"
	default 2

config AUDIO_MAX_OUTPUT_CARD_NUM
	int "Max # of Output Audio Card"
	default 2

config AUDIO_MAX_DEVICE_NUM
	int "Max # of device of each card"
	default 3
	
config AUDIO_PROCESSING_FEATURES
	bool "Audio Specific Processing features on dsp"
	default n
	---help---
		Enable control processing on dsp.
		Some devices process Keyword Detect, EPD, buffering, Dolby, etc on device level.
		Send event message to user layer regarding this kind of process.
		
if AUDIO_PROCESSING_FEATURES
menu "Audio Processing Features"

config AUDIO_SPEECH_DETECT_FEATURES
	bool "Speech Detect Features"
	default n
	---help---
		Speech Detect Features including End Point Detect(EPD), Keyword Detect(KD) for
		wake up recognition.

if AUDIO_SPEECH_DETECT_FEATURES	

config AUDIO_KEYWORD_DETECT
	bool "Provides keyword detect"
	default n
	---help---
		Keyword detect may be supported by some audio devices, but not the typical
		device doesn't have this in dsp chip.

config AUDIO_ENDPOINT_DETECT
	bool "Provides endpoint detect"
	default n
	---help---
		End Point detect may be supported by some audio devices, but not the typical
		device doesn't have this in dsp chip.		

endif
endmenu
endif

config AUDIO_I2SCHAR
	bool "I2S character driver (for testing only)"
	default n
	depends on I2S && AUDIO
	---help---
		This selection enables a simple character driver that supports I2S
		transfers via a read() and write().  The intent of this driver is to
		support I2S testing.  It is not an audio driver but does conform to
		some of the buffer management heuristics of an audio driver.  It is
		not suitable for use in any real driver application in its current
		form.

if AUDIO_I2SCHAR

config AUDIO_I2SCHAR_RXTIMEOUT
	int "RX timeout"
	default 0
	---help---
		This is a fixed timeout value that will be used for all receiver
		transfers.  This is in units of system clock ticks (configurable).
		The special value of zero disables RX timeouts.  Default: 0

config AUDIO_I2SCHAR_TXTIMEOUT
	int "TX timeout"
	default 0
	---help---
		This is a fixed timeout value that will be used for all transmitter
		transfers.  This is in units of system clock ticks (configurable).
		The special value of zero disables RX timeouts.  Default: 0

endif # AUDIO_I2SCHAR

config AUDIO_ALC5658
	bool "ALC5658 audio chip"
	depends on AUDIO
	---help---
		Select to enable support for the ALC5658 Audio codec by Realtek
		NOTE: This driver also depends on both I2C and I2S support although
		that dependency is not explicit here.

if AUDIO_ALC5658

config ALC5658_I2S_TIMEOUT
	int "Timeout values for I2S send & receive"
	default 100
	
config ALC5658_INITVOLUME
	int "ALC5658 initial volume setting"
	default 250

config ALC5658_INFLIGHT
	int "ALC5658 maximum in-flight audio buffers"
	default 2

config ALC5658_BUFFER_SIZE
	int "ALC5658 preferred buffer size"
	default 2048

config ALC5658_NUM_BUFFERS
	int "ALC5658 preferred number of buffers"
	default 4

config ALC5658_REGDUMP
	bool "ALC5658 register dump"
	default n
	---help---
		Enable logic to dump the contents of all ALC5658 registers.

config ALC5658_CLKDEBUG
	bool "ALC5658 clock analysis"
	default n
	---help---
		Enable logic to analyze ALC5658 clock configuation.

endif # AUDIO_ALC5658

config AUDIO_NULL
	bool "NULL audio device"
	default n
	depends on AUDIO
	---help---
		A do-nothing audio device driver to simplify testing of audio
		decoders.
if AUDIO_NULL

config AUDIO_NULL_MSG_PRIO
	int "Null audio device message priority"
	default 1

config AUDIO_NULL_BUFFER_SIZE
	int "Null audio device preferred buffer size"
	default 8192

config AUDIO_NULL_NUM_BUFFERS
	int "Null audio device preferred number of buffers"
	default 4

config AUDIO_NULL_WORKER_STACKSIZE
	int "Null audio device worker thread stack size"
	default 768

endif # AUDIO_NULL

config AUDIO_CX20921
	bool "CX20921 ADC audio chip"
	default n
	depends on AUDIO
	---help---
		Select to enable support for the CX20921 ADC Audio codec by conexant
		NOTE: This driver also depends on both I2C and I2S support although
		that dependency is not explicit here.

config CX20921_I2S_TIMEOUT
	int "Timeout value of CX20921 I2S Response (in ms)"
	default 100
	depends on AUDIO_CX20921
	---help---
		Set timeout of CX20921 I2S response in millisecond

config AUDIO_ALC1019
        bool "ALC1019 DAC audio chip"
        default n
        depends on AUDIO && I2S && I2C && SCHED_WORKQUEUE
        ---help---
                Select to enable support for the ALC1019 DAC Audio codec
                NOTE: This driver also depends on both I2C and I2S support although
                that dependency is not explicit here.

config AUDIO_TAS5749
	bool "TAS5749 DAC audio chip"
	default n
	depends on AUDIO
	---help---
		Select to enable support for the TAS5749 DAC Audio codec by TI
		NOTE: This driver also depends on both I2C and I2S support although
		that dependency is not explicit here.

config TAS5749_I2S_TIMEOUT
	int "Timeout value of TAS5749 I2S Response (in ms)"
	default 100
	depends on AUDIO_TAS5749
	---help---
		Set timeout of TAS5749 I2S response in millisecond

config TAS5749_BUFFER_SIZE
	int "buffer size on TAS5749"
	default 4096
	depends on AUDIO_TAS5749
	---help---
		Set buffer size of TAS5749

config TAS5749_NUM_BUFFERS
	int "number of buffer on TAS5749"
	default 4
	depends on AUDIO_TAS5749
	---help---
		Set buffers number of TAS5749
```

## os/drivers/bluetooth/realtek_ble/Kconfig
```kconfig
#
# For a description of the syntax of this configuration file,
# see kconfig-language at https://www.kernel.org/doc/Documentation/kbuild/kconfig-language.txt
#

config BLE_CENTRAL_CONN_NUM
	int "BLE Central Connection"
	default 3
	---help---
		Set the Maximum number of BLE Central Connection

config BLE_PERIPHERAL_CONN_NUM
	int "BLE Peripheral Connection"
	default 1
	---help---
		Set the Maximum number of BLE Peripheral Connection

config BLE_MAX_BONDED_DEVICE
	int "BLE Max Bonded Device"
	default 5
	---help---
		Set the Maximum number of BLE Bond Data

config BLE_SCAN_MAX_WHITELIST
	int "BLE Max White List"
	default 10
	---help---
		Set the Maximum number of BLE White List

config BLE_SCAN_MAX_TIMEOUT
	int "BLE Scan Timeout in sec"
	default 300
	---help---
		Set the timeout of BLE Scan in seconds
```
