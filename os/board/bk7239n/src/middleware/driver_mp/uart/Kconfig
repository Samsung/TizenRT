## os/board/esp32_devkit/Kconfig
```kconfig
#
# For a description of the syntax of this configuration file,
# see kconfig-language at https://www.kernel.org/doc/Documentation/kbuild/kconfig-language.txt
#

config ESP32_DEVKIT_TYPE
	string 
	default "esp32_DevKitC"  if ARCH_BOARD_ESP32_DEVKITC
	default "esp_wrover_kit" if ARCH_BOARD_ESP_WROVER_KIT

choice
	prompt "On-board Crystal Frequency"
	default ESP32CORE_XTAL_40MHZ

config ESP32CORE_XTAL_40MHZ
	bool "40MHz"

config ESP32CORE_XTAL_26MHZ
	bool "26MHz"

endchoice # On-board Crystal Frequency

config ESP32CORE_RUN_IRAM
	bool "Run from IRAM"
	default n
	---help---
		The default configuration is set up run from IRAM.  However, the
		current (2016-11-14) OpenOCD for ESP32 does not support writing to
		FLASH.  This option sets up the linker scripts to support execution
		from IRAM.  In this case, OpenOCD can be used to load directly into
		IRAM.

		At this stage the nuttx image is small enough to be entirely memory-
		resident.  Once board support is more mature you can add flash cache
		mapping code to run from SPI flash after initial boot. There are at
		least two possible approaches you could take: You can add the flash
		cache mapping code into nuttx directly, so it is self-contained -
		early nuttx initialisation runs from IRAM and enables flash cache,
		and then off you go. Or you can use the esp-idf software bootloader
		and partition table scheme and have nuttx be an esp-idf "app" which
		allows interoperability with the esp-idf system but makes you
		reliant on the esp-idf design for these parts. Both are possible.

choice
	prompt "Default serial port"
	default DEV_TTY_USB0 if ARCH_BOARD_ESP32_DEVKITC
	default DEV_TTY_USB1 if ARCH_BOARD_ESP_WROVER_KIT

config DEV_TTY_USB0
	bool "/dev/ttyUSB0"

config DEV_TTY_USB1
	bool "/dev/ttyUSB1"

endchoice #Default serial port

config ESPTOOLPY_PORT
	string
	default "/dev/ttyUSB0" if DEV_TTY_USB0
	default "/dev/ttyUSB1" if DEV_TTY_USB1
	---help---
	The serial port that's connected to the ESP chip.

choice
	prompt "Default baud rate"
	default ESPTOOLPY_BAUD_115200B
	---help---
		Default baud rate to use while communicating with the ESP chip.

config ESPTOOLPY_BAUD_115200B
	bool "115200 baud"
config ESPTOOLPY_BAUD_230400B
	bool "230400 baud"
config ESPTOOLPY_BAUD_921600B
	bool "921600 baud"
config ESPTOOLPY_BAUD_2MB
	bool "2Mbaud"
endchoice

config ESPTOOLPY_BAUD
	int
	default 115200 if ESPTOOLPY_BAUD_115200B
	default 230400 if ESPTOOLPY_BAUD_230400B
	default 921600 if ESPTOOLPY_BAUD_921600B
	default 2000000 if ESPTOOLPY_BAUD_2MB

config ESPTOOLPY_COMPRESSED
	bool "Use compressed upload"
	default "y"
	---help---
		The flasher tool can send data compressed using zlib, letting the ROM on the ESP chip
		decompress it on the fly before flashing it. For most payloads, this should result in a
		speed increase.

choice
	prompt "Flash SPI mode"
	default FLASHMODE_DIO
	---help---
		Mode the flash chip is flashed in, as well as the default mode for the
		binary to run in.

config FLASHMODE_QIO
	bool "QIO"
config FLASHMODE_QOUT
	bool "QOUT"
config FLASHMODE_DIO
	bool "DIO"
config FLASHMODE_DOUT
	bool "DOUT"
endchoice

# Note: we use esptool.py to flash bootloader in
# dio mode for QIO/QOUT, bootloader then upgrades
# itself to quad mode during initialisation
config ESPTOOLPY_FLASHMODE
	string
	default "dio" if FLASHMODE_QIO
	default "dio" if FLASHMODE_QOUT
	default "dio" if FLASHMODE_DIO
	default "dout" if FLASHMODE_DOUT

choice
	prompt "Flash SPI speed"
	default ESPTOOLPY_FLASHFREQ_40M
	---help---
		The SPI flash frequency to be used.

config ESPTOOLPY_FLASHFREQ_80M
	bool "80 MHz"
config ESPTOOLPY_FLASHFREQ_40M
	bool "40 MHz"
config ESPTOOLPY_FLASHFREQ_26M
	bool "26 MHz"
config ESPTOOLPY_FLASHFREQ_20M
	bool "20 MHz"
endchoice

config ESPTOOLPY_FLASHFREQ
	string
	default "80m" if ESPTOOLPY_FLASHFREQ_80M
	default "40m" if ESPTOOLPY_FLASHFREQ_40M
	default "26m" if ESPTOOLPY_FLASHFREQ_26M
	default "20m" if ESPTOOLPY_FLASHFREQ_20M

choice
	prompt "Flash size"
	default ESPTOOLPY_FLASHSIZE_2MB
	help
		SPI flash size, in megabytes

config ESPTOOLPY_FLASHSIZE_1MB
	bool "1 MB"
config ESPTOOLPY_FLASHSIZE_2MB
	bool "2 MB"
config ESPTOOLPY_FLASHSIZE_4MB
	bool "4 MB"
config ESPTOOLPY_FLASHSIZE_8MB
	bool "8 MB"
config ESPTOOLPY_FLASHSIZE_16MB
	bool "16 MB"
endchoice

config ESPTOOLPY_FLASHSIZE
	string
	default "1MB" if ESPTOOLPY_FLASHSIZE_1MB
	default "2MB" if ESPTOOLPY_FLASHSIZE_2MB
	default "4MB" if ESPTOOLPY_FLASHSIZE_4MB
	default "8MB" if ESPTOOLPY_FLASHSIZE_8MB
	default "16MB" if ESPTOOLPY_FLASHSIZE_16MB

config ESPTOOLPY_FLASHSIZE_DETECT
	bool "Detect flash size when flashing bootloader"
	default y
	---help---
		If this option is set, 'make flash' targets will automatically detect
		the flash size and update the bootloader image when flashing.

choice
	prompt "Before flashing"
	default ESPTOOLPY_BEFORE_RESET
	---help---
		Configure whether esptool.py should reset the ESP32 before flashing.

		Automatic resetting depends on the RTS & DTR signals being
		wired from the serial port to the ESP32. Most USB development
		boards do this internally.

config ESPTOOLPY_BEFORE_RESET
	bool "Reset to bootloader"
config ESPTOOLPY_BEFORE_NORESET
	bool "No reset"
endchoice

config ESPTOOLPY_BEFORE
	string
	default "default_reset" if ESPTOOLPY_BEFORE_RESET
	default "no_reset" if ESPTOOLPY_BEFORE_NORESET

choice
	prompt "After flashing"
	default ESPTOOLPY_AFTER_RESET
	---help---
		Configure whether esptool.py should reset the ESP32 after flashing.

		Automatic resetting depends on the RTS & DTR signals being
		wired from the serial port to the ESP32. Most USB development
		boards do this internally.

config ESPTOOLPY_AFTER_RESET
	bool "Reset after flashing"
config ESPTOOLPY_AFTER_NORESET
	bool "Stay in bootloader"
endchoice

config ESPTOOLPY_AFTER
	string
	default "hard_reset" if ESPTOOLPY_AFTER_RESET
	default "no_reset" if ESPTOOLPY_AFTER_NORESET

config ESP32_AUTOMOUNT
	bool "Automount partitions"
	default n
	depends on FLASH_PARTITION
	depends on !DISABLE_MOUNTPOINT
	---help---
		If enabled, mount userfs or romfs partition automatically at boot.

config ESP32_AUTOMOUNT_USERFS
	bool "Automount userfs partiton"
	default n
	depends on ESP32_AUTOMOUNT
	depends on FS_SMARTFS
	---help---
		If enabled, mount userfs partition automatically at boot.

config ESP32_AUTOMOUNT_USERFS_DEVNAME
    string "Device name of the partition for user file system"
    default "/dev/smart0p0"
    depends on ESP32_AUTOMOUNT_USERFS
    ---help---
        Specifies the device name (/dev/smart0pX) of the partition
        for user r/w file system.
        when SMARTFS_MULTI_ROOT_DIRS is enabled the device name
        will be appended by "d1" (/dev/smart0pxd1).

config ESP32_AUTOMOUNT_USERFS_MOUNTPOINT
    string "Mountpoint of the partition for user r/w file system"
    default "/mnt"
    depends on ESP32_AUTOMOUNT_USERFS
    ---help---
        Specifies the mount point where user r/w file system
        will be mounted at.

config ESP32_AUTOMOUNT_ROMFS
	bool "Automount romfs partiton"
	default y
	depends on ESP32_AUTOMOUNT
	depends on FS_ROMFS
	---help---
		If enabled, mount romfs partition automatically at boot.

config ESP32_AUTOMOUNT_ROMFS_DEVNAME
    string "Device name of the partition for rom read only file system"
    default "/dev/mtdblock1"
    depends on ESP32_AUTOMOUNT_ROMFS
    ---help---
	Specifies the block device name of rom readonly file system.
	the device name starts with "/dev/mtdblock", and the index is
	its sequency(begin with 0) in partition list.

config ESP32_AUTOMOUNT_ROMFS_MOUNTPOINT
    string "Mountpoint of the partition for rom read only file system"
    default "/rom"
    depends on ESP32_AUTOMOUNT_ROMFS
    ---help---
        Specifies the mount point where rom readonly file system
        will be mounted at.

config SPIRAM_SUPPORT
    bool "ESP32 external SPIRAM support"
    default n
	depends on ARCH_BOARD_ESP_WROVER_KIT
    ---help---
        This enables support for an external SPI RAM chip, connected in parallel with the
        main SPI flash chip.
        Enable multi heap on TizenRT to use spiram

menu "SPI RAM config"
    depends on SPIRAM_SUPPORT

choice SPIRAM_TYPE
    prompt "Type of SPI RAM chip in use"
    default SPIRAM_TYPE_AUTO

config SPIRAM_TYPE_ESPPSRAM32
    bool "ESP-PSRAM32 or IS25WP032"

endchoice

choice SPIRAM_SPEED
    prompt "Set RAM clock speed"
    default SPIRAM_CACHE_SPEED_40M
    help
        Select the speed for the SPI RAM chip.
        If SPI RAM is enabled, we only support three combinations of SPI speed mode we supported now:

        1. Flash SPI running at 40Mhz and RAM SPI running at 40Mhz
        2. Flash SPI running at 80Mhz and RAM SPI running at 40Mhz
        3. Flash SPI running at 80Mhz and RAM SPI running at 80Mhz

           Note: If the third mode(80Mhz+80Mhz) is enabled for SPI RAM of type 32MBit, one of the HSPI/VSPI host will
            be occupied by the system. Which SPI host to use can be selected by the config item SPIRAM_OCCUPY_SPI_HOST.
            Application code should never touch HSPI/VSPI hardware in this case. The option to select
            80MHz will only be visible if the flash SPI speed is also 80MHz. (ESPTOOLPY_FLASHFREQ_80M is true)

config SPIRAM_SPEED_40M
    bool "40MHz clock speed"
config SPIRAM_SPEED_80M
    depends on ESPTOOLPY_FLASHFREQ_80M
    bool "80MHz clock speed"
endchoice

config SPIRAM_CACHE_WORKAROUND
    bool "Enable workaround for bug in SPI RAM cache for Rev1 ESP32s"
    default "y"
    help
        Revision 1 of the ESP32 has a bug that can cause a write to PSRAM not to take place in some situations
        when the cache line needs to be fetched from external RAM and an interrupt occurs. This enables a
        fix in the compiler that makes sure the specific code that is vulnerable to this will not be emitted.

        This will also not use any bits of newlib that are located in ROM, opting for a version that is compiled
        with the workaround and located in flash instead.

choice SPIRAM_OCCUPY_SPI_HOST
    prompt "SPI host to use for 32MBit PSRAM"
    default SPIRAM_OCCUPY_VSPI_HOST
    depends on SPIRAM_SPEED_80M
    help
        When both flash and PSRAM is working under 80MHz, and the PSRAM is of type 32MBit, one of the HSPI/VSPI
        host will be used to output the clock. Select which one to use here.

config SPIRAM_OCCUPY_HSPI_HOST
    bool "HSPI host (SPI2)"
config SPIRAM_OCCUPY_VSPI_HOST
    bool "VSPI host (SPI3)"
endchoice

endmenu # "SPI RAM config"
```

## os/board/imxrt1020-evk/Kconfig
```kconfig
#
# For a description of the syntax of this configuration file,
# see kconfig-language at https://www.kernel.org/doc/Documentation/kbuild/kconfig-language.txt
#

if ARCH_BOARD_IMXRT1020_EVK

config FLASH_START_ADDR
	hex
	default 0x60000000
	---help---
		A start address of flash (in hex).
		This is fixed value, so user doesn't need to change it.

config FLASH_SIZE
	int
	default 8388608
	---help---
		A size of flash (in bytes).
		This is fixed value, so user doesn't need to change it.

config IMXRT_NORFLASH
	bool "Enable Norflash"
	default y
	---help---
		Enables Norflash

config SVR_DB_SECURESTORAGE
	bool "Enable storing SVR DB inside secure storage partition"
	default n
	depends on SECURITY_SS
	---help---
		If enabled, SVR DB is stored in secure storage partion
		mounted at the specified mount point.

if RAMMTD
config IMXRT_RAMMTD_NEBLOCKS
	int "RAM MTD erase block count"
	default 64
	---help---
		Ramfs size will be RAMMTD_ERASESIZE * IMXRT_RAMMTD_NEBLOCKS.
		You have to consider total ramsize to alloc ramfs size.

config IMXRT_RAMMTD_DEV_NUMBER
	int "device number for mtd of jSmartFs"
	default 3

config IMXRT_RAMMTD_DEV_POINT
	string "Device name of the partition for ramfs r/w file system"
	default "/dev/smart3"

config IMXRT_RAMMTD_MOUNT_POINT
	string "Mountpoint of the partition for ramfs r/w file system"
	default "/ramfs"
endif

config PROD_HEADER
	string "Product pin definition header"
	default "prod/fac.h"

endif
```

## os/board/imxrt1050-evk/Kconfig
```kconfig
#
# For a description of the syntax of this configuration file,
# see kconfig-language at https://www.kernel.org/doc/Documentation/kbuild/kconfig-language.txt
#

if ARCH_BOARD_IMXRT1050_EVK

config FLASH_START_ADDR
	hex
	default 0x60000000
	---help---
		A start address of flash (in hex).
		This is fixed value, so user doesn't need to change it.

config FLASH_SIZE
	int
	default 16777216
	---help---
		A size of flash (in bytes).
		This is fixed value, so user doesn't need to change it.

choice
	prompt "Boot Flash"
	default IMXRT1050_EVK_HYPER_FLASH

config IMXRT1050_EVK_HYPER_FLASH
	bool "HYPER Flash"
	select IMXRT_HYPERFLASH

config IMXRT1050_EVK_NOR_FLASH
	bool "Serial NOR Flash"
	select IMXRT_NORFLASH

endchoice # Boot Flash

config IMXRT_HYPERFLASH
	bool "Enable Hyperflash"
	default n
	---help---
		Enables Hyperflash

config IMXRT_NORFLASH
	bool "Enable Norflash"
	default n
	---help---
		Enables Norflash

config IMXRT_AUTOMOUNT_TZDEVNAME
	string "Device name of the partition for zoneinfo file system"
	default "/dev/mtdblock10"
	depends on LIBC_ZONEINFO_ROMFS
	depends on IMXRT_AUTOMOUNT
	---help---
		Specifies the device name (/dev/mtdblock10) of the partition
		for zoneinfo file system.

config SVR_DB_SECURESTORAGE
	bool "Enable storing SVR DB inside secure storage partition"
	default n
	depends on SECURITY_SS
	---help---
		If enabled, SVR DB is stored in secure storage partion
		mounted at the specified mount point.

if RAMMTD
config IMXRT_RAMMTD_NEBLOCKS
	int "RAM MTD erase block count"
	default 64
	---help---
		Ramfs size will be RAMMTD_ERASESIZE * IMXRT_RAMMTD_NEBLOCKS.
		You have to consider total ramsize to alloc ramfs size.

config IMXRT_RAMMTD_DEV_NUMBER
	int "device number for mtd of jSmartFs"
	default 3

config IMXRT_RAMMTD_DEV_POINT
	string "Device name of the partition for ramfs r/w file system"
	default "/dev/smart3"

config IMXRT_RAMMTD_MOUNT_POINT
	string "Mountpoint of the partition for ramfs r/w file system"
	default "/ramfs"
endif

config PROD_HEADER
	string "Product pin definition header"
	default "prod/fac.h"
endif
```

## os/board/qemu-mps2-an505/Kconfig
```kconfig
#
# For a description of the syntax of this configuration file,
# see kconfig-language at https://www.kernel.org/doc/Documentation/kbuild/kconfig-language.txt
#

if ARCH_BOARD_QEMU_MPS2_AN505

menu "QEMU MPS2 AN505 Board Configuration"

config QEMU_MPS2_AN505_TESTFS
	bool "Reserve board hook for runtime test filesystem setup"
	default y if QEMU_MPS2_AN505_PROFILE_BK7239N
	default y
	---help---
		Keep the board initialization hook available for the RAM-backed test
		filesystem plumbing that will be added with the qemu-mps2-an505
		runtime defconfigs.

config USERFS_MNTPT
	string
	default "/mnt" if AUTOMOUNT_USERFS
	---help---
		Default mount point for runtime filesystem checks on qemu-mps2-an505.

endmenu # "QEMU MPS2 AN505 Board Configuration"

endif # ARCH_BOARD_QEMU_MPS2_AN505
```
