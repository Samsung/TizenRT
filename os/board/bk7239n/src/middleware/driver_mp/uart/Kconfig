## os/board/bk7239n/src/middleware/driver_mp/uart/Kconfig
```kconfig
menu "UART"
	config UART1
		bool "Enable UART1"
		default n
	config UART1_FLOW_CTRL
		bool "Uart1 Flow Ctrl"
		default n

	config UART2
		bool "Enable UART2"
		default n

	config UART3
		bool "Enable UART3"
		default n

	config UART_PRINT_PORT
		int "Config Uart Print Port"
		range 0 2
		default 0
		help
		Default 0 mean use UART1

	config UART_CLI_BKREG_PORT
		int "Config Uart CLI and BKreg Port"
		range 0 2
		default 1
		help
		Default 1 mean use UART1

	config UART_ATE_PRINT_PORT
		int "Config Uart ATE Print Port"
		range 0 2
		default 0
		help
		Default 0 mean use UART1

	config UART_ATE_PORT
		int "Config Uart ATE Port"
		range 0 2
		default 1
		help
		Default 1 mean use UART2

	config PRINTF_BUF_SIZE
		int "Print Buffer Size"
		range 1 4096
		default 128
		help
		The value should be changed if print size is more than 128

	# TODO do we need to put it to uart_debug component?
	config BACKGROUND_PRINT
		bool "Enable background print"
		default n

	config KFIFO_SIZE
		int "Kfifo Size"
		range 1 4096
		default 128
		help
			This will set kfifo size when software uses kfifo to cache data receiving.

	config UART_STATIS
		bool "Enable UART Statis"
		default n

	config UART_LOW_VOLTAGE_SUPPORT
		bool "Enable UART support low power"
		default n
		
	config UART_ERR_INTERRUPT
		bool "Enable UART support error interrupt"
		default n

	config UART_TX_DMA
		bool "Enable UART tx dma"
		default n
		---help---
			Enable UART tx dma copy data support,special feature used for UART TX data. \
			When erase Flash, CPU can't get instructions from flash then it can't work, \
			so DMA copy data from RAM to UART FIFO

	config UART_RX_DMA
		bool "Enable UART rx dma"
		default n
		---help---
			Enable UART rx dma copy data support,special feature used for UART RX data. \
			When erase Flash, CPU can't get instructions from flash then it can't work, \
			so DMA copy data from UART FIFO to RAM

	config UART_RX_DMA_KFIFO_SIZE
		int "Kfifo Size"
		range 1 4096
		default 512
		help
			This will reset kfifo size of "CONFIG_KFIFO_SIZE" when software enable rx dma.

	config UART_PM_CB_SUPPORT
		bool "Enable UART enter low voltage callback support"
		default n
endmenu
```

## os/board/bk7239n/src/middleware/driver_mp/wdt/Kconfig
```kconfig
menu "Watchdog"
	config INT_WDT
		bool "Enable Interrupt Watchdog"
		default y

	config INT_WDT_PERIOD_MS
		int "Interrupt Watchdog Period(ms)"
		default 1000

	config TASK_WDT
		bool "Enable Task Watchdog"
		default y

	config TASK_WDT_PERIOD_MS
		int "Task Watchdog Period(ms)"
		default 60000

	config NMI_WDT_EN
		bool "Enable NMI Watchdog"
		default n
endmenu
```

## os/board/bk7239n/src/middleware/soc/Kconfig
```kconfig
menu "SOC_CONFIG"

	choice SOC
		prompt "ARMINO SoC"
		default SOC_BK7239N if "$ARMINO_SOC" = "bk7239n"

		config SOC_BK7239N
			bool "BK7239N"

	endchoice

	choice System
		prompt "System"
		default SYS_CPU0

		config SYS_CPU0
			bool "CPU0 system"

	endchoice

	config CPU_CNT
			int "System CPU count: 1: single core, 2: dual core, etc."
			default 1

	config SOC_STR
		string "SoC string"
		default "bk7239n"  if SOC_BK7239N
		default "$ARMINO_SOC"

	config SOC_ARCH
		string "Soc arch"
		default "unknown"

	config SOC_SMP
		bool "For soc smp feature"
		default n

	config SOC_BK7239XX
		bool "For bk7239n series chipset"
		default n

endmenu
```

## os/board/bk7239n/src/middleware/soc/bk7239n/Kconfig
```kconfig
menu "bk7239"
	config CPU0_SPE_RAM_SIZE
		hex "CPU0 RAM size for SPE"
		default 0x80000

	config CPU0_NSPE_RAM_SIZE
		hex "CPU0 RAM size for NSPE"
		default 0x40000

	config ANA_REG_WRITE_POLL_REG_B
		bool "Write analog register polls sys reg0xb"
		default y

	config PM_HAL_DEBUG
		bool "Enable PM hal debug"
		default n

	config PM_HAL_CTRL
		bool "Enable PM hal debug"
		default n

	config TZ
		bool "Supported TrustZone"
		default y

	config SPE
		int "Enable SPE"
		default 0

	config RX_OPTIMIZE
		bool "Optimize rx current"
		default n

	config RELEASE_IRAM
		bool "release iram"
		default n
endmenu
```

## os/board/common/Kconfig
```kconfig
#
# For a description of the syntax of this configuration file,
# see kconfig-language at https://www.kernel.org/doc/Documentation/kbuild/kconfig-language.txt
#

config ARCH_BOARD_HAVE_FLASH
	bool
	default n
	---help---
		This shows the board has the flash and enables to use.
		This is enabled by board config.

if ARCH_BOARD_HAVE_FLASH && (NFILE_DESCRIPTORS != 0)
comment "Board-Partition Options"

config FLASH_PARTITION
	bool "Enable partition support on FLASH"
	default n
	select MTD
	select MTD_PARTITION
	---help---
		Enables creation of partitions on the FLASH

if FLASH_PARTITION

config FLASH_MINOR
	int "Minor number for the FLASH device"
	default 0
	---help---
		Sets the minor number for /dev node of the external flash
		device.

config FLASH_PART_SIZE
	string "Flash partition size list (in KBytes)"
	default "16,48,192,32,512,2400,1536,1536,1400,8,512," if !BUILD_PROTECTED
	default "16,48,192,32,512,1200,1200,1536,1536,1400,8,512," if BUILD_PROTECTED
	---help---
		Comma separated list of partition sizes in KB.

config FLASH_PART_TYPE
	string "Flash partition type list"
	default "none,none,none,none,none,none,none,none,smartfs,config,none," if !BUILD_PROTECTED
	default "none,none,none,none,none,none,none,none,none,smartfs,config,none," if BUILD_PROTECTED
	---help---
		Comma separated list of partition types that can be one of
		followings: none, smartfs, config

config FLASH_PART_NAME
	string "Flash partition name list"
	default "bl1,sssro,bl2,sssfw,wlanfw,os,factory,ota,user,nvram,sssrw," if !BUILD_PROTECTED
	default "bl1,sssro,bl2,sssfw,wlanfw,os,apps,factory,ota,user,nvram,sssrw," if BUILD_PROTECTED
	depends on MTD_PARTITION_NAMES
	---help---
		Comma separated list of partition names.

endif # FLASH_PARTITION
endif # ARCH_BOARD_HAVE_FLASH && (NFILE_DESCRIPTORS != 0)

config ARCH_BOARD_HAVE_SECOND_FLASH
	bool
	default n
	---help---
		This shows the board has the second flash and enables to use.
		This is enabled by board config.

if ARCH_BOARD_HAVE_SECOND_FLASH && (NFILE_DESCRIPTORS != 0)
comment "Second Flash Partition Options"

config SECOND_FLASH_PARTITION
	bool "Enable partition support on Second FLASH"
	default n
	select MTD
	select MTD_PARTITION
	---help---
		Enables creation of partitions on the Second FLASH

if SECOND_FLASH_PARTITION

config SECOND_FLASH_MINOR
	int "Minor number for the FLASH device"
	default 1
	---help---
		Sets the minor number for /dev node of the second flash
		device.

config SECOND_FLASH_PART_SIZE
	string "Flash partition size list (in KBytes)"
	default "512,2048,"
	---help---
		Comma separated list of partition sizes in KB.

config SECOND_FLASH_PART_TYPE
	string "Flash partition type list"
	default "kernel,smartfs," if APP_BINARY_SEPARATION
	default "none,smartfs," if !APP_BINARY_SEPARATION
	---help---
		Comma separated list of partition types that can be one of
		followings: none, kernel, smartfs, romfs, ftl, config

config SECOND_FLASH_PART_NAME
	string "Flash partition name list"
	default "kernel,userfs,"
	depends on MTD_PARTITION_NAMES
	---help---
		Comma separated list of partition names.

endif # SECOND_FLASH_PARTITION
endif # ARCH_BOARD_HAVE_SECOND_FLASH && (NFILE_DESCRIPTORS != 0)

config AUTOMOUNT
	bool "Automount partitions"
	default n
	depends on FLASH_PARTITION
	depends on !DISABLE_MOUNTPOINT
	---help---
		If enabled, mount userfs or romfs partition automatically at boot.

config AUTOMOUNT_USERFS
	bool "Automount userfs partition"
	default n
	depends on AUTOMOUNT
	depends on FS_SMARTFS
	---help---
		If enabled, mount userfs partition automatically at boot.
		The device name of the partition will be set like "/dev/smart0pX"
		for user r/w file system.
		When SMARTFS_MULTI_ROOT_DIRS is enabled the device name
		will be appended by "d1" (/dev/smart0pxd1).

config AUTOMOUNT_ROMFS
	bool "Automount romfs partition"
	default n
	depends on AUTOMOUNT
	depends on FS_ROMFS
	---help---
		If enabled, mount romfs partition automatically at boot.

config BOARD_ENTROPY_POOL
        bool "Enable Board level storing of entropy pool structure"
        default n
        depends on CRYPTO_RANDOM_POOL
        ---help---
                Entropy pool structure can be provided by board source.
                Use for this is, for example, to allocate entropy pool
                from special area of RAM which content is kept over
                system reset.

config BOARD_INITRNGSEED
        bool "Enable Board level initial seeding of entropy pool RNG"
        default n
        depends on CRYPTO_RANDOM_POOL
        ---help---
                If enabled, entropy pool random number generator will call
                board_init_rndseed() upon initialization. This function
                can then provide early entropy seed to the pool through
                entropy injection APIs provided at 'nuttx/random.h'.

config BOARD_USBDEV_SERIALSTR
        bool
        default n
```
