## os/board/qemu-virt/Kconfig
```kconfig
#
# For a description of the syntax of this configuration file,
# see kconfig-language at https://www.kernel.org/doc/Documentation/kbuild/kconfig-language.txt
#

if ARCH_BOARD_QEMU_VIRT
menu "Bootloader Configurations"
# choice
#     prompt "Boot Method"
#     default QEMU_VIRT_KERNEL_LOAD
# config QEMU_VIRT_KERNEL_LOAD
#     bool "Load kernel to RAM"
#     select BOOT_RUNFROMSDRAM
#     help
#         Bootloader loads kernel to RAM.
# config QEMU_VIRT_KERNEL_XIP
#     bool "Jump to kernel (XIP)"
#     select BOOT_RUNFROMFLASH
#     help
#         Bootloader just jumps to kernel.
# endchoice
endmenu

config FLASH_VSTART
    hex
    default 0x00000000
    help
        A start virtual address of flash (in hex).
        This is fixed value, so user doesn't need to change it.
        Keep this value same as FLASH_START_ADDR.

config FLASH_START_ADDR
    hex
    default 0x00000000
    help
        A start address of flash (in hex).
        This is fixed value, so user doesn't need to change it.

config FLASH_VSTART_LOADABLE
    hex
    default 0x00008000
    depends on XIP_ELF
    help
        A start virtual address of flash (in hex). This macro
        will be used to do address remapping for loadable running on XIP.
        This is fixed value, so user doesn't need to change it.

config FLASH_SIZE
    int
    default 67108864
    help
        A size of flash (in bytes).
        This is fixed value, so user doesn't need to change it.

    if SECOND_FLASH_PARTITION
        config SECOND_FLASH_START_ADDR
            hex
            default 0x04000000
            help
                A start address of second flash (in hex).
                This is fixed value, so user doesn't need to change it.

        config SECOND_FLASH_SIZE
            int
            default 67108864
            help
                A size of second flash (in bytes).
    endif

config USERFS_MNTPT
    string
    default "/mnt" if AUTOMOUNT_USERFS && !SECOND_FLASH_PARTITION
    default "/mnt0" if AUTOMOUNT_USERFS && SECOND_FLASH_PARTITION
    help
        A mount point name of first flash partition.

config USERFS_EXT_MNTPT
    string
    default "/mnt" if AUTOMOUNT_USERFS && SECOND_FLASH_PARTITION
    help
        A mount point name of second flash partition.

endif #ARCH_BOARD_QEMU_VIRT
```

## os/board/rtl8720e/Kconfig
```kconfig
#
# For a description of the syntax of this configuration file,
# see kconfig-language at https://www.kernel.org/doc/Documentation/kbuild/kconfig-language.txt
#

if ARCH_BOARD_RTL8720E

config FLASH_START_ADDR
    hex
    default 0x8000000
    help
        A start address of flash (in hex).
        This is fixed value, so user doesn't need to change it.

config FLASH_SIZE
    int
    default 8388608
    help
        A size of flash (in bytes).
        This is fixed value, so user doesn't need to change it.

menu "SPI Flash driver"

config AMEBALITE_FLASH_BASE
    hex "Start address for user filesystem"
    default 0x180000
    help
        Setting this vaule to configure flash start address for user filesystem,
        such as smartfs, romfs.

config AMEBALITE_FLASH_CAPACITY
    hex "Size for user filesystem"
    default 0x80000
    help
        Setting this vaule to configure flash size  for user filesystem,
        such as smartfs, romfs.

config AMEBALITE_FLASH_PAGE_SIZE
    int "Read/write unit size of SPI flash"
    default 256
    help
        Setting this vaule to configure read/write unit size of esp32 SPI flash.

config AMEBALITE_FLASH_BLOCK_SIZE
    int "Erase unit size of SPI flash"
    default 4096
    help
        Setting this vaule to configure erase unit size of esp32 SPI flash.

config AMEBALITE_SECURE_WORLD_ADDRESS
     hex "Secure address to read/write"
     default 0x70383020
     help
         Setting this value to a secure address to check whether it can be accessed from non-secure zone.

endmenu
endif
```

## os/board/rtl8720e/Kconfig.signing
```kconfig
config USER_SIGN_PREPEND_SIZE
	int "Prepended user binary signing size"
	default 32
	depends on BINARY_SIGNING
	---help---
		This is a size of prepended binary signing data.
```

## os/board/rtl8721csm/Kconfig
```kconfig
#
# For a description of the syntax of this configuration file,
# see kconfig-language at https://www.kernel.org/doc/Documentation/kbuild/kconfig-language.txt
#

if ARCH_BOARD_RTL8721CSM

config BOOTLOADER_FIXED_PARTITIONS
    bool "Use bootloader that supports fixed partitions"
    default y
    depends on !USE_BP

config BOOTLOADER_DYNAMIC_PARTITIONS
    bool "Use bootloader that supports dynamic partitions"
    default y
    depends on USE_BP

config FLASH_START_ADDR
    hex
    default 0x8000000
    help
        A start address of flash (in hex).
        This is fixed value, so user doesn't need to change it.

config FLASH_SIZE
    int
    default 8388608
    help
        A size of flash (in bytes).
        This is fixed value, so user doesn't need to change it.

menu "SPI Flash driver"

config AMEBAD_FLASH_BASE
    hex "Start address for user filesystem"
    default 0x180000
    help
        Setting this vaule to configure flash start address for user filesystem,
        such as smartfs, romfs.

config AMEBAD_FLASH_CAPACITY
    hex "Size for user filesystem"
    default 0x80000
    help
        Setting this vaule to configure flash size  for user filesystem,
        such as smartfs, romfs.

config AMEBAD_FLASH_PAGE_SIZE
    int "Read/write unit size of SPI flash"
    default 256
    help
        Setting this vaule to configure read/write unit size of esp32 SPI flash.

config AMEBAD_FLASH_BLOCK_SIZE
    int "Erase unit size of SPI flash"
    default 4096
    help
        Setting this vaule to configure erase unit size of esp32 SPI flash.
	
endmenu
endif
```

## os/board/rtl8721csm/Kconfig.signing
```kconfig
config USER_SIGN_PREPEND_SIZE
	int "Prepended user binary signing size"
	default 32
	depends on APP_BINARY_SEPARATION && BINARY_SIGNING
	---help---
		This is a size of prepended binary signing data.
```

## os/board/rtl8730e/Kconfig
```kconfig
#
# For a description of the syntax of this configuration file,
# see kconfig-language at https://www.kernel.org/doc/Documentation/kbuild/kconfig-language.txt
#

if ARCH_BOARD_RTL8730E

config FLASH_VSTART
    hex
    default 0x8000000
    help
        A start virtual address of flash (in hex).
        This is fixed value, so user doesn't need to change it.
	Keep this value same as FLASH_START_ADDR.

config FLASH_START_ADDR
    hex
    default 0x8000000
    help
        A start address of flash (in hex).
        This is fixed value, so user doesn't need to change it.

config TRPK_CONTAINS_MULTIPLE_BINARY
    bool
    default n
    depends on XIP_ELF
    help
        This macro is to differentiate whether the kernel trpk contains
        more than 1 binary. If yes, we have to recalculate the offset
        according to the binary that is running on Tizen Lite, to make
        sure the loadable_apps for XIP_ELF is placed to the correct
        virtual flash address (ie. Only Loadable_apps with running on
        XIP is needed, because the core has to know where to execute
        from the correct remapped address)
        This macro is not needed for flat configs, due to the kernel 
        binaries remapping will be handled by the bootloader.

config FLASH_VSTART_LOADABLE
    hex
    default 0xe000000
    depends on XIP_ELF
    help
        A start virtual address of flash (in hex). This macro
        will be used to do address remapping for loadable running on XIP.
        This is fixed value, so user doesn't need to change it.

choice
    prompt "Board Flash Size"
    default BOARD_FLASH_16M

config BOARD_FLASH_8M
    bool "8 Mbyte"
    help
        Board with flash 8Mbyte size

config BOARD_FLASH_16M
    bool "16 Mbyte"
    help
        Board with flash 16Mbyte size

endchoice

config RTL8730E_BOARD_REVISION
	int "Select target board revision"
	default 0
	---help---
		Select the board revision.
		The pins of the peripherals may differ depending on this

config FLASH_SIZE
    int
    default 8388608 if BOARD_FLASH_8M
    default 16777216 if BOARD_FLASH_16M
    help
        A size of flash (in bytes).
        This is fixed value, so user doesn't need to change it.

menu "SPI Flash driver"

config AMEBASMART_FLASH_BASE
    hex "Start address for user filesystem"
    default 0x180000
    help
        Setting this vaule to configure flash start address for user filesystem,
        such as smartfs, romfs.

config AMEBASMART_FLASH_CAPACITY
    hex
    default 0x800000 if BOARD_FLASH_8M
    default 0x1000000 if BOARD_FLASH_16M
    help
        Setting this vaule to configure flash size  for user filesystem,
        such as smartfs, romfs.

config AMEBASMART_FLASH_PAGE_SIZE
    int "Read/write unit size of SPI flash"
    default 256
    help
        Setting this vaule to configure read/write unit size of esp32 SPI flash.

config AMEBASMART_FLASH_BLOCK_SIZE
    int "Erase unit size of SPI flash"
    default 4096
    help
        Setting this vaule to configure erase unit size of esp32 SPI flash.

config AMEBASMART_SECURE_WORLD_ADDRESS
     hex "Secure address to read/write"
     default 0x70383020
     help
         Setting this value to a secure address to check whether it can be accessed from non-secure zone.

endmenu
endif
```

## os/board/rtl8730e/Kconfig.signing
```kconfig
config USER_SIGN_PREPEND_SIZE
	int "Prepended user binary signing size"
	default 4096
	depends on BINARY_SIGNING
	---help---
		This is a size of prepended binary signing data.
```

## os/board/stm32h745zi-nucleo/Kconfig
```kconfig
#
# For a description of the syntax of this configuration file,
# see kconfig-language at https://www.kernel.org/doc/Documentation/kbuild/kconfig-language.txt
#
if ARCH_BOARD_STM32H745ZI_NUCLEO

config FLASH_START_ADDR
    hex
    default 0x80C0000
    help
        A start address of flash (in hex).
        This is fixed value, so user doesn't need to change it.

config FLASH_SIZE
    int
    default 262144
    help
        A size of flash (in bytes).
        This is fixed value, so user doesn't need to change it.

config SHARED_MEMORY
    bool
    default y

config SHARED_MEMORY_AXI_RAM
    bool
    default n

config SHARED_MEMORY_SRAM1
    bool
    default n

config SHARED_MEMORY_SRAM2
    bool
    default n

config SHARED_MEMORY_SRAM3
    bool
    default n

config SHARED_MEMORY_SRAM4
    bool
    default y

endif # ARCH_BOARD_STM32H745ZI_NUCLEO
```

## os/compression/Kconfig
```kconfig
#
# For a description of the syntax of this configuration file,
# see kconfig-language at https://www.kernel.org/doc/Documentation/kbuild/kconfig-language.txt
#

config COMPRESSION
        bool "Compression library support"
        default n
        ---help---
                Add support for compression library.

if COMPRESSION

config COMPRESSION_TYPE
        int "Compression Algorithm Type"
        default 2
        range 1 2
        ---help---
                Enter compression type.
                1 = LZMA
                2 = MINIZ

endif # COMPRESSION

config COMPRESSED_BINARY
	bool "Compressed binary support"
	default n
	depends on BINFMT_ENABLE
	select COMPRESSION
	---help---
		If a compressed binary is to be loaded/executed
		this config needs to be enabled. It adds support for
		reading compressed binary.

if COMPRESSED_BINARY

config COMPRESSION_BLOCK_SIZE
	int "Block size for binary compression"
	default 16384
	range 512 16384
	---help---
		Enter block size to use for compression of binary.

endif # COMPRESSED_BINARY
```

## os/crypto/Kconfig
```kconfig
#
# For a description of the syntax of this configuration file,
# see kconfig-language at https://www.kernel.org/doc/Documentation/kbuild/kconfig-language.txt
#

config CRYPTO
	bool "Crypto API Support"
	default n
	---help---
		Disable or Enable Crypto features

if CRYPTO

config CRYPTO_BLAKE2S
	bool "BLAKE2s hash algorithm"
	default n
	---help---
		Enable the BLAKE2s hash algorithm

config CRYPTO_RANDOM_POOL
	bool "Entropy pool and strong randon number generator"
	default n
	select CRYPTO_BLAKE2S
	---help---
		Entropy pool gathers environmental noise from device drivers,
		user-space, etc., and returns good random numbers, suitable
		for cryptographic use. Based on entropy pool design from
		*BSDs and uses BLAKE2Xs algorithm for CSPRNG output.

endif
```

## os/drivers/ai-soc/Kconfig
```kconfig
#
# For a description of the syntax of this configuration file,
# see kconfig-language at https://www.kernel.org/doc/Documentation/kbuild/kconfig-language.txt

config NDP120
	bool "NDP120 AI soc support"
	default n
	depends on SPI
	---help---
		Select to enable support for the NDP120 AI soc

if NDP120

if RTL8730E_BOARD_REVISION > 7
config NDP120_AEC_SUPPORT
	bool "NDP120 Support AEC"
	default y
	---help---
		Select to enable support AEC

endif

config NDP120_ALIVE_CHECK
	bool "NDP120 alive check thread"
	default n
	---help---
		Select to enable support Alive check thread
endif
```

## os/drivers/analog/Kconfig
```kconfig
#
# For a description of the syntax of this configuration file,
# see kconfig-language at https://www.kernel.org/doc/Documentation/kbuild/kconfig-language.txt
#

config ADC
	bool "Analog-to-Digital Conversion"
	default n
	---help---
		Select to enable support for analog input device support.  This includes
		not only Analog-to-Digital Converters (ADC) but also amplifiers and
		analog multiplexers.

		This selection enables:

			- The upper half, device-independent ADC character driver, and
			- Selection of common lower half ADC drivers.

		MCU-specific, lower half drivers may be selected independently of
		CONFIG_ADC.  However, if CONFIG_ADC is selected, then it is assume
		that lower half ADC drivers will be used only with the common ADC
		upper half driver.

if ADC

config ADC_FIFOSIZE
	int "ADC buffer size"
	default 8
	---help---
		This variable defines the size of the ADC ring buffer that is used
		to queue received ADC data until they can be retrieved by the
		application by reading from the ADC character device.  NOTE:  Since
		this is a ring buffer, the actual number of bytes that can be
		retained in buffer is (ADC_FIFOSIZE - 1).

config ADC_NPOLLWAITERS
	int "Number of poll waiters"
	default 2
	depends on !DISABLE_POLL
	---help---
		Maximum number of threads that can be waiting on poll.

endif # ADC

config DAC
	bool "Digital-to-Analog Conversion"
	default n
	---help---
		Select to enable support for Digital-to-Analog Converters (DACs).
```
