## os/board/bk7239n/src/middleware/driver/sdcard/Kconfig
```kconfig
menu "SDCARD"
	config SDCARD
		bool "Enable SDCARD"
		default y if (USB && USB_DEVICE)
		default n if !(USB && USB_DEVICE)

	choice SD_HOST_INTF
		prompt "SD Host Interface"
		depends on SDCARD_HOST
		default SD_HOST_INTF

		config SD_HOST_INTF
			bool "SD Host Interface"

		config SD1_HOST_INTF
			bool "SD1 Host Interface"
	endchoice

	config SDCARD_V2P0
		bool "Support SDCARD refactor code which version is 2.0"
		default y

	config SDCARD_V1P0
		bool "Before SDCARD refactor code which version is 1.0"
		default n

	config SDCARD_BUSWIDTH_4LINE
		bool "Support SDCARD 4 Data Wires"
		default n

	config SDCARD_POWER_GPIO_CTRL
		bool "Enable SDcard power gpio ctrl"
		default n

	config SDCARD_POWER_GPIO_CTRL_AUTO_POWERDOWN_WHEN_IDLE
	    depends on SDCARD_POWER_GPIO_CTRL
        bool "Enable SDcard auto powerdown when idle"
        default y
endmenu
```

## os/board/bk7239n/src/middleware/driver/sdio/Kconfig
```kconfig
menu "SDIO"
	config SDIO
		bool "Enable SDIO"

	config SDIO_V1P0
		bool "SDIO Version V1P0"
		depends on SDIO
		default n
		
	config SDIO_V2P0
		bool "SDIO Version V2P0"
		default n

	config SDIO_TRANS
		bool "Enable SDIO Trans"
		depends on SDIO_V1P0
		default n

	config REAL_SDIO
		bool "Enable Real SDIO"
		depends on SDIO_V1P0

	config SDIO_BLOCK_512
		bool "Enable SDIO 512 Bytes Block"
		depends on REAL_SDIO

	config SDIO_SLAVE
		bool "Enable SDIO Slave Device, BEKEN Chip Is A SDIO Slave Device"
		depends on SDIO
		default n

	config SDIO_CHANNEL_EN
		bool "Enable SDIO channel"
		depends on SDIO_SLAVE && SDIO_V2P0
		default n

	config SDIO_BIDIRECT_CHANNEL_EN
		bool "Enable SDIO two derect channel"
		depends on SDIO_CHANNEL_EN
		default n

	config SDIO_GDMA_EN
		bool "SDIO transfer data whether enable GDMA"
		depends on SDIO_V2P0 && GENERAL_DMA
		default n

	config GPIO_NOTIFY_TRANSACTION_EN
		bool "Host Wake BK7256"
		depends on SDIO_SLAVE && SDIO_V2P0
		default y

	config SDIO_4LINES_EN
		bool "SDIO Uses 4 Lines Transfer Data"
		depends on SDIO
		default y

	config SDIO_TEST_EN
		bool "SDIO Test Program Enable"
		depends on SDIO_SLAVE && SDIO_V2P0
		default n

	config SDIO_DEBUG_EN
		bool "SDIO Debug Program Enable"
		depends on SDIO_SLAVE && SDIO_V2P0
		default n

	config SDIO_PM_CB_SUPPORT
		bool "SDIO PM Support"
		default n

	config SDIO_SYNC_TRANS
		bool "SDIO sync transmit"
		default n

	config SDIO_RK3568
		bool "SDIO connect with RK3568 Host"
		default n

	config SDIO_1V8_EN
		bool "SDIO 1.8v IO voltage select"
		default n

endmenu
```

## os/board/bk7239n/src/middleware/driver/sys_ctrl/Kconfig
```kconfig
menu "SYS_CTRL"
	config SYS_REDUCE_NORMAL_POWER
	bool "Reduce system normal power"
	default n

	choice XTAL_FREQ
		prompt "Xtal frequence"
		default XTAL_FREQ_26M

		config XTAL_FREQ_40M
			bool "XTAL frequency 40M"

		config XTAL_FREQ_26M
			bool "XTAL frequency 26M"
	endchoice

	#TODO fixed it
	config XTAL_FREQ
		int "26000000"
		default 26000000 if XTAL_FREQ_26M
		default 40000000 if XTAL_FREQ_40M

	config DCO_FREQ
		int "DCO frequency"
		default 120000000

	config SYSTEM_CTRL
		bool "Enable system_ctrl"
		default n
	
	config HAL_DEBUG_SYS
		bool "system_ctrl debug"
		default n

	config POWER_CLOCK_RF
		bool "Enable rf power clock"
		default n

	config SYSTEM_CLOCK
		bool "Enable system clock"
		default n

	config ROSC_TEST_MODE
		bool "Enable ROSC test mode"
		default n

	config DEFAULT_LPO_SRC
		int "Default low power clock source"
		range 0 2
		default 2

	config CPU0_SUB_POWER_DOMAIN_ENA
		bool "Enable CPU0 sub-power dowmain"
		default n

	config LDO_SELF_LOW_POWER_MODE_ENA
		bool "Enable LDO self low power mode"
		default n
endmenu
```

## os/board/bk7239n/src/middleware/driver/timer/Kconfig
```kconfig
menu "TIMER"
	config TIMER
		bool "Enable TIMER"
		default y
		
	config TIMER_COUNTER
		bool "Enable timer counter"
		default y

	config TIMER_SUPPORT_ID_BITS
		int "timer support id bits"
		range 0 255
		default 0
		help
		0 indicates that all IDs are supported by default, no configuration required

	config TIMER_US
		bool "Enable timer0 as microsecond timer"
		default n

	config TIMER_PM_CB_SUPPORT
		bool "Enable TIMER enter low voltage callback support"
		default n
endmenu	
```

## os/board/bk7239n/src/middleware/driver/trng/Kconfig
```kconfig
menu "TRNG"
	config TRNG_SUPPORT
		bool "Support hardware TRNG"
		default y
endmenu
```

## os/board/bk7239n/src/middleware/driver_mp/aon_wdt/Kconfig
```kconfig
menu "AON_Watchdog"
	config AON_WDT
		bool "Enable AON Watchdog"
		default n

	config INT_AON_WDT
		bool "Enable Interrupt AON Watchdog"
		default n

	config INT_AON_WDT_PERIOD_MS
		int "Interrupt AON Watchdog Period(ms)"
		default 1000
endmenu
```

## os/board/bk7239n/src/middleware/driver_mp/chip_support/Kconfig
```kconfig
menu "SOFTWARE_SUPPORT_CHIP"
	config CHIP_SUPPORT
		bool "Enable chip support"
		default n
endmenu
```

## os/board/bk7239n/src/middleware/driver_mp/deep_lv/Kconfig
```kconfig
menu "DEEP_LV"
	config DEEP_LV
		bool "Enable deep low voltage"
		default n
endmenu
```

## os/board/bk7239n/src/middleware/driver_mp/eth/Kconfig
```kconfig
menu "ETH"
	config ETH
		bool "Enable Ethernet"
		default n

	choice ETH_PIN_GROUP
		prompt "Ethernet PIN Group"
		default ETH_PIN_GROUP0

		config ETH_PIN_GROUP0
			bool "Ethernet PIN Group (27, 29-39)"
			help
				Ethernet uses pin 27,29-39. Conflicts with DVP.
		config ETH_PIN_GROUP1
			bool "Ethernet PIN Group (46-55)"
			help
				Ethernet uses pin 46-55, Conflicts with LCD.
	endchoice

	config ETH_PTP
		bool "Support PTP"
		default n
		help
			Support 1588-2008 PTP.

	config ETH_VLAN
		bool "Support VLAN"
		default n

	config ETH_LPI
		bool "Support ETH LPI"
		default n
		help
			ETH Low Power IDLE Support, Current HW doesn't support on BK7236/BK7258.

	config ETH_EEE
		bool "ETH WoL"
		default n
		help
			ETH Wake over LAN Support.

	config ETH_REGISTER_CALLBACKS
		bool "ETH Use register callbacks"
		default n

	config ETH_TSO
		bool "TCP Segment Offload"
		default n

	config ETH_CSUM_OFFLOAD
		bool "IP/TCP/UDP/ICMP Checksum offload"
		default y
	
	config ETH_DHCP
		depends on ETH
		bool "ETH use dhcp or static"
		default y

	config ETH_PM_CB_SUPPORT
		bool "enable PM module enter/exit low voltage callback support"
		default n

	config PHY_SMSC
		bool "SMSC 100M PHY support"
		default y

	config PHY_MICREL_KSZ90X1
		bool "SMSC 1000M PHY support"
		default n

	config PHY_REALTEK
		bool "Realtek PHY Support"
		default n

endmenu
```

## os/board/bk7239n/src/middleware/driver_mp/fatfs/Kconfig
```kconfig
menu "FATFS"
	config FATFS
		bool "Support FATFS"
		default n
		
	config FATFS_SDCARD
		bool "Support SDCARD FATFS"
		default n
endmenu
```

## os/board/bk7239n/src/middleware/driver_mp/gpio/Kconfig
```kconfig
menu "GPIO"
	config GPIO
		bool "Enable GPIO"
		default y

	config AON_GPIO
		bool "Enable AON_GPIO"
		default y

	config ANA_GPIO
		bool "Enable ANA_GPIO"
		default n

	config GPIO_WAKEUP_SUPPORT
		bool "Enable GPIO WAKEUP system if at low voltage status"
		default n

	config GPIO_DYNAMIC_WAKEUP_SUPPORT
		bool "Enable GPIO dynamic config to wake system if at low volatage status"
		depends on GPIO_WAKEUP_SUPPORT
		default n

	config GPIO_KPSTAT_SUPPORT
		bool "Enable GPIO keep status during low voltage"
		default n

	config GPIO_DYNAMIC_KPSTAT_SUPPORT
		bool "Enable GPIO dynamic config to keep gpio status at low voltage status"
		depends on GPIO_KPSTAT_SUPPORT
		default n

	config GPIO_DYNAMIC_KEEP_STATUS_MAX_CNT
		int "how many gpio can dynamic set to keep status at low power status"
		range 0 48
		default 4
		help
		The value should be changed if need more then 4 gpio

	config GPIO_WAKEUP_DEBUG
		bool "Enable GPIO wakeup module debug code"
		depends on GPIO_WAKEUP_SUPPORT
		default n

	config GPIO_DYNAMIC_WAKEUP_SOURCE_MAX_CNT
		int "how many gpio can dynamic set to wakeup system at low power status"
		range 0 48
		default 4
		help
		The value should be changed if need more then 4 gpio

	config GPIO_SIMULATE_UART_WRITE
		bool "Enable GPIO simulate uart write data"
		default n

	config GPIO_DEFAULT_SET_SUPPORT
		bool "Enable GPIO default set devs"
		default n

	config GPIO_ANA_WAKEUP_SUPPORT
		bool "Enable GPIO wakeup system from analog channel"
		default n
		help
			This is for super deep sleep

	config GPIO_CLOCK_SWITCH_EN
		bool "Enable GPIO clock select from 32k/26m"
		default n

	config GPIO_RETENTION_SUPPORT
		bool "Enable GPIO retention for (super) deep sleep and soft reset"
		default n
		help
			If not open, gpio could not keep state when the always on power domain is off

	config GPIO_RETENTION_DISPOSABLE
		bool "Decide GPIO retention is disposable or permanent"
		default y

	config USR_GPIO_CFG_EN
		bool "Enable user-defined GPIO config for each project"
		depends on GPIO_DEFAULT_SET_SUPPORT
		default n

	config GPIO_TEST
		depends on GPIO && DRIVER_TEST
		bool "Enable gpio test"
		default y

	config GPIO_DUMP_MAP_DEV_DEBUG
		bool "Enable GPIO MAP DEV DEBUG CODE"
		default n
		
	config GPIO_API_TEST
		depends on GPIO && DRIVER_TEST
		bool "Enable gpio api test"
		default n

	config GPIO_CLOCK_PIN_SUPPORT
		bool "Enable gpio clock pin test"
		default n
endmenu
```

## os/board/bk7239n/src/middleware/driver_mp/i2s/Kconfig
```kconfig
menu "I2S"
    config I2S
        depends on AUDIO_RING_BUFF
        bool "Enable I2S"
        default n

endmenu
```

## os/board/bk7239n/src/middleware/driver_mp/phy/Kconfig
```kconfig
menu "PHY"
	#TODO is here the right place to put CONFIG_PTA?
	config PTA
		bool "Enable PTA"
		default n

	config ATE_TEST
		bool "Enable ATE Test"
		default n

	config MAC_PHY_BYPASS
		bool "Enable MAC/PHY by pass mode"
		default y
endmenu
```

## os/board/bk7239n/src/middleware/driver_mp/psram/Kconfig
```kconfig
menu "PSRAM"
	config PSRAM
		bool "Enable PSRAM"
		default n

	config PSRAM_AS_SYS_MEMORY
		depends on PSRAM
		bool "Enable psram_malloc API"
		default n

	config USE_PSRAM_HEAP_AT_SRAM_OOM
		depends on PSRAM_AS_SYS_MEMORY
		bool "Use psram_malloc at os_malloc failed."
		default n

	config PSRAM_HEAP_BASE
		depends on PSRAM_AS_SYS_MEMORY
		hex "Set psram_malloc base address"
		default 0x60700000
		help
			The psram address is from 0x60000000 to 0x60800000 for psram aps6408l_o

	config PSRAM_HEAP_CPU0_BASE_ADDER
		depends on PSRAM
		hex "Set psram_malloc base address"
		default 0x60700000

	config PSRAM_HEAP_SIZE
		depends on PSRAM_AS_SYS_MEMORY
		hex "Set psram heap size"
		default 0x80000
		help
			psram aps6408l-o
			0x100000 - 1M
			The max size is 0x800000
			The suggested option is 0x100000 or 0x200000
			psram w955d8mky-5j
			0xE0000 - 896KB
			The max size is 0x400000
			The suggested option is 0xE0000
			psram apsx256
			0x500000 - 5M
			The max size is 0x1000000
			The suggested option is 0x5000000 or 0x1000000

	config PSRAM_WRITE_THROUGH
		depends on PSRAM
		bool "Enable PSRAM write through"
		default n

	config PSRAM_CALIBRATE
		depends on PSRAM
		bool "Enable PSRAM calibrate"
		default n

	config PSRAM_AUTO_DETECT
		depends on PSRAM && EASY_FLASH && EASY_FLASH_V4
		bool "Enable PSRAM id auto detect function"
		default n

	config PSRAM_APS6408L_O
		depends on PSRAM
		bool "Select Psram PSRAM_APS6408L_O"
		default n

	config PSRAM_W955D8MKY_5J
		depends on PSRAM
		bool "Select Psram PSRAM_W955D8MKY_5J"
		default n

	config PSRAM_APS128XXO_OB9
		depends on PSRAM
		bool "Select Psram PSRAM_APS128XXO_OB9"
		default n

	config MEMORY_PRIORITIZE_PSRAM
		depends on PSRAM_AS_SYS_MEMORY
		bool "malloc relates function, prioritize malloc memory from PSRAM"
		default n

endmenu
```

## os/board/bk7239n/src/middleware/driver_mp/pwm/Kconfig
```kconfig
menu "PWM"
	config PWM
		bool "Enable pwm"
		default y

	choice PWM_VERSION
		prompt "ASIC PWM IP Version"
		default PWM_V1PX

		config PWM_V1PX
			bool "PWM_V1PX"
			help
			    "ASIC PWM IP Version V1P1:BK7236XX...,the chips MP after 2023-04"

		config PWM_V2P2
			bool "PWM_V2P2"
			help
				ASIC PWM Version ID: V2.2
	endchoice

	config PWM_PM_CB_SUPPORT
		bool "PWM PM Support"
		default n

	config PWM_PHASE_SHIFT
		bool "PWM phase shift Support"
		default n

	config PWM_FADE
		bool "PWM fade mode support"
		default n

	config PWM_TEST
		depends on PWM && DRIVER_TEST
		bool "Enable pwm test"
		default y

	config PWM_API_TEST
		depends on PWM && DRIVER_TEST
		bool "Enable pwm api test"
		default n
endmenu
```

## os/board/bk7239n/src/middleware/driver_mp/saradc/Kconfig
```kconfig
menu "SARADC"
	config SARADC
		bool "Enable saradc"
		default y

	config SARADC_NEED_FLUSH
		bool "SARADC whether need flush data"
		default y

	config SARADC_RANGE_DIVIDE
		bool "Enable saradc measure range divide"
		default n

	config SARADC_PM_CB_SUPPORT
		bool "saradc pm support"
		depends on SARADC
		default n

	config ADC_BUF_SIZE
		int "config adc receive buffer size"
		default 32

	choice SARADC_VERSION
		prompt "ASIC SARADC IP Version"
		default SARADC_V1P1

		config SARADC_V1P1
			bool "SARADC_V1P1"
			help
				ASIC SARADC Version ID: V1.1

		config SARADC_V1P2
			bool "SARADC_V1P2"
			help
				ASIC SARADC Version ID: V1.2
	endchoice

	config SARADC_V1P2_COMPATIBLE_MODE
		bool "Enable v1p2 compatible mode, and adapte the compatible interfaces"
		depends on SARADC_V1P2
		default n
endmenu	
```

## os/board/bk7239n/src/middleware/driver_mp/sd_card/Kconfig
```kconfig
menu "SDCARD"
	config SDCARD
		bool "Enable SDCARD"
		default y if (USB && USB_DEVICE)
		default n if !(USB && USB_DEVICE)

	config SDCARD_DEFAULT_CLOCK_FREQ
		int "sd card default clock freq"
		default 11

	config SDCARD_CHECK_INSERTION_EN
		bool "Whether to use pin to determine whether the sdcard is connected"
		default n

	menu "SDCARD_CHECK_INSERTION_EN"
		depends on SDCARD_CHECK_INSERTION_EN

		config SDCARD_CHECK_INSERTION_GPIO_ID
			int "Detect whether to connect the GPIO ID of the sdcard"
			default 0
	endmenu

	config SDCARD_BUSWIDTH_4LINE
		bool "Support SDCARD 4 Data Wires"
		default n

	config SDCARD_POWER_GPIO_CTRL
		depends on SDCARD
		bool "Enable SDcard power gpio ctrl"
		default n

    config SDCARD_POWER_GPIO_CTRL_AUTO_POWERDOWN_WHEN_IDLE
        depends on SDCARD_POWER_GPIO_CTRL
        bool "Enable SDcard auto powerdown when idle"
        default n

	config SDCARD_DEBUG_SUPPORT
		bool "Enable SDcard debug"
		default n
		help
			enable SDCARD debug, it will dump write and read data with SDCARD
endmenu
```
