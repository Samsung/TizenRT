## os/board/bk7239n/src/middleware/driver_mp/sdio/Kconfig
```kconfig
menu "SDIO"
	config SDIO
		bool "Enable SDIO"

	config SDIO_V1P0
		bool "SDIO Version V1P0"
		depends on SDIO
		default n
		
	config SDIO_V2P0
		bool "SDIO Version V2P0"
		default n

	config SDIO_V2P1
		bool "SDIO Version V2P1:Inherit from V2P0,SDIO Slave only, add pack/unpack payloads feature"
		depends on SDIO_SLAVE
		default n

	config SDIO_V2P2
		bool "SDIO Version V2P2:Inherit from V2P1,SDIO Slave only, add cmd auto resonse and data irq feature"
		depends on SDIO_SLAVE
		default n

	config SDIO_TRANS
		bool "Enable SDIO Trans"
		depends on SDIO_V1P0
		default n

	config REAL_SDIO
		bool "Enable Real SDIO"
		depends on SDIO_V1P0

	config SDIO_BLOCK_512
		bool "Enable SDIO 512 Bytes Block"
		depends on REAL_SDIO

	config SDIO_SLAVE
		bool "Enable SDIO Slave Device, BEKEN Chip Is A SDIO Slave Device"
		depends on SDIO
		default n

	config SDIO_CHANNEL_EN
		bool "Enable SDIO channel"
		depends on SDIO_SLAVE && (SDIO_V2P0 || SDIO_V2P1 || SDIO_V2P2)
		default n

	config SDIO_BIDIRECT_CHANNEL_EN
		bool "Enable SDIO two derect channel"
		depends on SDIO_CHANNEL_EN
		default n

	config SDIO_GDMA_EN
		bool "SDIO transfer data whether enable GDMA"
		depends on (SDIO_V2P0 || SDIO_V2P1 || SDIO_V2P2) && GENERAL_DMA
		default n

	config GPIO_NOTIFY_TRANSACTION_EN
		bool "Host Wake BK7256"
		depends on SDIO_SLAVE && (SDIO_V2P0 || SDIO_V2P1 || SDIO_V2P2)
		default y

	config SDIO_4LINES_EN
		bool "SDIO Uses 4 Lines Transfer Data"
		depends on SDIO || SDIO_HOST
		default y

	config SDIO_1V8_EN
		bool "SDIO Uses 1.8v work voltage"
		depends on SDIO || SDIO_HOST
		default n

	config SDIO_TEST_EN
		bool "SDIO Test Program Enable"
		depends on SDIO_SLAVE && (SDIO_V2P0 || SDIO_V2P1 || SDIO_V2P2)
		default n

	config SDIO_DEBUG_EN
		bool "SDIO Debug Program Enable"
		depends on SDIO_SLAVE && (SDIO_V2P0 || SDIO_V2P1 || SDIO_V2P2)
		default n

	config SDIO_PM_CB_SUPPORT
		bool "SDIO PM Support"
		default n

	config SDIO_SYNC_TRANS
		bool "SDIO sync transmit"
		default n

	config SDIO_RK3568
		bool "SDIO connect with RK3568 Host"
		default n

	config SDIO_SLAVE_RX_FLOW_CONTROL
		bool "SDIO salve rx flow control enable"
		default n

	config SDIO_CMD_AUTO_RSP_EN
		bool "SDIO salve cmd auto start enable"
		default n

	config SDIO_CMD_FIFO_CNT_EN
		bool "SDIO salve cmd buffer count enable"
		default n

endmenu
```

## os/board/bk7239n/src/middleware/driver_mp/sdio_host/Kconfig
```kconfig
menu "SDIO_HOST"
	config SDIO_HOST
		bool "Enable sdio host"
		default n

	config SDIO_HOST_DEFAULT_CLOCK_FREQ
		int "SDIO Host default clock freq"
		default 200000

	config SDIO_HOST_CLR_WRITE_INT
		bool "SDIO CLEAR WRITE INT NEED WAIT"
		default n

        config PIN_SDIO_GROUP_1
		bool "SDIO pin map select"
		default n

endmenu
```

## os/board/bk7239n/src/middleware/driver_mp/spi/Kconfig
```kconfig
menu "SPI"
	config SPI
		bool "Enable SPI"
		default y

	config SPI_DMA
		bool "Enable SPI DMA"
		default y

	config SPI_STATIS
		bool "Enable SPI Statis"
		default n
			
	config SPI_SUPPORT_TX_FIFO_WR_READY
		bool "Support TX FIFO Write Ready"
		default y

	config SPI_MST_FLASH
		bool "SPI MST Flash"
		default n

	config SPI_MST_PSRAM
		bool "SPI MST PSRAM"
		default n

	config SPI_PM_CB_SUPPORT
		bool "SPI PM Support"
		default n
	config SPI
		bool "SPI ENABLE"
		default n

	config SPI_BYTE_INTERVAL
		bool "SPI byte interval"
		default n

endmenu
```

## os/board/bk7239n/src/middleware/driver_mp/touch/Kconfig
```kconfig
menu "TOUCH"
	config TOUCH
		bool "Enable TOUCH"
		default n
	config TOUCH_INTERNAL_SERIAL_CAP
		bool "Enable TOUCH INTERNAL SERIAL CAP"
		default n
	config TOUCH_PM_SUPPORT
		bool "Enable TOUCH PM SUPPORT"
		default n
endmenu
	
```
