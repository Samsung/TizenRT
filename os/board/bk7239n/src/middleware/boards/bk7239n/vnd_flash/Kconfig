## os/board/bk7239n/src/middleware/boards/bk7239n/vnd_flash/Kconfig
```kconfig
menu "Boards::Bk7239::Vnd_flash"
	config OVERRIDE_FLASH_PARTITION
		bool "Enable Override Flash Partition"
		default n
endmenu
```

## os/board/bk7239n/src/middleware/compal/Kconfig
```kconfig
menu "Compal"

	config COMMON_IO
		depends on FREERTOS_V10
		bool "Enable Common Io"
		default n
		help
			Amazon Common IO

endmenu
```

## os/board/bk7239n/src/middleware/driver/Kconfig
```kconfig
menu "Driver"
    source "/root/tizenrt/os/board/bk7239n/src/middleware/driver/device/Kconfig"
    source "/root/tizenrt/os/board/bk7239n/src/middleware/driver/wdt/Kconfig"
    #source "/root/tizenrt/os/board/bk7239n/src/middleware/driver/aon_wdt/Kconfig"
    source "/root/tizenrt/os/board/bk7239n/src/middleware/driver/uart/Kconfig"
    source "/root/tizenrt/os/board/bk7239n/src/middleware/driver/trng/Kconfig"
    # source "/root/tizenrt/os/board/bk7239n/src/middleware/driver/sdio_host/Kconfig"
    # source "/root/tizenrt/os/board/bk7239n/src/middleware/driver/sd_card/Kconfig"
    #source "/root/tizenrt/os/board/bk7239n/src/middleware/driver/fatfs/Kconfig"
    # source "/root/tizenrt/os/board/bk7239n/src/middleware/driver/sdio/Kconfig"
    source "/root/tizenrt/os/board/bk7239n/src/middleware/driver/spi/Kconfig"
    # source "/root/tizenrt/os/board/bk7239n/src/middleware/driver/qspi/Kconfig"
    source "/root/tizenrt/os/board/bk7239n/src/middleware/driver/rtc/Kconfig"
    source "/root/tizenrt/os/board/bk7239n/src/middleware/driver/gpio/Kconfig"
    source "/root/tizenrt/os/board/bk7239n/src/middleware/driver/pmu/Kconfig"
    source "/root/tizenrt/os/board/bk7239n/src/middleware/driver/general_dma/Kconfig"
    # source "/root/tizenrt/os/board/bk7239n/src/middleware/driver/touch/Kconfig"
    source "/root/tizenrt/os/board/bk7239n/src/middleware/driver/sbc/Kconfig"
    # source "/root/tizenrt/os/board/bk7239n/src/middleware/driver/jpeg_enc/Kconfig"
    # source "/root/tizenrt/os/board/bk7239n/src/middleware/driver/jpeg_dec/Kconfig"
    source "/root/tizenrt/os/board/bk7239n/src/middleware/driver/psram/Kconfig"
    source "/root/tizenrt/os/board/bk7239n/src/middleware/driver/calendar/Kconfig"
    source "/root/tizenrt/os/board/bk7239n/src/middleware/driver/sys_ctrl/Kconfig"
    source "/root/tizenrt/os/board/bk7239n/src/middleware/driver/phy/Kconfig"
    source "/root/tizenrt/os/board/bk7239n/src/middleware/driver/i2s/Kconfig"
    source "/root/tizenrt/os/board/bk7239n/src/middleware/driver/i2c/Kconfig"
    #source "/root/tizenrt/os/board/bk7239n/src/middleware/driver/audio/Kconfig"
    source "/root/tizenrt/os/board/bk7239n/src/middleware/driver/pwm/Kconfig"
    source "/root/tizenrt/os/board/bk7239n/src/middleware/driver/icu/Kconfig"
    source "/root/tizenrt/os/board/bk7239n/src/middleware/driver/timer/Kconfig"
    source "/root/tizenrt/os/board/bk7239n/src/middleware/driver/saradc/Kconfig"
    source "/root/tizenrt/os/board/bk7239n/src/middleware/driver/flash/Kconfig"
    #source "/root/tizenrt/os/board/bk7239n/src/middleware/driver/h264/Kconfig"
    source "/root/tizenrt/os/board/bk7239n/src/middleware/driver/sdmadc/Kconfig"
    source "/root/tizenrt/os/board/bk7239n/src/middleware/driver/pwr_clk/Kconfig"
    source "/root/tizenrt/os/board/bk7239n/src/middleware/driver/vault/Kconfig"
    source "/root/tizenrt/os/board/bk7239n/src/middleware/driver/otp/Kconfig"
    source "/root/tizenrt/os/board/bk7239n/src/middleware/driver/fft/Kconfig"
    #source "/root/tizenrt/os/board/bk7239n/src/middleware/driver/hw_rotate/Kconfig"
    #source "/root/tizenrt/os/board/bk7239n/src/middleware/driver/yuv_buf/Kconfig"
    #source "/root/tizenrt/os/board/bk7239n/src/middleware/driver/lcd/Kconfig"
    #source "/root/tizenrt/os/board/bk7239n/src/middleware/driver/irda/Kconfig"
    source "/root/tizenrt/os/board/bk7239n/src/middleware/driver/reset_reason/Kconfig"
    source "/root/tizenrt/os/board/bk7239n/src/middleware/driver/efuse/Kconfig"
    #source "/root/tizenrt/os/board/bk7239n/src/middleware/driver/mailbox/Kconfig"
    #source "/root/tizenrt/os/board/bk7239n/src/middleware/driver/tp/Kconfig"
    #source "/root/tizenrt/os/board/bk7239n/src/middleware/driver/dma2d/Kconfig"
    #source "/root/tizenrt/os/board/bk7239n/src/middleware/driver/chip_support/Kconfig"
    #source "/root/tizenrt/os/board/bk7239n/src/middleware/driver/eth/Kconfig"
    source "/root/tizenrt/os/board/bk7239n/src/middleware/driver/ckmn/Kconfig"
    #source "/root/tizenrt/os/board/bk7239n/src/middleware/driver/hw_scale/Kconfig"
    #source "/root/tizenrt/os/board/bk7239n/src/middleware/driver/lin/Kconfig"
    #source "/root/tizenrt/os/board/bk7239n/src/middleware/driver/scr/Kconfig"
    #source "/root/tizenrt/os/board/bk7239n/src/middleware/driver/jpeg_dec/Kconfig"
    #source "/root/tizenrt/os/board/bk7239n/src/middleware/driver/slcd/Kconfig"
    source "/root/tizenrt/os/board/bk7239n/src/middleware/driver/io_matrix/Kconfig"
endmenu
```

## os/board/bk7239n/src/middleware/driver/audio/Kconfig
```kconfig
menu "AUDIO"
	config AUDIO
		bool "Enable Audio"
		default n

	config AUDIO_ADC
		depends on AUDIO
		bool "Enable audio adc driver"
		default n

	config AUDIO_DMIC
		depends on AUDIO
		bool "Enable audio dmic driver"
		default n

	config AUDIO_DTMF
		depends on AUDIO
		bool "Enable audio dtmf driver"
		default n

	config AUDIO_DAC
		depends on AUDIO
		bool "Enable audio dac driver"
		default n

    config AUDIO_RING_BUFF
        bool "Enable Audio Ring Buff"
		default y
		help
			Enable Audio ring buffer

	config ES8311
		depends on SIM_I2C
		depends on I2S
		bool "Enable audio codec chip ES8311 driver"
		default n
endmenu
```

## os/board/bk7239n/src/middleware/driver/ckmn/Kconfig
```kconfig
menu "CKMN"
	config CKMN
		bool "Enable CKMN"
		default n

	config CKMN_TEST
		depends on CKMN && DRIVER_TEST
		bool "Enable ckmn test"
		default n
endmenu
```

## os/board/bk7239n/src/middleware/driver/device/Kconfig
```kconfig
menu "device"
	config DEVICE_MAX_NAME_LEN
		int "Set maximum device name length"
		default 32

	config DM
		bool "Enable device model"
		default n
endmenu
```

## os/board/bk7239n/src/middleware/driver/flash/Kconfig
```kconfig
menu "FLASH"
	config FLASH
		bool "Enable flash"
		default y

	config FLASH_QUAD_ENABLE
		bool "Enable flash quad enable"
		default n
		
	config FLASH_SRC_CLK_60M
		bool "Enable flash source clock 60M"
		default n

	config FLASH_MB
		bool "Enable flash mailbox channel"
		default n
	config FLASH_FORBID_OPERATE_BOOTLADER
		bool "Enable operate bootloader flash"
		default y

	config FLASH_WRITE_STATUS_VOLATILE
		bool "Enable write volatile status register"
		default n
endmenu
```

## os/board/bk7239n/src/middleware/driver/general_dma/Kconfig
```kconfig
menu "GENERAL_DMA"
	config GENERAL_DMA
		bool "Enable General DMA"
		default y

	choice GDMA_HW_VERSION
		prompt "GDMA HW version in ASIC"
		default GDMA_HW_V1PX

		config GDMA_HW_V2PX
			bool "GDMA HW version v2px in ASIC"

		config GDMA_HW_V1PX
			bool "GDMA HW version v1px in ASIC"
	endchoice

	config DMA_LOGIC_CHAN_CNT
		depends on GDMA_HW_V2PX
		int "dma-logic-channels count"
		default 4 if GDMA_HW_V2PX
		---help---
			Current CPU-CORE software system uses how many dma-logic-channels.
			Total of all CPU-COREs dma logic chan count should be not bigger then total dma hardware supportted channels

	config DMA_LOGIC_CHAN_ID_MIN
		depends on GDMA_HW_V2PX
		int "Current CPU-CORE software system min dma-logic-channel-id."
		default 0 if GDMA_HW_V2PX
		---help---
			Current CPU-CORE software system min dma-logic-channel-id.
			Be care overlap the other CPU-CORE software system's dma-logic-channel-id.
			The value should be set like this:
			CPU0 is from 0;
			CPU1 is from CPU0_DMA_LOGIC_CHAN_CNT
			CPU2 is from CPU0_DMA_LOGIC_CHAN_CNT + CPU1_DMA_LOGIC_CHAN_CNT

endmenu
```

## os/board/bk7239n/src/middleware/driver/hw_rotate/Kconfig
```kconfig
menu "HW_ROTATE"
	config HW_ROTATE_PFC
		bool "Enable hw rotate and pixel convert module"
		default n
endmenu
```

## os/board/bk7239n/src/middleware/driver/hw_scale/Kconfig
```kconfig
menu "HW_SCALE"
	config HW_SCALE
		bool "Enable hw scale module"
		default n
endmenu
```

## os/board/bk7239n/src/middleware/driver/i2c/Kconfig
```kconfig
menu "I2C"
	config I2C
		bool "Enable I2C"
		default y

	config I2C_SUPPORT_ID_BITS
		int "i2c support id bits"
		range 1 255
		default 1
		help
		The value should be changed if need to change i2c id

	config FM_I2C
		bool "Enable FM I2C"
		default y

	config SIM_I2C
		bool "Enable GPIO Simulate I2C"
		default n

	config I2C_PM_CB_SUPPORT
		bool "i2c pm support"
		depends on I2C
		default n

	config SIM_I2C_HW_BOARD_V3
		bool "sim i2c with bk7258 hardware board v3"
		default y

	config I2C_DIRECT_DRIVE_MODE
		bool "Direct drive mode setting"
		default y
endmenu
```

## os/board/bk7239n/src/middleware/driver/icu/Kconfig
```kconfig
menu "ICU"
	config ICU_GPIO
		bool "Enable icu gpio"
		default n
endmenu

menu "Interrupt"
	config ISR_REG_DISABLE
		bool "Disable irq"
		default n
endmenu
```

## os/board/bk7239n/src/middleware/driver/io_matrix/Kconfig
```kconfig
menu "io_matrix"
	config SUPPORT_IO_MATRIX
		bool "Enable iO Mux Feature"
		default n

	config IO_MATRIX_VER1_0
		bool "IO Mux Ver1.0 Feature, For Instance: bk7259"
		default n

	config IO_MATRIX_VER2_0
		bool "IO Mux Ver2.0 Feature, For Instance: bk7236n,bk7236q"
		default n

	config IOMX_TEST
		depends on SUPPORT_IO_MATRIX && DRIVER_TEST
		bool "Enable io-mux test"
		default y
endmenu
```

## os/board/bk7239n/src/middleware/driver/lcd/Kconfig
```kconfig
menu "LCD"
	config LCD
		bool "Enable LCD"
		default n

	config LCD_QSPI
		bool "Enable LCD QSPI"
		default n

	config LCD_QSPI_COLOR_DEPTH_BYTE
		depends on LCD_QSPI
		int "Set Lcd Qspi Color Depth"
		default 3
		help
			2 - RGB565
			3 - RGB888

	config LCD_POWER_GPIO_CTRL
		bool "Enable lcd power gpio ctrl"
		default n

	config LCD_BACKLIGHT_GPIO_CTRL
		bool "Enable lcd backlight gpio ctrl"
		default n
endmenu
```

## os/board/bk7239n/src/middleware/driver/otp/Kconfig
```kconfig
menu "OTP"
	config OTP
		bool "Enable OTP"
		default n

	config PHY_RFCALI_TO_OTP
		bool "Enable rfcali_to_otp"
		default n
		help
			Use OTP to save rfcali data

endmenu
```

## os/board/bk7239n/src/middleware/driver/pmu/Kconfig
```kconfig
menu "AON_PMU"
	config AON_PMU
		bool "Enable AON_PMU"
		default n

	config AON_PMU_TEST
		depends on AON_PMU && DRIVER_TEST
		bool "Enable Aon Pmu Test"
		default n

	config AON_PMU_REG0_REFACTOR_DEV
		bool "For aon pmu reg0 refactor"
		default n

	config AON_PMU_POR_TIMING_SUPPORT
		bool "Por power failure timing"
		default n

endmenu
```

## os/board/bk7239n/src/middleware/driver/psram/Kconfig
```kconfig
menu "PSRAM"
	config PSRAM
		bool "Enable PSRAM"
		default n

	config PSRAM_AS_SYS_MEMORY
		depends on PSRAM
		bool "Enable psram_malloc API"
		default n

	config USE_PSRAM_HEAP_AT_SRAM_OOM
		depends on PSRAM_AS_SYS_MEMORY
		bool "Use psram_malloc at os_malloc failed."
		default n

	config PSRAM_WRITE_THROUGH
		depends on PSRAM
		bool "Enable PSRAM write through"
		default n

	config PSRAM_CALIBRATE
		depends on PSRAM
		bool "Enable PSRAM calibrate"
		default n

	config PSRAM_AUTO_DETECT
		depends on PSRAM && EASY_FLASH && EASY_FLASH_V4
		bool "Enable PSRAM id auto detect function"
		default n

	config PSRAM_APS6408L_O
		depends on PSRAM
		bool "Select Psram PSRAM_APS6408L_O"
		default n

	config PSRAM_W955D8MKY_5J
		depends on PSRAM
		bool "Select Psram PSRAM_W955D8MKY_5J"
		default n

	config PSRAM_APS128XXO_OB9
		depends on PSRAM
		bool "Select Psram PSRAM_APS128XXO_OB9"
		default n

	config MEMORY_PRIORITIZE_PSRAM
		depends on PSRAM_AS_SYS_MEMORY
		bool "malloc relates function, prioritize malloc memory from PSRAM"
		default n

endmenu
```

## os/board/bk7239n/src/middleware/driver/pwr_clk/Kconfig
```kconfig
menu "PWR_CLK"
	config EXTERN_32K
		bool "Use an external 32k crystal"
		default n
	config MEM_AUTO_POWER_DISABLE
		bool "mem auto power disable"
		default n
	config CP1_AUTO_POWER_DISABLE
		bool "cp1 auto power disable"
		default n
	config CPU_DEFAULT_FREQ_60M
		bool "set cpu default frequency 60M"
		default n
	config RESERVE_1K_SRAM_UNINITIAL
		bool "reserve 1k sram uninitialized"
		default n
	config LPO_SRC_26M32K
		bool "32k use the 26m divide"
		default n
	config BUCK_ENABLE
		bool "buck enable"
		default n
	config BUCK_ANALOG_DISABLE
		depends on BUCK_ENABLE
		bool "buck disable analog"
		default n
	config BAKP_POWER_DOMAIN_DISABLE
		 bool "bakp power domain disable"
		default n
	config BAKP_POWER_DOMAIN_PM_CONTROL
		 bool "used for PM control of bakp domain power on and off"
		default n
	config AHBP_POWER_DOMAIN_LV_DISABLE
		 bool "ahbp power domain disable"
		default n
	config PSRAM_POWER_DOMAIN_LV_DISABLE
		 bool "psram power domain disable"
		default n
	config DCO_CLK_ENABLE
		bool "Enable dco clk"
		default n
	config EXTERN_32K_PIN_MULT
		 bool "extern32k pin multiplexing"
		default n
	config CLI_CODE_SIZE_OPTIMIZE_ENABLE
		 bool "cli command code size optimize"
		default n
	config VBSPBUFLP1V_ENABLE
		 bool "enable vbspbuflp1v"
	config LV_FLASH_ENTER_LP_ENABLE
		 bool "flash enter low power mode when enter low voltage"
		default n
	config SMP_CPU1_DISABLE
		 bool "not enalbe the cpu1 when using the SMP"
		default n
	config LPO_MP_A_FORCE_USE_EXT32K
		 bool "MP_A force use the external 32k"
		default n
	config ROSC_CALIB_SW
		 bool "enable calibrate rc32k by software"
		default n
	config ROSC_COMPENSATION
		 bool "enable rosc compensation for rtc tick"
		default n
	config LP_VOL
		hex "Set Low power voltage value"
		default 0x6
		help
			Set Low power voltage default value 0.6v(0.45+0.025*6)
			This value should not be configured arbitrarily. Prior discussion with the chip vendor's support engineers is required before configuration
	config DIGLDO_LOW_VOLTAGE_ENABLE
		 bool "enable dig ldo low voltage "
		default y
	config AUTO_DETECT_32K_SOURCE
		 bool "auto detect 32k source"
		default n
	config CLK_FORCE_MAX_CPU_FREQ_320M
		 bool "force max cpu frequency 320M"
		default n
	config PM_26M_STABILITY_DELAY_TIME_HARDWARE
		 int "26M CRYSTAL HARDWARE STABILITY DELAY TIME"
		default 1300
		help
			config the 26M crystal hardware stability time
	config PHY_PWD
		bool "Enable Phy power down in lv sleep, used for bk7236n,bk7239n,bk7236q"
		default n
	config MAC_PWD
		bool "Enable Mac power down in lv sleep, used for bk7236n,bk7239n,bk7236q"
		default n
	config WRLS_PWD
		bool "Enable wrls power down in lv sleep, used for bk7259"
		default n
	config SOFT_CTRL_VOLT
		bool "Reduce vdddig by software in lv sleep"
		default n
	config KEEP_VDDDIG_VOLT_IN_LV
		bool "vdddig voltage in lv keep as active"
		default n
	config NORMAL_SLEEP_ULTRA_LOW_POWER
		bool "ultra low power of normal sleep"
		default n
	config MAC_USE_RTC
		bool "mac use rtc during lv sleep"
		default n        
endmenu
```

## os/board/bk7239n/src/middleware/driver/qspi/Kconfig
```kconfig
menu "QSPI"
		config QSPI
			bool "Enable QSPI"
			default n

		config QSPI_STATIS
			bool "Enable QSPI Statis"
			default y

		config QSPI_FLASH_GD
			bool "Enable GD Flash"
			default n
endmenu
```

## os/board/bk7239n/src/middleware/driver/reset_reason/Kconfig
```kconfig
menu "RESET_REASON"
	config RESET_REASON
		bool "Enable reset reason"
		default y
endmenu
```
