;--------------------------------------------------------------------------
;
; Copyright 2016 Samsung Electronics All Rights Reserved.
;
; Licensed under the Apache License, Version 2.0 (the "License");
; you may not use this file except in compliance with the License.
; You may obtain a copy of the License at
;
; http://www.apache.org/licenses/LICENSE-2.0
;
; Unless required by applicable law or agreed to in writing,
; software distributed under the License is distributed on an
; "AS IS" BASIS, WITHOUT WARRANTIES OR CONDITIONS OF ANY KIND,
; either express or implied. See the License for the specific
; language governing permissions and limitations under the License.
;
;--------------------------------------------------------------------------
Res
Sys.res

Sys.multicore DAPIRPOST 0.
Sys.multicore DAPDRPOST 0.
Sys.multicore DAPIRPRE 0.
Sys.multicore DAPDRPRE 0.

Sys.CPU CortexR4
Sys.JtagClock 10MHz
Sys.Option ResBreak off
Sys.Option EnReset on

Sys.Config.MEMORYACCESSPORT 0
Sys.Config.DEBUGACCESSPORT 0

Sys.Config.COREBASE 0x80001000

Sys.up

Sys.mode.attach

if run()
   break

;watchdog 
d.s 0x18020634 %LE %LONG 0x0

;clock
d.s 0x180001e0 %LE %LONG (d.l(d:0x180001e0)|0x20)

d.load.elf Y:\data1\tinyara\tinyara\build\bin\tinyara

enddo
