;--------------------------------------------------------------------------
;
; Copyright 2016 Samsung Electronics All Rights Reserved.
;
; Licensed under the Apache License, Version 2.0 (the "License");
; you may not use this file except in compliance with the License.
; You may obtain a copy of the License at
;
; http://www.apache.org/licenses/LICENSE-2.0
;
; Unless required by applicable law or agreed to in writing,
; software distributed under the License is distributed on an
; "AS IS" BASIS, WITHOUT WARRANTIES OR CONDITIONS OF ANY KIND,
; either express or implied. See the License for the specific
; language governing permissions and limitations under the License.
;
;--------------------------------------------------------------------------
;------------------------------
;  Configuring JTAG interface
;-----------------------------

AREA.RESet
AREA.CREATE
AREA.SELECT
AREA.VIEW

LOCAL &BASE_DIR
&DIR=OS.PPD()			; get current dir
&BASE_DIR="&DIR"

ENTRY &image_file &image_size &dest_addr

SYStem.Option ResBreak OFF
SYStem.Option WaitReset 300.ms 
SYStem.Option EnReset OFF
SYStem.Option IMASKASM ON
SYStem.Option IMASKHLL ON
System.JtagClock 500Khz

print "s5jt200 evt0 jtag start.."

System.CPU CortexR4

Sys.Config.COREBASE 0x801E0000 ; R4
;Sys.Config.CTIBASE 0x80820000

System.Config AXIACCESSPORT 0.
System.Config DEBUGACCESSPORT 1.
System.Config MEMORYACCESSPORT 5.

Sys.attach
B.Select.Program Onchip

if run()
	break
;print "Disable Watchdog Reset"
d.s SD:0x80030000 %LE %LONG 0x0

wait 0.2s
LOCAL &BASE_DIR
&DIR=OS.PPD()			; get current dir
&BASE_DIR="&DIR"

;------------------------------
; S5JT200 FLASH FUSING MAP (16.08.18)
; nBl1, tinyara, wlbt F/W
;-----------------------------

&FLASH_BASE=0x04000000

&BL1_FLASH_START=0x04000000
&tinyARA_FLASH_START=0x04004000	
&wlbt_FW_FLASH_START=0x04304000 ; 256KB ->0x04344000
&sss_FW_FLASH_START=0x04344000 ; 64KB ->0x04354000
&led_FW_FLASH_START=0x04354000 ; 64KB  -> 0x04364000

&BL1_FLASH_FILE="&BASE_DIR\..\..\..\configs\sidk_s5jt200\boot_bin\t20.nbl1.bin"
&tinyARA_FLASH_FILE="&BASE_DIR\..\..\..\output\bin\tinyara_head.bin"
&wlbt_FW_FLASH_FILE="&BASE_DIR\..\..\..\configs\sidk_s5jt200\boot_bin\t20.wlbt.bin"
&sss_FW_FLASH_FILE=
&led_FW_FLASH_FILE=


GOSUB	flash_init
GOSUB	flash_erase	&BL1_FLASH_FILE &BL1_FLASH_START

enddo
;-----------------------------------------
flash_init:
	R.S PC 0x02020000
	print "Initialize Serial Flash Interface..."
	d.s SD:0x80040020 %LE %LONG 0x00222222 ;;GPCON
	d.s SD:0x80040028 %LE %LONG 0x00333333 ;;GPPUD
	d.s SD:0x80310004 %LE %LONG 0x8010001A ;;Disable WP

	RETURN		

;-----------------------------------------
flash_write:

	ENTRY &file &fstart 
	LOCAL &temp &write_size &target_addr &end_addr
	&write_size=OS.FILE.SIZE(&file)
	print &fstart
	&target_addr=&fstart-&FLASH_BASE
	&end_addr=&target_addr+&write_size
	print "Logical Flash Address :0x" &target_addr
	print "Memory Map in Flash Addr 0x" &fstart 	
	while &target_addr<&end_addr
	(
		 d.s SD:0x80310010 %LE %LONG &target_addr ;;Erase Address(base 0x0 -- mapped 0x0400_0000)
		 d.s SD:0x8031005E %BYTE 0xFF ;;Sector Erase
		 &target_addr=&target_addr+0x1000
		 print "Erase Flash :0x" &target_addr
		 ;print "remain :0x" &write_size-&target_addr
	)	
	wait 0.8s
	;READ SERIAL FLASH ID
	&temp=DATA.LONG(SD:0x803100AC)
	print "flash value SD:0x803100AC:" &temp
	d.load.b &file &fstart

	RETURN


;-----------------------------------------
flash_erase:
	ENTRY &file &fstart 
	LOCAL &temp &write_size &target_addr &end_addr
	&write_size=OS.FILE.SIZE(&file)
	print &fstart
	&target_addr=&fstart-&FLASH_BASE
	&end_addr=&target_addr+&write_size
	print "Logical Flash Address :0x" &target_addr
	print "Memory Map in Flash Addr 0x" &fstart 	
	while &target_addr<&end_addr
	(
		 d.s SD:0x80310010 %LE %LONG &target_addr ;;Erase Address(base 0x0 -- mapped 0x0400_0000)
		 d.s SD:0x8031005E %BYTE 0xFF ;;Sector Erase
		 &target_addr=&target_addr+0x1000
		 print "Erase Flash :0x" &target_addr
		 ;print "remain :0x" &write_size-&target_addr
	)	
	wait 0.8s
	;READ SERIAL FLASH ID
	&temp=DATA.LONG(SD:0x803100AC)
	RETURN
enddo
