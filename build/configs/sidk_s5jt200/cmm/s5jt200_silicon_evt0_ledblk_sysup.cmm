;--------------------------------------------------------------------------
;
; Copyright 2016 Samsung Electronics All Rights Reserved.
;
; Licensed under the Apache License, Version 2.0 (the "License");
; you may not use this file except in compliance with the License.
; You may obtain a copy of the License at
;
; http://www.apache.org/licenses/LICENSE-2.0
;
; Unless required by applicable law or agreed to in writing,
; software distributed under the License is distributed on an
; "AS IS" BASIS, WITHOUT WARRANTIES OR CONDITIONS OF ANY KIND,
; either express or implied. See the License for the specific
; language governing permissions and limitations under the License.
;
;--------------------------------------------------------------------------

system.option resbreak off
system.option enreset off
system.option trst off

system.jc 500KHz
system.cpu cortexm0
sys.config memoryaccessport 0x20
sys.config ahbaccessport 0x20
sys.config coredebug.base E:0xE00FF000

system.up

;d.load.elf * /nocode /include

data.load.elf "U:\work\tinyara_t20\tinyara\os\arch\arm\src\s5j\soc\ledblk_fw\apps\build_result.elf" /nocode /gcc3 /gnu /strippart 3. /path "U:\"
