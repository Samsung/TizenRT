;--------------------------------------------------------------------------
;
; Copyright 2016 Samsung Electronics All Rights Reserved.
;
; Licensed under the Apache License, Version 2.0 (the "License");
; you may not use this file except in compliance with the License.
; You may obtain a copy of the License at
;
; http://www.apache.org/licenses/LICENSE-2.0
;
; Unless required by applicable law or agreed to in writing,
; software distributed under the License is distributed on an
; "AS IS" BASIS, WITHOUT WARRANTIES OR CONDITIONS OF ANY KIND,
; either express or implied. See the License for the specific
; language governing permissions and limitations under the License.
;
;--------------------------------------------------------------------------
;------------------------------
;  Configuring JTAG interface
;-----------------------------
SYStem.Option ResBreak OFF
SYStem.Option WaitReset 100.ms
SYStem.Option EnReset OFF
SYStem.Option IMASKASM ON
SYStem.Option IMASKHLL ON
System.JtagClock 3MHz

print "s5jt200 evt0 jtag start.."

System.CPU CortexR4

Sys.Config.COREBASE 0x801E0000 ; R4
;Sys.Config.CTIBASE 0x80820000

System.Config AXIACCESSPORT 64.
System.Config DEBUGACCESSPORT 1.
System.Config MEMORYACCESSPORT 5.

Sys.attach
B.Select.Program Onchip

if run()
	break

wait 0.2s

LOCAL &skip_sysup
&skip_sysup="n"

if ("&skip_sysup"=="n")
(
	area
	print "loading Symbol Info"
	d.load.elf ../../../output/bin/*tinyara /nocode
	print "Source Path"
	y.spath.srd ../../../../../*
	r.s PC 0x04004020
	b.s os_start
	;go
	;wait !run()
	;b.d os_start
)
d.l

