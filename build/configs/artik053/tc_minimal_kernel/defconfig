## build/configs/imxrt1050-evk/nxp_demo/defconfig
```kconfig
# CONFIG_ARCH_RAMFUNCS is not set
CONFIG_ARCH="arm"
CONFIG_ARCH_BOARD="imxrt1050-evk"
CONFIG_ARCH_BOARD_IMXRT1050_EVK=y
CONFIG_ARCH_CHIP_IMXRT=y
CONFIG_ARCH_CHIP_MIMXRT1052DVL6A=y
CONFIG_ARCH_STACKDUMP=y
CONFIG_ARMV7M_DCACHE=y
CONFIG_ARMV7M_DCACHE_WRITETHROUGH=y
CONFIG_ARMV7M_ICACHE=y
CONFIG_ARMV7M_DTCM=y
CONFIG_ARMV7M_LAZYFPU=y
CONFIG_ARMV7M_USEBASEPRI=y
CONFIG_ARMV7M_MPU=y
CONFIG_BOARD_LOOPSPERMSEC=104926
CONFIG_FS_PROCFS=y
CONFIG_IDLETHREAD_STACKSIZE=2048
CONFIG_IMXRT_LPUART1=y
CONFIG_INTELHEX_BINARY=y
CONFIG_LPUART1_SERIAL_CONSOLE=y
CONFIG_MAX_TASKS=16
CONFIG_MAX_WDOGPARMS=2
CONFIG_NFILE_DESCRIPTORS=8
CONFIG_NFILE_STREAMS=8
CONFIG_TINYARA_USERSPACE=0x60200000
CONFIG_PASS1_BUILDIR="configs/imxrt1050-evk/kernel"
CONFIG_PREALLOC_MQ_MSGS=4
CONFIG_PREALLOC_WDOGS=16
CONFIG_RAM_SIZE=524288
CONFIG_RAM_START=0x20200000
CONFIG_RAM_REGIONx_SIZE="524288"
CONFIG_RAM_REGIONx_START="0x20200000"
CONFIG_SCHED_WAITPID=y
CONFIG_START_DAY=8
CONFIG_START_MONTH=6
CONFIG_SYSTEM_TZSH=y
CONFIG_SYS_RESERVED=8
CONFIG_USER_ENTRYPOINT="nxp_demo_sample_main"
CONFIG_ENTRY_MANUAL=y
CONFIG_EXAMPLES_NXP_DEMO=y
CONFIG_IOTBUS=n
```

## build/configs/qemu-mps2-an505/loadable_elf/defconfig
```kconfig
#
# qemu-mps2-an505 protected loadable ELF configuration
#

CONFIG_DOCKER_VERSION="2.0.1"
CONFIG_HOST_LINUX=y

CONFIG_APPS_DIR="../apps"
CONFIG_FRAMEWORK_DIR="../framework"
CONFIG_TOOLS_DIR="../tools"
CONFIG_APP_BINARY_SEPARATION=y
CONFIG_BUILD_PROTECTED=y
CONFIG_BUILD_2PASS=y
CONFIG_PASS1_TARGET="all"
CONFIG_PASS1_OBJECT=""
CONFIG_BOARD_BUILD_DATE="260409"
CONFIG_RAW_BINARY=y

CONFIG_ARCH_HAVE_CUSTOMOPT=y
CONFIG_DEBUG_NOOPT=y

CONFIG_ARCH_ARM=y
CONFIG_ARCH="arm"
CONFIG_ARCH_CHIP_QEMU_MPS2_AN505=y
CONFIG_ARCH_CHIP="qemu-mps2-an505"
CONFIG_ARCH_BOARD_QEMU_MPS2_AN505=y
CONFIG_ARCH_BOARD="qemu-mps2-an505"
CONFIG_ARCH_CORTEXM33=y
CONFIG_ARCH_ARMV8M_FAMILY=y
CONFIG_ARCH_FAMILY="armv8-m"
CONFIG_ARM_CMNVECTOR=y
CONFIG_ARMV8M_SECURE_STATE=y
CONFIG_ARCH_HAVE_CMNVECTOR=y
CONFIG_ARMV8M_TOOLCHAIN_GNU_EABIL=y
CONFIG_ARMV8M_USEBASEPRI=y
CONFIG_ARCH_INTERRUPTSTACK=0
CONFIG_ARCH_NESTED_IRQ_STACK_SIZE=512
CONFIG_ARCH_HAVE_RESET=y
CONFIG_ARCH_HAVE_UART0=y
CONFIG_ARCH_HAVE_SERIAL_TERMIOS=y
CONFIG_ARM_MPU=y
CONFIG_ARMV8M_MPU=y
CONFIG_ARMV8M_MPU_NREGIONS=16
CONFIG_ARCH_USE_MPU=y

CONFIG_QEMU_MPS2_AN505_PROFILE_BK7239N=y
CONFIG_QEMU_MPS2_AN505_SECURE_STATE=y
CONFIG_QEMU_MPS2_AN505_CPU_CLOCK=25000000
CONFIG_QEMU_MPS2_AN505_UART_CLOCK=25000000
CONFIG_QEMU_MPS2_AN505_CMSDK_UART=y
CONFIG_QEMU_MPS2_AN505_TESTFS=y
CONFIG_QEMU_MPS2_AN505_LOADABLE_LOADER=y
CONFIG_BOARD_LOOPSPERMSEC=22222

CONFIG_BOOT_RUNFROMFLASH=y
CONFIG_FLASH_VSTART=0x28000000
CONFIG_FLASH_START_ADDR=0x28000000
CONFIG_FLASH_VSTART_LOADABLE=0x28080000
CONFIG_FLASH_SIZE=4194304
CONFIG_FLASH_PARTITION=y
CONFIG_FLASH_MINOR=0
CONFIG_FLASH_PART_SIZE="512,512,512,512,512,512,1016,8,"
CONFIG_FLASH_PART_TYPE="kernel,bin,bin,kernel,bin,bin,smartfs,bootparam,"
CONFIG_FLASH_PART_NAME="kernel,common,app1,kernel,common,app1,userfs,bootparam,"
CONFIG_RAM_START=0x00200000
CONFIG_RAM_VSTART=0x00200000
CONFIG_RAM_SIZE=2097152
CONFIG_RAM_KREGIONx_START="0x00200000"
CONFIG_RAM_KREGIONx_SIZE="2097152"

CONFIG_LIB_BOARDCTL=y
CONFIG_BOARDCTL_IOCTL=y
CONFIG_BOARDCTL_RESET=y
CONFIG_BOARD_INITIALIZE=y
CONFIG_BOARD_INITTHREAD=y
CONFIG_BOARD_INITTHREAD_STACKSIZE=2048
CONFIG_BOARD_INITTHREAD_PRIORITY=240

CONFIG_USEC_PER_TICK=1000
CONFIG_SYSTEM_TIME64=y
CONFIG_CLOCK_MONOTONIC=y
CONFIG_START_YEAR=2010
CONFIG_START_MONTH=5
CONFIG_START_DAY=8
CONFIG_SCHED_ATEXIT=y
CONFIG_SCHED_ONEXIT=y
CONFIG_MAX_WDOGPARMS=2
CONFIG_PREALLOC_WDOGS=8
CONFIG_WDOG_INTRESERVE=1
CONFIG_PREALLOC_TIMERS=4
CONFIG_INIT_ENTRYPOINT=y
CONFIG_IRQCOUNT=y
CONFIG_TASK_NAME_SIZE=31
CONFIG_MAX_TASKS=64
CONFIG_SCHED_WAITPID=y

CONFIG_DEV_CONSOLE=y
CONFIG_FDCLONE_STDIO=y
CONFIG_SDCLONE_DISABLE=y
CONFIG_NFILE_DESCRIPTORS=32
CONFIG_NFILE_STREAMS=8
CONFIG_NAME_MAX=32
CONFIG_PRIORITY_INHERITANCE=y

CONFIG_IDLETHREAD_STACKSIZE=1024
CONFIG_USERMAIN_STACKSIZE=2048
CONFIG_PTHREAD_STACK_MIN=256
CONFIG_PTHREAD_STACK_DEFAULT=2048
CONFIG_PTHREAD_MUTEX_TYPES=y
CONFIG_PTHREAD_MUTEX_ROBUST=y
CONFIG_NPTHREAD_KEYS=4
CONFIG_NPTHREAD_DESTRUCTOR_ITERATIONS=4
# CONFIG_DISABLE_PTHREAD is not set
# CONFIG_DISABLE_SIGNALS is not set
# CONFIG_DISABLE_MQUEUE is not set
CONFIG_SIG_SIGUSR1=1
CONFIG_SIG_SIGUSR2=2
CONFIG_SIG_SIGALARM=3
CONFIG_SIG_SIGCHLD=4
CONFIG_SIG_SIGCONDTIMEDOUT=16
CONFIG_SIG_SIGWORK=17
CONFIG_PREALLOC_MQ_MSGS=32
CONFIG_MQ_MAXMSGSIZE=256

CONFIG_DEV_NULL=y
CONFIG_DEV_ZERO=y
CONFIG_MMINFO=y
CONFIG_DRIVERS_OS_API_TEST=y
CONFIG_SERIAL=y
CONFIG_SERIAL_CONSOLE=y
CONFIG_MCU_SERIAL=y
CONFIG_STANDARD_SERIAL=y
CONFIG_SERIAL_NPOLLWAITERS=2
CONFIG_UART0_SERIAL_CONSOLE=y
CONFIG_UART0_RXBUFSIZE=256
CONFIG_UART0_TXBUFSIZE=256
CONFIG_UART0_BAUD=115200
CONFIG_UART0_BITS=8
CONFIG_UART0_PARITY=0
CONFIG_UART0_2STOP=0

CONFIG_FS_READABLE=y
CONFIG_FS_WRITABLE=y
CONFIG_AUTOMOUNT=y
CONFIG_AUTOMOUNT_USERFS=y
CONFIG_FS_PROCFS=y
CONFIG_FS_AUTOMOUNT_PROCFS=y
CONFIG_FS_TMPFS=y
CONFIG_FS_TMPFS_MOUNT_POINT="/mnt"
CONFIG_FS_TMPFS_BLOCKSIZE=1024
CONFIG_FS_TMPFS_DIRECTORY_ALLOCGUARD=64
CONFIG_FS_TMPFS_DIRECTORY_FREEGUARD=128
CONFIG_FS_TMPFS_FILE_ALLOCGUARD=1024
CONFIG_FS_TMPFS_FILE_FREEGUARD=2048
CONFIG_FS_SMARTFS=y
CONFIG_SMARTFS_ERASEDSTATE=0xff
CONFIG_SMARTFS_MAXNAMLEN=32
CONFIG_BCH=y
CONFIG_MTD=y
CONFIG_MTD_PARTITION=y
CONFIG_MTD_PARTITION_NAMES=y
CONFIG_RAMMTD=y
CONFIG_MTD_FTL=y
CONFIG_MTD_BYTE_WRITE=y
CONFIG_MTD_SMART=y
CONFIG_MTD_SMART_SECTOR_SIZE=4096

CONFIG_MM_KERNEL_HEAP=y
CONFIG_KMM_REGIONS=1
CONFIG_KMM_NHEAPS=1
CONFIG_MM_ASSERT_ON_FAIL=y
CONFIG_SCHED_WORKQUEUE=y
CONFIG_SCHED_HPWORK=y
CONFIG_SCHED_HPWORKPRIORITY=201
CONFIG_SCHED_HPWORKSTACKSIZE=2048
CONFIG_SCHED_LPWORK=y
CONFIG_SCHED_LPNTHREADS=1
CONFIG_SCHED_LPWORKPRIORITY=50
CONFIG_SCHED_LPWORKPRIOMAX=176
CONFIG_SCHED_LPWORKSTACKSIZE=2048

CONFIG_DEBUG=y
CONFIG_DEBUG_BINMGR_ERROR=y
CONFIG_DEBUG_BINMGR_INFO=y
CONFIG_DEBUG_ERROR=y
CONFIG_DEBUG_FS=y
CONFIG_DEBUG_FS_ERROR=y
CONFIG_DEBUG_MM=y
CONFIG_DEBUG_MM_HEAPINFO=y
CONFIG_STACK_COLORATION=y
CONFIG_DEBUG_SYMBOLS=y

CONFIG_STDIO_BUFFER_SIZE=64
CONFIG_STDIO_LINEBUFFER=y
CONFIG_LIB_HOMEDIR="/"
CONFIG_LIBM=y
CONFIG_LIBC_FLOATINGPOINT=y
CONFIG_LIBC_LONG_LONG=y
CONFIG_LIBC_SCANSET=y
CONFIG_LIBC_IOCTL_VARIADIC=y
CONFIG_EOL_IS_EITHER_CRLF=y
CONFIG_LIBC_STRERROR=y
CONFIG_LIBC_TMPDIR="/tmp"
CONFIG_ARCH_LOWPUTC=y
CONFIG_LIBC_LOCALTIME=y
CONFIG_LIBC_TZ_MAX_TIMES=320
CONFIG_LIBC_TZ_MAX_TYPES=20
CONFIG_LIB_SYSCALL=y
CONFIG_SYS_RESERVED=8
CONFIG_LIBC_ARCH_ELF=y
CONFIG_LIBC_EXECFUNCS=y
CONFIG_LIBC_SYMTAB=y
CONFIG_LIB_HASHMAP=y
CONFIG_BINFMT_ENABLE=y
CONFIG_BINFMT_LOADABLE=y
CONFIG_ELF=y
CONFIG_ELF_ALIGN_LOG2=2
CONFIG_ELF_STACKSIZE=2048
CONFIG_ELF_BUFFERSIZE=32
CONFIG_ELF_BUFFERINCR=32
CONFIG_ELF_EXCLUDE_SYMBOLS=y

CONFIG_ENTRY_MANUAL=y
CONFIG_USER_ENTRYPOINT=""
CONFIG_BUILTIN_APPS=y
CONFIG_NUM_APPS=1
CONFIG_SUPPORT_COMMON_BINARY=y
CONFIG_COMMON_BINARY_VERSION="260409"
CONFIG_COMMON_BINARY_NAME="common"
CONFIG_COMMON_BIN_STATIC_RAMSIZE=262144
CONFIG_HEAP_INDEX_LOADED_APP=0
CONFIG_EXAMPLES_LOADABLE=y
CONFIG_APP1_INFO=y
CONFIG_APP1_BIN_NAME="app1"
CONFIG_APP1_BIN_TYPE="ELF"
CONFIG_APP1_BIN_VER=260409
CONFIG_APP1_BIN_DYN_RAMSIZE=262144
CONFIG_APP1_BIN_LOADING_PRIORITY="HIGH"
CONFIG_APP1_MAIN_STACKSIZE=4096
CONFIG_APP1_MAIN_PRIORITY=220
CONFIG_USE_BP=y
CONFIG_BINARY_MANAGER=y
CONFIG_BM_PRIORITY_MAX=205
CONFIG_BM_PRIORITY_MIN=200
CONFIG_BINMGR_UPDATE=y
CONFIG_BINMGR_RELOAD_REBOOT=y

CONFIG_EXAMPLES_TESTCASE=y
CONFIG_DISABLE_MANUAL_TESTCASE=y
CONFIG_EXAMPLES_TESTCASE_DRIVERS=y
CONFIG_TC_DRIVERS_NULL=y
CONFIG_TC_DRIVERS_ZERO=y
CONFIG_EXAMPLES_TESTCASE_FILESYSTEM=y
CONFIG_TC_FS_PROCFS=y
CONFIG_ITC_FS=y
CONFIG_EXAMPLES_TESTCASE_KERNEL=y
CONFIG_TC_KN_ALL=y
CONFIG_TC_KERNEL_TASH_HEAPINFO=y
CONFIG_TC_KERNEL_TASH_STACKMONITOR=y

CONFIG_TASH=y
CONFIG_TASH_TASK_PRIORITY=125
CONFIG_TASH_MAX_STORE_COMMANDS=10
CONFIG_TASH_REBOOT=y
CONFIG_TASH_CMDTASK_STACKSIZE=4096
CONFIG_TASH_CMDTASK_PRIORITY=100

CONFIG_SYSTEM_PREAPP_INIT=y
CONFIG_SYSTEM_PREAPP_STACKSIZE=2048
CONFIG_SYSTEM_READLINE=y
CONFIG_READLINE_ECHO=y
CONFIG_SYSTEM_INFORMATION=y
CONFIG_SYSTEM_CMDS=y
CONFIG_FS_CMDS=y
CONFIG_ENABLE_FREE=y
CONFIG_ENABLE_HEAPINFO=y
CONFIG_ENABLE_PS=y
CONFIG_ENABLE_STACKMONITOR=y
CONFIG_STACKMONITOR_STACKSIZE=4096
CONFIG_STACKMONITOR_PRIORITY=100
CONFIG_STACKMONITOR_INTERVAL=5
CONFIG_ENABLE_UPTIME=y
```

## external/Kconfig
```kconfig
#
# For a description of the syntax of this configuration file,
# see kconfig-language at https://www.kernel.org/doc/Documentation/kbuild/kconfig-language.txt
#

source "$EXTERNALDIR/audiocodec/Kconfig"
source "$EXTERNALDIR/avs/Kconfig"
source "$EXTERNALDIR/aws/Kconfig"
source "$EXTERNALDIR/codecs/Kconfig"
source "$EXTERNALDIR/curl/Kconfig"
source "$EXTERNALDIR/error_report/Kconfig"
source "$EXTERNALDIR/gmock/Kconfig"
source "$EXTERNALDIR/iotivity/Kconfig"
source "$EXTERNALDIR/json/Kconfig"
source "$EXTERNALDIR/libtuv/Kconfig"
source "$EXTERNALDIR/nghttp2/Kconfig"
source "$EXTERNALDIR/protobuf/Kconfig"
source "$EXTERNALDIR/wakaama/Kconfig"
source "$EXTERNALDIR/WICED/Kconfig"
source "$EXTERNALDIR/libopus/Kconfig"
source "$EXTERNALDIR/stress_tool/Kconfig"
source "$EXTERNALDIR/swepd/Kconfig"
source "$EXTERNALDIR/esp_idf_port/Kconfig"
source "$EXTERNALDIR/rtk_wifi/Kconfig"
source "$EXTERNALDIR/netutils/Kconfig.netutil"
source "$EXTERNALDIR/dhcpd/Kconfig.protocol"
source "$EXTERNALDIR/dhcpc/Kconfig.protocol"
```

## external/WICED/Kconfig
```kconfig
#
# For a description of the syntax of this configuration file,
# see kconfig-language at https://www.kernel.org/doc/Documentation/kbuild/kconfig-language.txt
#

config WL_BCM4390X
	bool "BCM4390X Wireless Module support"
	default n
	select WICED
	select BCM4390X_WIRELESS
	select NET_NOINTS
	depends on ARCH_BOARD_CY4390x
	---help---
		Enable support for BCM4390X WiFi driver

if WL_BCM4390X
config WIRELESS_FIRMWARE_FILESYSTEM
	bool "BCM43909B0 wireless firmware can be loaded from file system"
	default n
	select MTD_PARTITION
	select FS_ROMFS
	---help---
		Enable when file system includes its wireless module firmware

config WICED
	bool "WICED code Support"
	default n

config NET_NOINTS
	bool "NOINTS Support"
	default n
endif
```
