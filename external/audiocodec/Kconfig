## external/esp_idf_port/esp_lwip/Kconfig
```kconfig
menu "ESP32 LWIP"

config ESP_DHCP_SERVER
    bool "Enable expressif DHCP Server implement"
    default y
    help
        this option enable expressif DHCP Server implement.
 
config L2_TO_L3_COPY
    bool "Enable copy between Layer2 and Layer3 packets"
    default y
    help
        If this feature is enabled, all traffic from layer2(WIFI Driver) will be
        copied to a new buffer before sending it to layer3(LWIP stack), freeing
        the layer2 buffer.
        Please be notified that the total layer2 receiving buffer is fixed and 
        ESP32 currently supports 25 layer2 receiving buffer, when layer2 buffer 
        runs out of memory, then the incoming packets will be dropped in hardware. 
        The layer3 buffer is allocated from the heap, so the total layer3 receiving
        buffer depends on the available heap size, when heap runs out of memory,  
        no copy will be sent to layer3 and packet will be dropped in layer2. 
        Please make sure you fully understand the impact of this feature before 
        enabling it.

config LWIP_IRAM_OPTIMIZATION
    bool "Enable LWIP IRAM optimization"
    default n
    help
        If this feature is enabled, some functions relating to RX/TX in LWIP will be
        put into IRAM, it can improve UDP/TCP throughput by >10% for single core mode,
        it doesn't help too much for dual core mode. On the other hand, it needs about
        10KB IRAM for these optimizations.

        If this feature is disabled, all lwip functions will be put into FLASH.

menu "DHCP server"

config LWIP_DHCPS_LEASE_UNIT
    int "Multiplier for lease time, in seconds"
    range 1 3600
    default 60
    help
        The DHCP server is calculating lease time multiplying the sent 
        and received times by this number of seconds per unit. 
        The default is 60, that equals one minute.

config LWIP_DHCPS_MAX_STATION_NUM
    int "Maximum number of stations"
    range 1 64
    default 8
    help
        The maximum number of DHCP clients that are connected to the server.
        After this number is exceeded, DHCP server removes of the oldest device
        from it's address pool, without notification.

endmenu # DHCPS

endmenu
```

## external/ftpd/Kconfig.protocol
```kconfig
#
# For a description of the syntax of this configuration file,
# see kconfig-language at https://www.kernel.org/doc/Documentation/kbuild/kconfig-language.txt
#

config NETUTILS_FTPD
	bool "FTP server"
	default n
	depends on NET_LWIP
	---help---
		Enable support for the FTP server.
```

## external/gmock/Kconfig
```kconfig
#
# For a description of the syntax of this configuration file,
# see kconfig-language at https://www.kernel.org/doc/Documentation/kbuild/kconfig-language.txt
#

config GMOCK
	bool "gmock"
	default n
	depends on HAVE_CXX
	---help---
		enable gmock
```

## external/grpc/Kconfig.protocol
```kconfig
#
# For a description of the syntax of this configuration file,
# see kconfig-language at https://www.kernel.org/doc/Documentation/kbuild/kconfig-language.txt
#

config GRPC
	bool "gRPC"
	default n
	select PROTOBUF
	depends on NET && LIBCXX
	---help---
		Enable support for the gRPC.

if GRPC

config GRPC_PTHREAD_SIZE
	int "Set thread size for grpc modules"
	default 16384
	---help---
		set thread size for grpc modules

config TSI_LOG
	bool "Enable TSI Layer Log"
	default n
	---help---
		Show function calls process in TSI Layer

config TSI_MBEDTLS_LOG
	int "Set mbedTLS Log Level(0:NONE - 5:ALL)"
	default 0
	---help---
		Set Log levels for mbedtls debugging log

endif # GRPC
```

## external/iotivity/Kconfig
```kconfig
#
# For a description of the syntax of this configuration file,
# see kconfig-language at https://www.kernel.org/doc/Documentation/kbuild/kconfig-language.txt
#

menu "IOTIVITY Config Parameters"

config ENABLE_IOTIVITY
	bool "enable / disable iotivity stack"
	default n
	select LIBC_NETDB
	select TIME_EXTENDED
	select ARCH_STDARG_H
	---help---
		select to enable the iotivity stack in tinyara

config EXAMPLES_IOTIVITY
	bool "Enable building IoTivity Samples"
	default y
	depends on ENABLE_IOTIVITY
	---help---
		Enable building IoTivity Samples

choice
	prompt "iotivity stack version"
	default IOTIVITY_RELEASE_VERSION_1_3
	depends on ENABLE_IOTIVITY

config IOTIVITY_RELEASE_VERSION_1_2
	bool "1.2-rel"
	---help---
		1.2-rel version

config IOTIVITY_RELEASE_VERSION_1_3
	bool "1.3-rel"
	---help---
		1.3-rel version
endchoice

config IOTIVITY_ROUTING
	string "Enable routing, allowed values : 'EP' / 'GW' "
	default "EP"
	depends on ENABLE_IOTIVITY
	---help---
		define this to enable routing, allowed values : 'EP' / 'GW'

config IOTIVITY_PTHREAD_STACKSIZE
	int "Default pthread stack size for iotivity threads"
	default 8192
	depends on ENABLE_IOTIVITY
	---help---
		Default pthread stack size for iotivity threads

config IOTIVITY_QUEING_PTHREAD_STACKSIZE
	int "Default pthread stack size for the queing thread"
	default 3072
	depends on ENABLE_IOTIVITY
	---help---
		Default pthread stack size for the queing thread

config IOTIVITY_RETRANSMIT_PTHREAD_STACKSIZE
	int "Default pthread stack size for the retransmission pthread"
	default 1024
	depends on ENABLE_IOTIVITY
	---help---
		Default pthread stack size for the retransmission pthread

config IOTIVITY_TCPRECEIVE_PTHREAD_STACKSIZE
	int "Default pthread stack size for the TCP-receive thread"
	default 8192
	depends on ENABLE_IOTIVITY
	---help---
		Default pthread stack size for the TCP-receive thread

config IOTIVITY_RECEIVEHANDLER_PTHREAD_STACKSIZE
	int "Default pthread stack size for the receive-handler thread"
	default 8192
	depends on ENABLE_IOTIVITY
	---help---
		Default pthread stack size for the receive-handler thread

config ENABLE_IOTIVITY_SECURED
	bool "enable iotivity security"
	default n
	depends on ENABLE_IOTIVITY
	select NET_SECURITY_TLS
	---help---
		select to enable the security for iotivity stack in tinyara

config ENABLE_IOTIVITY_CLOUD
	bool "enable iotivity cloud"
	default n
	depends on ENABLE_IOTIVITY
	---help---
		select to enable the cloud for iotivity stack in tinyara

config IOTIVITY_RELEASE
	bool "Set Iotivity to Release mode"
	default y
	depends on ENABLE_IOTIVITY
	---help---
		select to build IoTivity in Release mode. Code will be optimized.

config IOTIVITY_LOGGING
        bool "enable iotivity stack logs"
        default n
        depends on ENABLE_IOTIVITY
        ---help---
                select to enable all iotivity stack logs (DEBUG / INFO etc.)

config IOTIVITY_MBEDTLS_DEBUG
	bool "enable mbedtls debug"
	default n
	depends on ENABLE_IOTIVITY
	---help---
		enable mbedtls debug

if IOTIVITY_MBEDTLS_DEBUG
config IOTIVITY_MBEDTLS_DEBUG_LEVEL
	int "mbedtls debug level in iotivity"
	default 3
	---help---
		set mbedtls debug level
endif

choice
	prompt "iotivity log level"
	default IOTIVITY_LOG_LEVEL_ERROR
	depends on ENABLE_IOTIVITY

config IOTIVITY_LOG_LEVEL_DEBUG
        bool "DEBUG"
	---help---
		All logs including DEBUG, INFO, WARNING, ERROR, FATAL level is printed.

config IOTIVITY_LOG_LEVEL_INFO
        bool "INFO"
	---help---
		The logs including INFO, WARNING, ERROR, FATAL level is printed.

config IOTIVITY_LOG_LEVEL_WARNING
        bool "WARNING"
	---help---
		The logs including WARNING, ERROR, FATAL level is printed.

config IOTIVITY_LOG_LEVEL_ERROR
        bool "ERROR"
	---help---
		The logs including ERROR, FATAL level is printed.

config IOTIVITY_LOG_LEVEL_FATAL
        bool "FATAL"
	---help---
		FATAL level is printed.
endchoice

endmenu #IOTIVITY Config Parameters
```

## external/libcoap/Kconfig.protocol
```kconfig
#
# For a description of the syntax of this configuration file,
# see kconfig-language at https://www.kernel.org/doc/Documentation/kbuild/kconfig-language.txt
#

config NETUTILS_LIBCOAP
	bool "libcoap 4.1.1"
	default n
	depends on NET_LWIP
	depends on NET_LWIP_NETDB
	---help---
		Enable support for the libcoap library 

if NETUTILS_LIBCOAP
config NETUTILS_LIBCOAP_DEBUG
	bool "Enable CoAP Debugging Log"
	default y
    ---help---
		Enables CoAP logs
endif
```

## external/libcxx-test/Kconfig
```kconfig
#
# For a description of the syntax of this configuration file,
# see kconfig-language at https://www.kernel.org/doc/Documentation/kbuild/kconfig-language.txt
#

config LIBCXX_UTC
	bool "Unit Test for LLVM Libc++"
	default n
	depends on LIBCXX
	depends on HAVE_CXXINITIALIZE || BINFMT_CONSTRUCTORS
	---help---
		Enables unit test for LLVM Libc++.

config LIBCXX_UTC_ALGORITHMS
	bool "UTC for Libc++ Algorithms"
	default y
	depends on LIBCXX_UTC
	---help---
		UTC for Libc++ Algorithms

config LIBCXX_UTC_ALGORITHMS_NONMOD
	bool "UTC for Libc++ Non-modifying Algorithms"
	default y
	depends on LIBCXX_UTC_ALGORITHMS
	---help---
		UTC for Libc++ Non-modifying Algorithms (find, count, search, equal, etc.)

config LIBCXX_UTC_ALGORITHMS_MOD
	bool "UTC for Libc++ Modifying Algorithms"
	default y
	depends on LIBCXX_UTC_ALGORITHMS
	---help---
		UTC for Libc++ Modifying Algorithms (copy, move, swap, transform, fill, etc.)

config LIBCXX_UTC_ALGORITHMS_SORT
	bool "UTC for Libc++ Sorting Algorithms"
	default y
	depends on LIBCXX_UTC_ALGORITHMS
	---help---
		UTC for Libc++ Sorting Algorithms (sort, merge, heap, min/max, etc.)

config LIBCXX_UTC_ALGORITHMS_CLIB
	bool "UTC for Libc++ C Library Algorithms"
	default y
	depends on LIBCXX_UTC_ALGORITHMS
	---help---
		UTC for Libc++ C Library Algorithms (bsearch, qsort)

config LIBCXX_UTC_ALGORITHMS_NUMERIC
	bool "UTC for Libc++ Numeric Algorithms"
	default y
	depends on LIBCXX_UTC_ALGORITHMS
	---help---
		UTC for Libc++ Numeric Algorithms (accumulate, reduce, gcd, lcm, etc.)

config LIBCXX_UTC_CONTAINERS
	bool "UTC for Libc++ Containers"
	default y
	depends on LIBCXX_UTC
	---help---
		UTC for Libc++ Containers

config LIBCXX_UTC_CONTAINERS_MAP
	bool "UTC for Libc++ Map"
	default y
	depends on LIBCXX_UTC_CONTAINERS
	---help---
		UTC for Libc++ Containers(Map)

config LIBCXX_UTC_CONTAINERS_VECTOR
	bool "UTC for Libc++ Vector"
	default y
	depends on LIBCXX_UTC_CONTAINERS
	---help---
		UTC for Libc++ Containers(Vector)

config LIBCXX_UTC_CONTAINERS_LIST
	bool "UTC for Libc++ List"
	default y
	depends on LIBCXX_UTC_CONTAINERS
	---help---
		UTC for Libc++ Containers(List)

config LIBCXX_UTC_UTILITIES
	bool "UTC for Libc++ Utilities"
	default y
	depends on LIBCXX_UTC
	---help---
		UTC for Libc++ Utilities

config LIBCXX_UTC_DIAGNOSTICS
	bool "UTC for Libc++ Diagnostics(stdexcept)"
	default y
	depends on LIBCXX_UTC
	depends on LIBCXX_EXCEPTION
	---help---
		UTC for Libc++ Diagnostics(stdexcept). Requires exception support.

config LIBCXX_UTC_NUMERICS
	bool "UTC for Libc++ Numerics"
	default y
	depends on LIBCXX_UTC
	---help---
		UTC for Libc++ Numerics

config LIBCXX_UTC_STDBOOL
	bool "UTC for Libc++ stdbool"
	default y
	depends on LIBCXX_UTC
	---help---
		UTC for Libc++ stdbool

config LIBCXX_UTC_THREAD
	bool "UTC for Libc++ Thread(Mutex)"
	default y
	depends on LIBCXX_UTC
	---help---
		UTC for Libc++ Thread(Mutex)

config LIBCXX_UTC_ITERATORS
	bool "UTC for Libc++ Iterators"
	default y
	depends on LIBCXX_UTC
	---help---
		UTC for Libc++ Iterators

config LIBCXX_UTC_STRINGS
	bool "UTC for Libc++ Strings"
	default n
	depends on LIBCXX_UTC
	---help---
		UTC for Libc++ Strings

config LIBCXX_UTC_STRINGS_LARGESIZE
	bool "UTC for Libc++ Strings Large size tests"
	default n
	depends on LIBCXX_UTC_STRINGS
	---help---
		UTC for Libc++ Strings Large size tests

config LIBCXX_UTC_UTILITIES_TUPLE
	bool "UTC for Libc++ Tuple"
	default n
	depends on LIBCXX_UTC_UTILITIES
	---help---
		UTC for Libc++ Utilities(Tuple)

config LIBCXX_UTC_UTILITIES_OPTIONAL
	bool "UTC for Libc++ Optional"
	default n
	depends on LIBCXX_UTC_UTILITIES
	depends on CXX_VERSION_17_OR_LATER
	---help---
		UTC for Libc++ Utilities(Optional) - Requires C++17

config LIBCXX_UTC_UTILITIES_VARIANT
	bool "UTC for Libc++ Variant"
	default n
	depends on LIBCXX_UTC_UTILITIES
	depends on CXX_VERSION_17_OR_LATER
	---help---
		UTC for Libc++ Utilities(Variant) - Requires C++17

config LIBCXX_UTC_UTILITIES_ANY
	bool "UTC for Libc++ Any"
	default n
	depends on LIBCXX_UTC_UTILITIES
	depends on CXX_VERSION_17_OR_LATER
	---help---
		UTC for Libc++ Utilities(Any) - Requires C++17

config LIBCXX_UTC_UTILITIES_META
	bool "UTC for Libc++ Type Traits"
	default n
	depends on LIBCXX_UTC_UTILITIES
	---help---
		UTC for Libc++ Utilities(Type Traits/Meta)

config LIBCXX_UTC_UTILITIES_RATIO
	bool "UTC for Libc++ Ratio"
	default n
	depends on LIBCXX_UTC_UTILITIES
	---help---
		UTC for Libc++ Utilities(Ratio)

config LIBCXX_UTC_UTILITIES_BITSET
	bool "UTC for Libc++ Bitset"
	default n
	depends on LIBCXX_UTC_UTILITIES
	---help---
		UTC for Libc++ Utilities(Bitset)

config LIBCXX_UTC_CONTAINERS_SET
	bool "UTC for Libc++ Set"
	default n
	depends on LIBCXX_UTC_CONTAINERS
	---help---
		UTC for Libc++ Containers(Set/Multiset)

config LIBCXX_UTC_CONTAINERS_DEQUE
	bool "UTC for Libc++ Deque"
	default n
	depends on LIBCXX_UTC_CONTAINERS
	---help---
		UTC for Libc++ Containers(Deque)

config LIBCXX_UTC_CONTAINERS_ADAPTORS
	bool "UTC for Libc++ Container Adaptors"
	default n
	depends on LIBCXX_UTC_CONTAINERS
	---help---
		UTC for Libc++ Containers(Queue/Stack/PriorityQueue)
```

## external/libopus/Kconfig
```kconfig
###########################################################################
#
# Copyright 2018 Samsung Electronics All Rights Reserved.
#
# Licensed under the Apache License, Version 2.0 (the "License");
# you may not use this file except in compliance with the License.
# You may obtain a copy of the License at
#
# http://www.apache.org/licenses/LICENSE-2.0
#
# Unless required by applicable law or agreed to in writing,
# software distributed under the License is distributed on an
# "AS IS" BASIS, WITHOUT WARRANTIES OR CONDITIONS OF ANY KIND,
# either express or implied. See the License for the specific
# language governing permissions and limitations under the License.
#
###########################################################################

#
# For a description of the syntax of this configuration file,
# see kconfig-language at https://www.kernel.org/doc/Documentation/kbuild/kconfig-language.txt
#

menuconfig CODEC_LIBOPUS
	bool "libopus 1.2.1"
	default y
	depends on AUDIO_CODEC
	---help---
		select to enable the libopus library

if CODEC_LIBOPUS

comment "OPUS Config Parameters"

choice
	prompt "Opus Application Mode"
	default OPUS_APPLICATION_AUDIO

config OPUS_APPLICATION_VOIP
	bool "VoIP"

config OPUS_APPLICATION_AUDIO
	bool "Audio"

config OPUS_APPLICATION_RESTRICTED_LOWDELAY
	bool "Restricted_lowdelay"

endchoice

config OPUS_ENCODE_COMPLEXITY
	int "Complexity for encoding, value in [0, 10]"
	default 5
	range 0 10
	---help---
		Complexity for opus encoding, avaiable complexity is in range [0, 10]

config OPUS_ENCODE_FRAMESIZE
	int "Frame size for encoding, value in msec"
	default 100
	---help---
		Frame size for opus encoding, it's duration of each packet.
		5, 10, 20, 40, 60, 80, 100, 120 milliseconds is available.

config OPUS_ENCODE_BITRATE
	int "Bitrate for encoding, bits per second"
	default 16000
	---help---
		Bitrate for encoding, bits per second, e.g. 16000

endif # CODEC_LIBOPUS
```

## external/libsodium/Kconfig
```kconfig
#
# For a description of the syntax of this configuration file,
# see kconfig-language at https://www.kernel.org/doc/Documentation/kbuild/kconfig-language.txt
#

config LIBSODIUM
	bool "Enable libsodium"
	default n
	---help---
		Enable libsodium

if LIBSODIUM

config LIBSODIUM_USE_MBEDTLS_SHA
	bool "Use mbedTLS SHA256 & SHA512 implementations"
	default n
	depends on NET_SECURITY_TLS
	---help---
		If this option is enabled, libsodium will use thin wrappers
		around mbedTLS for SHA256 & SHA512 operations.

endif
```
