## external/esp_idf_port/esp32/Kconfig
```kconfig
menu "ESP32-specific"

config RTOS_UNICORE
    bool "Run RTOS only on first core"
    default y
    help
        Select this if you only want to start RTOS on the first core.
        This is needed when e.g. another process needs complete control
        over the second core.

choice ESP32_DEFAULT_CPU_FREQ_MHZ
    prompt "CPU frequency"
    default ESP32_DEFAULT_CPU_FREQ_160
    help
        CPU frequency to be set on application startup.

config ESP32_DEFAULT_CPU_FREQ_80
    bool "80 MHz"
config ESP32_DEFAULT_CPU_FREQ_160
    bool "160 MHz"
config ESP32_DEFAULT_CPU_FREQ_240
    bool "240 MHz"
endchoice

config ESP32_DEFAULT_CPU_FREQ_MHZ
    int
    default 80 if ESP32_DEFAULT_CPU_FREQ_80
    default 160 if ESP32_DEFAULT_CPU_FREQ_160
    default 240 if ESP32_DEFAULT_CPU_FREQ_240

choice NUMBER_OF_UNIVERSAL_MAC_ADDRESS
    bool "Number of universally administered (by IEEE) MAC address"
    default FOUR_UNIVERSAL_MAC_ADDRESS
    help
        Configure the number of universally administered (by IEEE) MAC addresses.
        During initialisation, MAC addresses for each network interface are generated or derived from a
        single base MAC address.
        If the number of universal MAC addresses is four, all four interfaces (WiFi station, WiFi softap,
        Bluetooth and Ethernet) receive a universally administered MAC address. These are generated
        sequentially by adding 0, 1, 2 and 3 (respectively) to the final octet of the base MAC address.
        If the number of universal MAC addresses is two, only two interfaces (WiFi station and Bluetooth)
        receive a universally administered MAC address. These are generated sequentially by adding 0
        and 1 (respectively) to the base MAC address. The remaining two interfaces (WiFi softap and Ethernet)
        receive local MAC addresses. These are derived from the universal WiFi station and Bluetooth MAC
        addresses, respectively.
        When using the default (Espressif-assigned) base MAC address, either setting can be used. When using
        a custom universal MAC address range, the correct setting will depend on the allocation of MAC
        addresses in this range (either 2 or 4 per device.)

config TWO_UNIVERSAL_MAC_ADDRESS
    bool "Two"
config FOUR_UNIVERSAL_MAC_ADDRESS
    bool "Four"
endchoice

config NUMBER_OF_UNIVERSAL_MAC_ADDRESS
    int
    default 2 if TWO_UNIVERSAL_MAC_ADDRESS
    default 4 if FOUR_UNIVERSAL_MAC_ADDRESS

config SYSTEM_EVENT_QUEUE_SIZE
    int "System event queue size"
    default 200
    help
        Config system event queue size in different application.

config SYSTEM_EVENT_TASK_STACK_SIZE
    int "Event loop task stack size"
    default 2304
    help
        Config system event task stack size in different application.

choice CONSOLE_UART
    prompt "UART for console output"
    default CONSOLE_UART_DEFAULT
    help
        Select whether to use UART for console output (through stdout and stderr).

        - Default is to use UART0 on pins GPIO1(TX) and GPIO3(RX).
        - If "Custom" is selected, UART0 or UART1 can be chosen,
          and any pins can be selected.
        - If "None" is selected, there will be no console output on any UART, except
          for initial output from ROM bootloader. This output can be further suppressed by
          bootstrapping GPIO13 pin to low logic level.

config CONSOLE_UART_DEFAULT
    bool "Default: UART0, TX=GPIO1, RX=GPIO3"
config CONSOLE_UART_CUSTOM
    bool "Custom"
config CONSOLE_UART_NONE
    bool "None"
endchoice

choice CONSOLE_UART_NUM
    prompt "UART peripheral to use for console output (0-1)"
    depends on CONSOLE_UART_CUSTOM
    default CONSOLE_UART_CUSTOM_NUM_0
    help
        Due of a ROM bug, UART2 is not supported for console output
        via ets_printf.

config CONSOLE_UART_CUSTOM_NUM_0
    bool "UART0"
config CONSOLE_UART_CUSTOM_NUM_1
    bool "UART1"
endchoice

config CONSOLE_UART_NUM
    int
    default 0 if CONSOLE_UART_DEFAULT || CONSOLE_UART_NONE
    default 0 if CONSOLE_UART_CUSTOM_NUM_0
    default 1 if CONSOLE_UART_CUSTOM_NUM_1

config ESP32_RTC_CLK_CAL_CYCLES
    int "Number of cycles for RTC_SLOW_CLK calibration"
    default 3000 if ESP32_RTC_CLOCK_SOURCE_EXTERNAL_CRYSTAL
    default 1024 if ESP32_RTC_CLOCK_SOURCE_INTERNAL_RC
    range 0 27000 if ESP32_RTC_CLOCK_SOURCE_EXTERNAL_CRYSTAL || ESP32_RTC_CLOCK_SOURCE_EXTERNAL_OSC || ESP32_RTC_CLOCK_SOURCE_INTERNAL_8MD256
    range 0 32766 if ESP32_RTC_CLOCK_SOURCE_INTERNAL_RC
    help
        When the startup code initializes RTC_SLOW_CLK, it can perform
        calibration by comparing the RTC_SLOW_CLK frequency with main XTAL
        frequency. This option sets the number of RTC_SLOW_CLK cycles measured
        by the calibration routine. Higher numbers increase calibration
        precision, which may be important for applications which spend a lot of
        time in deep sleep. Lower numbers reduce startup time.

        When this option is set to 0, clock calibration will not be performed at
        startup, and approximate clock frequencies will be assumed:

        - 150000 Hz if internal RC oscillator is used as clock source. For this use value 1024.
        - 32768 Hz if the 32k crystal oscillator is used. For this use value 3000 or more.
          In case more value will help improve the definition of the launch of the crystal.
          If the crystal could not start, it will be switched to internal RC.

endmenu  # ESP32-Specific

menu Wi-Fi

config SW_COEXIST_ENABLE
    bool "Software controls WiFi/Bluetooth coexistence"
    default n
    help
        If enabled, WiFi & Bluetooth coexistence is controlled by software rather than hardware.
        Recommended for heavy traffic scenarios. Both coexistence configuration options are
        automatically managed, no user intervention is required.

choice SW_COEXIST_PREFERENCE
    prompt "WiFi/Bluetooth coexistence performance preference"
    depends on SW_COEXIST_ENABLE
    default SW_COEXIST_PREFERENCE_BALANCE
    help
        Choose Bluetooth/WiFi/Balance for different preference.
        If choose WiFi, it will make WiFi performance better. Such, keep WiFi Audio more fluent.
        If choose Bluetooth, it will make Bluetooth performance better. Such, keep Bluetooth(A2DP) Audio more fluent.
        If choose Balance, the performance of WiFi and bluetooth will be balance. It's default. Normally, just choose balance, the A2DP audio can play fluently, too.
        Except config preference in menuconfig, you can also call esp_coex_preference_set() dynamically.

config SW_COEXIST_PREFERENCE_WIFI
    bool "WiFi"

config SW_COEXIST_PREFERENCE_BT
    bool "Bluetooth(include BR/EDR and BLE)"

config SW_COEXIST_PREFERENCE_BALANCE
    bool "Balance"

endchoice

config SW_COEXIST_PREFERENCE_VALUE
    int
    depends on SW_COEXIST_ENABLE
    default 0 if SW_COEXIST_PREFERENCE_WIFI
    default 1 if SW_COEXIST_PREFERENCE_BT
    default 2 if SW_COEXIST_PREFERENCE_BALANCE

config ESP32_WIFI_STATIC_RX_BUFFER_NUM
    int "Max number of WiFi static RX buffers"
    range 2 25
    default 10
    help
        Set the number of WiFi static RX buffers. Each buffer takes approximately 1.6KB of RAM.
        The static rx buffers are allocated when esp_wifi_init is called, they are not freed
        until esp_wifi_deinit is called.

        WiFi hardware use these buffers to receive all 802.11 frames.
        A higher number may allow higher throughput but increases memory use.

config ESP32_WIFI_DYNAMIC_RX_BUFFER_NUM
    int "Max number of WiFi dynamic RX buffers"
    range 0 128
    default 32
    help
        Set the number of WiFi dynamic RX buffers, 0 means unlimited RX buffers will be allocated
        (provided sufficient free RAM). The size of each dynamic RX buffer depends on the size of
        the received data frame.

        For each received data frame, the WiFi driver makes a copy to an RX buffer and then delivers
        it to the high layer TCP/IP stack. The dynamic RX buffer is freed after the higher layer has
        successfully received the data frame.

        For some applications, WiFi data frames may be received faster than the application can
        process them. In these cases we may run out of memory if RX buffer number is unlimited (0).

        If a dynamic RX buffer limit is set, it should be at least the number of static RX buffers.

choice ESP32_WIFI_TX_BUFFER
    prompt "Type of WiFi TX buffers"
    default ESP32_WIFI_DYNAMIC_TX_BUFFER
    help
        Select type of WiFi TX buffers:

        If "Static" is selected, WiFi TX buffers are allocated when WiFi is initialized and released
        when WiFi is de-initialized. The size of each static TX buffer is fixed to about 1.6KB.

        If "Dynamic" is selected, each WiFi TX buffer is allocated as needed when a data frame is
        delivered to the Wifi driver from the TCP/IP stack. The buffer is freed after the data frame
        has been sent by the WiFi driver. The size of each dynamic TX buffer depends on the length
        of each data frame sent by the TCP/IP layer.

        If PSRAM is enabled, "Static" should be selected to guarantee enough WiFi TX buffers.
        If PSRAM is disabled, "Dynamic" should be selected to improve the utilization of RAM.

config ESP32_WIFI_STATIC_TX_BUFFER
    bool "Static"
config ESP32_WIFI_DYNAMIC_TX_BUFFER
    bool "Dynamic"
    depends on !SPIRAM_USE_MALLOC
endchoice

config ESP32_WIFI_TX_BUFFER_TYPE
    int
    default 0 if ESP32_WIFI_STATIC_TX_BUFFER
    default 1 if ESP32_WIFI_DYNAMIC_TX_BUFFER

config ESP32_WIFI_STATIC_TX_BUFFER_NUM
    int "Max number of WiFi static TX buffers"
    depends on ESP32_WIFI_STATIC_TX_BUFFER
    range 6 64
    default 16
    help
        Set the number of WiFi static TX buffers. Each buffer takes approximately 1.6KB of RAM.
        The static RX buffers are allocated when esp_wifi_init() is called, they are not released
        until esp_wifi_deinit() is called.

        For each transmitted data frame from the higher layer TCP/IP stack, the WiFi driver makes a
        copy of it in a TX buffer.  For some applications especially UDP applications, the upper
        layer can deliver frames faster than WiFi layer can transmit. In these cases, we may run out
        of TX buffers.

config ESP32_WIFI_DYNAMIC_TX_BUFFER_NUM
    int "Max number of WiFi dynamic TX buffers"
    depends on ESP32_WIFI_DYNAMIC_TX_BUFFER
    range 16 128
    default 32
    help
        Set the number of WiFi dynamic TX buffers. The size of each dynamic TX buffer is not fixed,
        it depends on the size of each transmitted data frame.

        For each transmitted frame from the higher layer TCP/IP stack, the WiFi driver makes a copy
        of it in a TX buffer. For some applications, especially UDP applications, the upper layer
        can deliver frames faster than WiFi layer can transmit. In these cases, we may run out of TX
        buffers.

config ESP32_WIFI_CSI_ENABLED
    bool "WiFi CSI(Channel State Information)"
    default n
    help
        Select this option to enable CSI(Channel State Information) feature. CSI takes about
        CONFIG_ESP32_WIFI_STATIC_RX_BUFFER_NUM KB of RAM. If CSI is not used, it is better to disable
        this feature in order to save memory.

config ESP32_WIFI_AMPDU_TX_ENABLED
    bool "WiFi AMPDU TX"
    default y
    help
        Select this option to enable AMPDU TX feature


config ESP32_WIFI_TX_BA_WIN
    int "WiFi AMPDU TX BA window size"
    depends on ESP32_WIFI_AMPDU_TX_ENABLED
    range 2 32
    default 6
    help
        Set the size of WiFi Block Ack TX window. Generally a bigger value means higher throughput but
        more memory. Most of time we should NOT change the default value unless special reason, e.g.
        test the maximum UDP TX throughput with iperf etc. For iperf test in shieldbox, the recommended
        value is 9~12.

config ESP32_WIFI_AMPDU_RX_ENABLED
    bool "WiFi AMPDU RX"
    default y
    help
        Select this option to enable AMPDU RX feature

config ESP32_WIFI_RX_BA_WIN
    int "WiFi AMPDU RX BA window size"
    depends on ESP32_WIFI_AMPDU_RX_ENABLED
    range 2 32
    default 6
    help
        Set the size of WiFi Block Ack RX window. Generally a bigger value means higher throughput but
        more memory. Most of time we should NOT change the default value unless special reason, e.g.
        test the maximum UDP RX throughput with iperf etc. For iperf test in shieldbox, the recommended
        value is 9~12.

config ESP32_WIFI_NVS_ENABLED
    bool "WiFi NVS flash"
    default n
    help
        Select this option to enable WiFi NVS flash

choice ESP32_WIFI_TASK_CORE_ID
    depends on !RTOS_UNICORE
    prompt "WiFi Task Core ID"
    default ESP32_WIFI_TASK_PINNED_TO_CORE_0
    help
        Pinned WiFi task to core 0 or core 1.

config ESP32_WIFI_TASK_PINNED_TO_CORE_0
    bool "Core 0"
config ESP32_WIFI_TASK_PINNED_TO_CORE_1
    bool "Core 1"
endchoice

config ESP32_WIFI_SOFTAP_BEACON_MAX_LEN
    int "Max length of WiFi SoftAP Beacon"
    range 752 1256
    default 752
    help
        ESP-MESH utilizes beacon frames to detect and resolve root node conflicts (see documentation). However the default
        length of a beacon frame can simultaneously hold only five root node identifier structures, meaning that a root node
        conflict of up to five nodes can be detected at one time. In the occurence of more root nodes conflict involving more
        than five root nodes, the conflict resolution process will detect five of the root nodes, resolve the conflict, and
        re-detect more root nodes. This process will repeat until all root node conflicts are resolved. However this process
        can generally take a very long time.

        To counter this situation, the beacon frame length can be increased such that more root nodes can be detected simultaneously.
        Each additional root node will require 36 bytes and should be added ontop of the default beacon frame length of
        752 bytes. For example, if you want to detect 10 root nodes simultaneously, you need to set the beacon frame length as
        932 (752+36*5).

        Setting a longer beacon length also assists with debugging as the conflicting root nodes can be identified more quickly.

config ESP32_WIFI_DEBUG_LOG_ENABLE
    bool "Enable WiFi debug log"
    default n
    help
       Select this option to enable WiFi debug log  
    
choice ESP32_WIFI_DEBUG_LOG_LEVEL
    depends on ESP32_WIFI_DEBUG_LOG_ENABLE
    prompt "WiFi debug log level"
    default ESP32_WIFI_LOG_DEBUG
    help
        The WiFi log is divided into the following levels: ERROR,WARNING,INFO,DEBUG,VERBOSE.
        The ERROR,WARNING,INFO levels are enabled by default, and the DEBUG,VERBOSE levels can be enabled here.

config ESP32_WIFI_DEBUG_LOG_DEBUG
    bool "WiFi Debug Log Debug"
config ESP32_WIFI_DEBUG_LOG_VERBOSE
    bool "WiFi Debug Log Verbose"
endchoice

choice ESP32_WIFI_DEBUG_LOG_MODULE
    depends on ESP32_WIFI_DEBUG_LOG_ENABLE
    prompt "WiFi debug log module"
    default ESP32_WIFI_DEBUG_LOG_MODULE_WIFI
    help
        The WiFi log module contains three parts: WIFI,COEX,MESH.
        The WIFI module indicates the logs related to WiFi, the COEX module indicates the logs related to WiFi and BT(or BLE) coexist,
        the MESH module indicates the logs related to Mesh. When ESP32_WIFI_LOG_MODULE_ALL is enabled, all modules are selected.

config ESP32_WIFI_DEBUG_LOG_MODULE_ALL
    bool "WiFi Debug Log Module All"
config ESP32_WIFI_DEBUG_LOG_MODULE_WIFI
    bool "WiFi Debug Log Module WiFi"
config ESP32_WIFI_DEBUG_LOG_MODULE_COEX
    bool "WiFi Debug Log Module Coex"
config ESP32_WIFI_DEBUG_LOG_MODULE_MESH
    bool "WiFi Debug Log Module Mesh"
endchoice

config ESP32_WIFI_DEBUG_LOG_SUBMODULE
    depends on ESP32_WIFI_DEBUG_LOG_ENABLE
    bool "WiFi debug log submodule"
    default n
    help
        Enable this option to set the WiFi debug log submodule. 
        Currently the log submodule contains the following parts: INIT,IOCTL,CONN,SCAN.
        The INIT submodule indicates the initialization process.The IOCTL submodule indicates the API calling process.
        The CONN submodule indicates the connecting process.The SCAN submodule indicates the scaning process.

config ESP32_WIFI_DEBUG_LOG_SUBMODULE_ALL
    depends on ESP32_WIFI_DEBUG_LOG_SUBMODULE
    bool "WiFi Debug Log Submodule All"
    default n
    help
        When this option is enabled, all debug submodules are selected.

config ESP32_WIFI_DEBUG_LOG_SUBMODULE_INIT
    depends on ESP32_WIFI_DEBUG_LOG_SUBMODULE && (!ESP32_WIFI_DEBUG_LOG_SUBMODULE_ALL)
    bool "WiFi Debug Log Submodule Init"
    default n

config ESP32_WIFI_DEBUG_LOG_SUBMODULE_IOCTL
    depends on ESP32_WIFI_DEBUG_LOG_SUBMODULE && (!ESP32_WIFI_DEBUG_LOG_SUBMODULE_ALL)
    bool "WiFi Debug Log Submodule Ioctl"
    default n

config ESP32_WIFI_DEBUG_LOG_SUBMODULE_CONN
    depends on ESP32_WIFI_DEBUG_LOG_SUBMODULE && (!ESP32_WIFI_DEBUG_LOG_SUBMODULE_ALL)
    bool "WiFi Debug Log Submodule Conn"
    default n

config ESP32_WIFI_DEBUG_LOG_SUBMODULE_SCAN
    depends on ESP32_WIFI_DEBUG_LOG_SUBMODULE && (!ESP32_WIFI_DEBUG_LOG_SUBMODULE_ALL)
    bool "WiFi Debug Log Submodule Scan"
    default n

endmenu  # Wi-Fi

menu PHY

config ESP32_PHY_CALIBRATION_AND_DATA_STORAGE
    bool "Store phy calibration data in NVS"
    default n
    help
        If this option is enabled, NVS will be initialized and calibration data will be loaded from there.
        PHY calibration will be skipped on deep sleep wakeup. If calibration data is not found, full calibration
        will be performed and stored in NVS. Normally, only partial calibration will be performed.
        If this option is disabled, full calibration will be performed.

        If it's easy that your board calibrate bad data, choose 'n'.
        Two cases for example, you should choose 'n':
        1.If your board is easy to be booted up with antenna disconnected.
        2.Because of your board design, each time when you do calibration, the result are too unstable.
        If unsure, choose 'y'.

config ESP32_PHY_INIT_DATA_IN_PARTITION
    bool "Use a partition to store PHY init data"
    default n
    help
        If enabled, PHY init data will be loaded from a partition.
        When using a custom partition table, make sure that PHY data
        partition is included (type: 'data', subtype: 'phy').
        With default partition tables, this is done automatically.
        If PHY init data is stored in a partition, it has to be flashed there,
        otherwise runtime error will occur.

        If this option is not enabled, PHY init data will be embedded
        into the application binary.

        If unsure, choose 'n'.

endmenu  # PHY


menu "Power Management"

config PM_ENABLE
	bool "Support for power management"
	default n
	help
		If enabled, application is compiled with support for power management.
		This option has run-time overhead (increased interrupt latency,
		longer time to enter idle state), and it also reduces accuracy of
		RTOS ticks and timers used for timekeeping.
		Enable this option if application uses power management APIs.

config PM_DFS_INIT_AUTO
	bool "Enable dynamic frequency scaling (DFS) at startup"
	depends on PM_ENABLE
	default n
	help
		If enabled, startup code configures dynamic frequency scaling.
		Max CPU frequency is set to CONFIG_ESP32_DEFAULT_CPU_FREQ_MHZ setting,
		min frequency is set to XTAL frequency.
		If disabled, DFS will not be active until the application
		configures it using esp_pm_configure function.

config PM_USE_RTC_TIMER_REF
	bool "Use RTC timer to prevent time drift (EXPERIMENTAL)"
	depends on PM_ENABLE && (ESP32_TIME_SYSCALL_USE_RTC || ESP32_TIME_SYSCALL_USE_RTC_FRC1)
	default n
	help
		When APB clock frequency changes, high-resolution timer (esp_timer)
		scale and base value need to be adjusted. Each adjustment may cause
		small error, and over time such small errors may cause time drift.
		If this option is enabled, RTC timer will be used as a reference to
		compensate for the drift.
		It is recommended that this option is only used if 32k XTAL is selected
		as RTC clock source.

config PM_PROFILING
	bool "Enable profiling counters for PM locks"
	depends on PM_ENABLE
	default n
	help
		If enabled, esp_pm_* functions will keep track of the amount of time
		each of the power management locks has been held, and esp_pm_dump_locks
		function will print this information.
		This feature can be used to analyze which locks are preventing the chip
		from going into a lower power state, and see what time the chip spends
		in each power saving mode. This feature does incur some run-time
		overhead, so should typically be disabled in production builds.

config PM_TRACE
	bool "Enable debug tracing of PM using GPIOs"
	depends on PM_ENABLE
	default n
	help
		If enabled, some GPIOs will be used to signal events such as RTOS ticks,
		frequency switching, entry/exit from idle state. Refer to pm_trace.c
		file for the list of GPIOs.
		This feature is intended to be used when analyzing/debugging behavior
		of power management implementation, and should be kept disabled in
		applications.


endmenu # "Power Management"
```
