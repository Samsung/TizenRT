## external/audiocodec/Kconfig
```kconfig
#
# For a description of the syntax of this configuration file,
# see kconfig-language at https://www.kernel.org/doc/Documentation/kbuild/kconfig-language.txt
#

config AUDIO_CODEC
	bool "Software Audio Codec Support"
	default n
	depends on AUDIO
	---help---
		Enable software audio codec functions

config AUDIO_CODEC_RINGBUFFER_SIZE
	int "Audio Decoder Ringbuffer Size"
	default 16384
	depends on AUDIO_CODEC
	---help---
		Ring buffer size that used for decoding MP3/AAC

config CODEC_AAC
	bool "Support AAC decoding"
	default n
	depends on AUDIO_CODEC
	---help---
		Enable AAC decoding

config CODEC_MP3
	bool "Support MP3 decoding"
	default n
	depends on AUDIO_CODEC
	---help---
		Enable MP3 decoding
```

## external/avs-device-sdk/Kconfig
```kconfig
#
# For a description of the syntax of this configuration file,
# see kconfig-language at https://www.kernel.org/doc/Documentation/kbuild/kconfig-language.txt
#

config AVS_DEVICE_SDK
	bool "Alexa Voice Service Device SDK"
	default n

	select MEDIA
	select MEDIA_PLAYER
	select MEDIA_RECORDER
	select AUDIO_CODEC
	---help---
		Enable AVS Device SDK
```

## external/aws/Kconfig
```kconfig
#
# For a description of the syntax of this configuration file,
# see kconfig-language at https://www.kernel.org/doc/Documentation/kbuild/kconfig-language.txt
#

menu "AWS IoT Embedded C SDK"

config AWS_SDK
	bool "AWS SDK"
	default n
	---help---
		include AWS SDK

if AWS_SDK
config AWS_IOT_MQTT_HOST
	string "Customer specific MQTT HOST"
	default "amazonaws.com"
	---help---
		Customer specific MQTT HOST. The same will be used for Thing Shadow

config AWS_IOT_MY_THING_NAME
	string "Thing Name of the Shadow"
	default "ARTIK05x"
	---help---
		Thing Name of the Shadow this device is associated with

config AWS_LOG_DEBUG
	bool "Enable debug log"
	default n

config AWS_LOG_TRACE
	bool "Enable trace log"
	default n

config AWS_LOG_INFO
	bool "Enable information log"
	default y

config AWS_LOG_WARN
	bool "Enable warning log"
	default y

config AWS_LOG_ERROR
	bool "Enable error log"
	default y

endif

endmenu
```

## external/cmsis_dsp/Kconfig
```kconfig
#
# For a description of the syntax of this configuration file,
# see kconfig-language at https://www.kernel.org/doc/Documentation/kbuild/kconfig-language.txt
#

config EXTERNAL_CMSIS_DSP
	bool "CMSIS DSP library"
	default n
	---help---
		Enables the CMSIS_DSP library.
```

## external/cmsis_nn/Kconfig
```kconfig
#
# For a description of the syntax of this configuration file,
# see kconfig-language at https://www.kernel.org/doc/Documentation/kbuild/kconfig-language.txt
#

config EXTERNAL_CMSIS_NN
	bool "CMSIS NN library"
	default n
	---help---
		Enables the CMSIS_NN library.
```

## external/curl/Kconfig
```kconfig
menu "CURL Options"

config ENABLE_CURL
	bool "Enable CURL"
	default n
	select LIBC_LOCALTIME
	select LIBC_SCANSET
	---help---
		Libcurl supports various Application level protocols.
		HTTP, FTP, Gopher etc.

if ENABLE_CURL
config DISABLE_HTTP
	bool "Disable HTTP"
	default n

if !DISABLE_HTTP
config USE_NGHTTP2
	bool "Use NGHTTP2"
	default n
	depends on ENABLE_NGHTTP2

config USE_ZLIB
	bool "Use Zlib Compression"
	default n

config DISABLE_COOKIES
	bool "Disable COOKIES"
	default n
endif #DISABLE_HTTP

config DISABLE_DICT
	bool "Disable DICT"
	default y

config DISABLE_FILE
	bool "Disable FILE"
	default y

config DISABLE_FTP
	bool "Disable FTP"
	default y

config DISABLE_TFTP
	bool "Disable TFTP"
	default y

config DISABLE_GOPHER
	bool "Disable GOPHER"
	default y

config DISABLE_SCP
	bool "Disable SCP"
	default y

config DISABLE_TELNET
	bool "Disable TELNET"
	default y

config DISABLE_LDAP
	bool "Disable LDAP"
	default y

if !DISABLE_LDAP
config USE_OPENLDAP
	bool "Use Open LDAP"
	default n
endif

config DISABLE_SMB
	bool "Disable SMB"
	default y

config DISABLE_SMTP
	bool "Disable SMTP"
	default y

config DISABLE_POP3
	bool "Disable POP3"
	default y

config DISABLE_PROXY
	bool "Disable Proxy"
	default y

config DISABLE_IMAP
	bool "Disable IMAP"
	default y

config DISABLE_RTSP
	bool "Disable RTSP"
	default y

config DISABLE_NTLM
	bool "Disable NTLM"
	default y

config DISABLE_CRYPTO_AUTH
	bool "Disable Crypto Authentication"
	default n

if !DISABLE_CRYPTO_AUTH
config CA_PATH
    string "Certificate Path"
    default "/rom"

config CA_BUNDLE
    string "Certificate Bundle"
    default "/rom/curl-certificates.crt"

config CA_FALLBACK
	bool "CA Fallback"
	default n
endif #DISABLE_CRYPTO_AUTH

config SSL_SUPPORT
	bool "SSL Support"
	default n
	depends on NET_SECURITY_TLS
	depends on FS_ROMFS

if SSL_SUPPORT
config MBEDTLS
	bool "Mbed TLS"
	default y

endif #SSL_SUPPORT

config CURL_DEBUG
	bool "Curl Debug"
	default n

if CURL_DEBUG
config LOG_CURL_FAIL
	bool "Fail Logs"
	default y

config LOG_CURL_INFO
	bool "Info Logs"
	default y

config LOG_CURL_DEBUG
	bool "Debug Logs"
	default y

config AGGRESSIVE_TEST
	bool "Aggressive Test"
	default n
endif #CURL_DEBUG
endif #ENABLE_CURL
endmenu #CURL Options
```

## external/dhcpc/Kconfig.protocol
```kconfig
#
# For a description of the syntax of this configuration file,
# see kconfig-language at https://www.kernel.org/doc/Documentation/kbuild/kconfig-language.txt
#

config NETUTILS_DHCPC
	bool "DHCP client"
	default n
	depends on NET_IPv4
	# This depend will be added when Network Config implementation is finished
	---help---
		Enable support for the DHCP client.

if NETUTILS_DHCPC && NET_LWIP_DHCP

config LWIP_DHCPC
	bool
	default y

config LWIP_DHCPC_TIMEOUT
	int "LWIP DHCPC timeout"
	default 10000

endif
```

## external/dhcpd/Kconfig.protocol
```kconfig
#
# For a description of the syntax of this configuration file,
# see kconfig-language at https://www.kernel.org/doc/Documentation/kbuild/kconfig-language.txt
#

config NETUTILS_DHCPD
	bool "DHCP server"
	default n
	depends on NET_IPv4
	---help---
		Enable support for the DHCP server.

if NETUTILS_DHCPD

if NET_DHCP
config NETUTILS_DHCPD_HOST
	bool "Host-based DHCPD build"
	default n
	depends on EXPERIMENTAL
	---help---
		DHCPD supports a host based build for testing on a PC.  It is
		enabled by this configuration, however, ti cannot really be used
		in the context to the TinyAra build as it currently stands.

config NETUTILS_DHCPD_IGNOREBROADCAST
	bool "Ignore client broadcast"
	default y
	---help---
		This is a hack.  I've had problems with Windows machines responding
		to unicast.  I think this is associated with a Windows registry key in
		HKEY_LOCAL_MACHINE\SYSTEM\CurrentControlSet\Services\DHCPServer\Parameters:
		The IgnoreBroadcastFlag value controls this behavior:  A value of 1 will
		cause the server to ignore the client broadcast flag and always respond
		with multicast; the value 0 to allows clients to request unicast.

config NETUTILS_DHCPD_LEASETIME
	int "Lease time (seconds)"
	default 864000
	---help---
		Default: 10 days

config NETUTILS_DHCPD_MINLEASETIME
	int "Minimum lease time (seconds)"
	default 86400
	---help---
		Default: 1 days

config NETUTILS_DHCPD_MAXLEASETIME
	int "Maximum lease time (seconds)"
	default 2592000
	---help---
		Default: 30 days

config NETUTILS_DHCPD_MAXLEASES
	int "Maximum number of leases"
	default 6

config NETUTILS_DHCPD_STARTIP
	hex "First IP address"
	default 0xc0a82f02

config NETUTILS_DHCPD_ROUTERIP
	hex "Router IP (0 to disable)"
	default 0xc0a82f01

config NETUTILS_DHCPD_NETMASK
	hex "Netmask (0 to disable)"
	default 0xffffff00

config NETUTILS_DHCPD_DNSIP
	hex "DNS (0 to disable)"
	default 0x08080808

config NETUTILS_DHCPD_OFFERTIME
	int "Offer time (seconds)"
	default 3600
	---help---
		Default: 1 hour

config NETUTILS_DHCPD_DECLINETIME
	int "Decline time (seconds)"
	default 3600
	---help---
	Default: 1 hour

endif

if NET_LWIP_DHCP

config LWIP_DHCPS
	bool
	default y

config LWIP_DHCPS_LEASE_DEF
	int "LWIP DHCPS lease time (min)"
	default 120

config LWIP_DHCPS_SERVER_IP
	string "Set DHCP server IP"
	default "192.168.47.1"

config LWIP_DHCPS_SERVER_NETMASK
	string "Set netmask"
	default "255.255.255.0"

config LWIP_DHCPS_MAX_STATION_NUM
	int "Maximum number of allowed stations"
	default 8
	
endif
endif
```

## external/error_report/Kconfig
```kconfig
#
# For a description of the syntax of this configuration file,
# see kconfig-language at https://www.kernel.org/doc/Documentation/kbuild/kconfig-language.txt
#

config ERROR_REPORT
	bool "Error Report Module"
	default n
	---help---
		enable Error Reporting

if ERROR_REPORT

config ERROR_REPORT_NENTRIES
	int "Number of Error Records"
	default 6
	---help---
		Maximum number of error records to store in memory

config DEBUG_ERR_REPORT_ERROR
	bool "Debug Error Reporting for errors"
	depends on DEBUG_ERROR
	default n
	---help---
		Debug Error Reporting errors

config DEBUG_ERR_REPORT_WARN
	bool "Debug Error Reporting for warnings"
	depends on DEBUG_WARN
	default n
	---help---
		Debug Error Reporting warnings

config DEBUG_ERR_REPORT_INFO
	bool "Debug Error Reporting for Info"
	depends on DEBUG_VERBOSE
	default n
	---help---
		Debug Error Reporting info

config WIFIMGR_ERROR_REPORT
	bool "WiFi Manager Errors"
	depends on WIFI_MANAGER
	default n
	---help---
		Report errors in WiFi Manager

config LWIP_SOCKET_ERROR_REPORT
	bool "LWIP socket errors"
	depends on NET_LWIP
	default n
	---help---
		Report errors at LWIP socket layer
		
config EIPADDR_ERROR_REPORT
	string "IPv4 address of endpoint"
	default "127.0.0.1"
	---help---
		Enter IP address of endpoint server where error logs will be gathered
		
config EPORT_ERROR_REPORT
	string "Port of endpoint"
	default "5001"
	---help---
		Enter Port of endpoint server where error logs will be gathered

config ERROR_REPORT_INFINITE_WAIT
	bool "Report error for infinitely waiting threads"
	default n
	select SCHED_CPULOAD
	---help---
		Report error if threads wait infinitely long

if ERROR_REPORT_INFINITE_WAIT

config ERROR_REPORT_INFINITE_CHECK_TIMER
	int "Timeout in seconds to check for infinite wait"
	default 6
	---help---
		Specify timeout value after which to check for infinite waits

config ERROR_REPORT_INFINITE_CHECK_THRESHOLD
	int "Number of observed interations of thread inactivity"
	default 3
	---help---
		Specify number of iterations of thread inactivity after which to report as error

config ERROR_REPORT_NTHREADS_IN_WAIT
	int "Number of threads (max) to be reported as waiting"
	default 8
	---help---
		Specify number of threads (max) in wait

config ERROR_REPORT_BACKTRACE_MAX_DEPTH
	int "Number of functions to report from callstack"
	default 6
	---help---
		Specify depth of the backtrace

endif #ERROR_REPORT_INFINITE_WAIT
endif # ERROR_REPORT
```

## external/esp_idf_port/Kconfig
```kconfig
#
# For a description of the syntax of this configuration file,
# see kconfig-language at https://www.kernel.org/doc/Documentation/kbuild/kconfig-language.txt
#

config ESP32_WIFI_SUPPORT
    bool "ESP32 Wireless Module support"
    default n
    depends on ARCH_BOARD_ESP32_FAMILY
    ---help---
        Enable support for ESP32 WiFi driver


if ESP32_WIFI_SUPPORT
source "$EXTERNALDIR/esp_idf_port/esp32/Kconfig"
source "$EXTERNALDIR/esp_idf_port/log/Kconfig"
source "$EXTERNALDIR/esp_idf_port/esp_lwip/Kconfig"
source "$EXTERNALDIR/esp_idf_port/tcpip_adapter/Kconfig"
endif
```
