## external/libtuv/Kconfig
```kconfig
#
# For a description of the syntax of this configuration file,
# see kconfig-language at https://www.kernel.org/doc/Documentation/kbuild/kconfig-language.txt
#

config LIBTUV
	bool "libtuv"
	default n
	---help---
		enable libtuv
```

## external/lzma/Kconfig
```kconfig
#
# For a description of the syntax of this configuration file,
# see kconfig-language at https://www.kernel.org/doc/Documentation/kbuild/kconfig-language.txt
#

config LIBLZMA
	bool "LZMA library"
	default y if COMPRESSION_TYPE=1 && BUILD_PROTECTED=n
	---help---
		LZMA Library to be used for Compression/Decompression of binaries
```

## external/mbedtls/Kconfig.protocol
```kconfig
if NET_SECURITY_TLS

config TLS_WITH_HW_ACCEL
	bool "Enable HW Accelerator"
	depends on SE
	select DEV_URANDOM
	default n

config TLS_MPI_MAX_SIZE
	int "TLS MPI Max Size (bytes)"
	default 512
	---help---
		Specify the maximum ram size to use when encrypting.
		You can find this value in the information for the certificate to use.
		ex) Server public key is 2048 bit

if TLS_WITH_HW_ACCEL

menu "HW Options"

config TLS_HW_RNG
	bool "Use H/W RNG"
	depends on HW_RNG
	default n
	---help---
		Supports true random generator by hardware
		Maximum random size is 256 bytes at one time.

config TLS_HW_DH_PARAM
	bool "Use H/W supports DH params"
	depends on HW_DH_PARAM
	default n
	---help---
		Generates and caculates diffie-hellman parameter with hardware.
		Supporting parameter size : 1024, 2048

config TLS_HW_ECDH_PARAM
	bool "Use H/W supports ECDH params"
	depends on HW_ECDH_PARAM
	default n
	---help---
		Generates and caculates eliptic curve params with hardware.
                Supporting curves :
		 . SECP 192, 224, 256, 384, 512
		 . Brainpool 256

config TLS_HW_RSA_VERIFICATION
	bool "Use H/W rsa verification"
	depends on HW_RSA_VERIFICATION
	default n
	---help---
		Verifing a RSA signature based on hardware.
		Supporting key size : 1024, 2048

config TLS_HW_ECDSA_VERIFICATION
	bool "Use H/W ecdsa verification"
	depends on HW_ECDSA_VERIFICATION
	default n
	---help---
		Verifing a ECDSA signature based on hardware.
		Supporting curves :
		 . SECP 192, 224, 256, 384, 512
		 . Brainpool 256

config TLS_HW_RSA_ENC
	bool "Use H/W rsa encryption"
	depends on HW_RSA_ENC
	default n
	---help---
		Encrypts a data based on hardware.
		Supporting key size : 1024, 2048
		
endmenu

endif
endif
```

## external/mdns/Kconfig.protocol
```kconfig
#
# For a description of the syntax of this configuration file,
# see kconfig-language at https://www.kernel.org/doc/Documentation/kbuild/kconfig-language.txt
#

config NETUTILS_MDNS
	bool "Multicast DNS"
	default n
	---help---
		Enables support for Multicast DNS. The multicast Domain Name System (mDNS)
		resolves host names to IP addresses within small networks that do not include
		a local name server.

if NETUTILS_MDNS

config NETUTILS_MDNS_RESPONDER_SUPPORT
	bool "mDNS Responder"
	default n
	---help---
		Enable mDNS Responder

config NETUTILS_MDNS_XMDNS
	bool "xmDNS for supporting site domain"
	default n
	---help---
		Enable xmDNS for supporting site domain

if NETUTILS_MDNS_XMDNS
config NETUTILS_MDNS_XMDNS_MULTICAST_ADDR
	string "xmDNS Multicast Address"
	default "224.0.0.251"
	---help---
		xmDNS Multicast Address

config NETUTILS_MDNS_XMDNS_PORT_NUM
	int "xmDNS Port Number"
	default 5353
	---help---
		xmDNS Port Number

endif # NETUTILS_MDNS_XMDNS

endif # NETUTILS_MDNS
```

## external/miniz/Kconfig
```kconfig
#
# For a description of the syntax of this configuration file,
# see kconfig-language at https://www.kernel.org/doc/Documentation/kbuild/kconfig-language.txt
#

config COMPRESSION_MINIZ
	bool "Miniz Compression"
	default y if COMPRESSION_TYPE=2 && BUILD_PROTECTED=n
	---help---
		Miniz Compression Library
```
