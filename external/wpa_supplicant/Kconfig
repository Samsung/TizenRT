## framework/src/media/Kconfig
```kconfig
#
# For a description of the syntax of this configuration file,
# see kconfig-language at https://www.kernel.org/doc/Documentation/kbuild/kconfig-language.txt
#

config MEDIA
	bool "Media Support"
	default n
	depends on AUDIO
	select HAVE_CXX
	select HAVE_CXXINITIALIZE
	---help---
		Enables overall support for Media library.

if MEDIA

config MEDIA_PLAYER
	bool "Support Media player"
	default n
	---help---
		Enable media player functions

if MEDIA_PLAYER

config MEDIA_PLAYER_STACKSIZE
	int "Media Player thread stack size"
	default 4096
	---help---

config MEDIA_PLAYER_OBSERVER_STACKSIZE
	int "Media Player Observer thread stack size"
	default 2048
	---help---

config INPUT_DATASOURCE_STACKSIZE
	int "InputDataSource thread stack size"
	default 4096
	---help---

config HTTPSOURCE_DOWNLOAD_BUFFER_SIZE
	int "Http DataSource download buffer size"
	default 4096
	---help---

config HTTPSOURCE_DOWNLOAD_BUFFER_THRESHOLD
	int "Http DataSource download buffer threshold"
	default 2048
	---help---

config HTTPSOURCE_DOWNLOAD_STACKSIZE
	int "Http DataSource download thread stack size"
	default 8192
	---help---

config DATASOURCE_PREPARSE_BUFFER_SIZE
	int "DataSource preparsing buffer size"
	default 4096
	---help---

menuconfig CONTAINER_FORMAT
	bool "Digital Container Formats Support"
	default y
	---help---
		Enable multimedia container formats

if CONTAINER_FORMAT

comment "Containers for multi-media"

config CONTAINER_MPEG2TS
	bool "MPEG-2 transport stream"
	default y
	---help---

config CONTAINER_MP4
	bool "MPEG-4 multimedia portfolio"
	default n
	---help---
		Not Supported Now

config CONTAINER_OGG
	bool "Xiph.org audio formats Vorbis and Opus"
	default n
	---help---
		Not Supported Now

comment "Containers exclusive to audio"

config CONTAINER_WAV
	bool "WAV/RIFF file format"
	default n
	---help---
		Not Supported Now

config DEMUX_BUFFER_SIZE
	int "Demuxing buffer size"
	default 4096
	---help---
		Buffer to cache stream data for demuxing

endif #CONTAINER_FORMAT

endif #MEDIA_PLAYER

config MEDIA_RECORDER
	bool "Support Media recorder"
	default n
	---help---
		Enable media recoreder functions

if MEDIA_RECORDER

config MEDIA_RECORDER_STACKSIZE
	int "Media Recorder thread stack size"
	default 12288
	---help---

config MEDIA_RECORDER_OBSERVER_STACKSIZE
	int "Media Recorder Observer thread stack size"
	default 2048
	---help---

config OUTPUT_DATASOURCE_STACKSIZE
	int "OutputDataSource thread stack size"
	default 4096
	---help---

endif #MEDIA_RECORDER

config MEDIA_VOICE_SPEECH_DETECTOR
	bool "Support Media/Voice Speech Detector"
	default n
	select VOICE_SOFTWARE_EPD
	---help---
		Enable Media/Voice Speech Detector functions

config AUDIO_RESAMPLER_BUFSIZE
	int "Audio Resampler Buffer size"
	default 4096
	depends on AUDIO
	---help---
		Buffer size for resampler

config FILE_DATASOURCE_STREAM_BUFFER_SIZE
	int "File DataSource stream buffer size"
	default 4096
	---help---

config FILE_DATASOURCE_STREAM_BUFFER_THRESHOLD
	int "File DataSource stream buffer threshold"
	default 2048

config BUFFER_DATASOURCE_STREAM_BUFFER_SIZE
	int "Buffer DataSource stream buffer size"
	default 4096
	---help---

config BUFFER_DATASOURCE_STREAM_BUFFER_THRESHOLD
	int "Buffer DataSource stream buffer threshold"
	default 1

endif #MEDIA

config AUDIO_CODEC
	bool "Software Audio Codec Support"
	default n
	depends on AUDIO
	---help---
		Enable software audio codec functions

config AUDIO_CODEC_RINGBUFFER_SIZE
	int "Audio Decoder Ringbuffer Size"
	default 16384
	depends on AUDIO_CODEC
	---help---
		Ring buffer size that used for decoding MP3/AAC
```

## framework/src/mediaplayer/Kconfig
```kconfig
#
# For a description of the syntax of this configuration file,
# see kconfig-language at https://www.kernel.org/doc/Documentation/kbuild/kconfig-language.txt
#

config AUDIO_MEDIAPLAYER
	bool "Enable mediaplayer"
	default n
```

## framework/src/messaging/Kconfig
```kconfig
#
# For a description of the syntax of this configuration file,
# see kconfig-language at https://www.kernel.org/doc/Documentation/kbuild/kconfig-language.txt
#

config MESSAGING_IPC
	bool "Enable Messaging APIs"
	default n
	depends on !DISABLE_MQUEUE
	depends on !DISABLE_SIGNALS
	---help---
		Enables Messaging APIs.
		Messaging IPC supports like below.
		1. Send unicast message with sync/async/noreply option.
			- sync : sender waits after sending msg
			- async : sender just sends msg and can receive the reply through callback.
			- noreply : sender just sends msg and cannot receive the reply.
		2. Reply unicast message : send reply msg from receiver to sender.
			- using same port name which used when receiving
		3. Send multicast message.
		4. Receive message with block/non-block option.
			- block : receiver waits for getting message.
			- non-block : receiver sets message callback func and continue to run.
		The maximum size of message is smaller than 65527 bytes.


if MESSAGING_IPC
config MESSAGING_RECV_LIST_SIZE
	int "The buffer size for getting receivers' information."
	default 10
	---help---
		This config is used for getting receivers information before send message.
		If this value is large, sending performance can be enhanced, but there is large memory consumption.
		If this value is small, memory consumption is less, but there is low performance for sending.

config MESSAGING_MAXMSG
	int "Max message number"
	default 10
	---help---
		Max number of messaging which can send or receive.

endif
```

## framework/src/network/mqtt/Kconfig.protocol
```kconfig
#
# For a description of the syntax of this configuration file,
# see kconfig-language at https://www.kernel.org/doc/Documentation/kbuild/kconfig-language.txt
#

config NETUTILS_MQTT
	bool "MQTT"
	default n
	depends on NET_LWIP_NETDB
	---help---
		Enable support for MQTT. MQTT provides a lightweight method of
		carrying out messaging using a publish/subscribe model. This makes
		it suitable for "Internet of Things" messaging such as with low power
		sensors or mobile devices such as phones, embedded computers. You can
                get more information about MQTT at https://mosquitto.org/.

if NETUTILS_MQTT

config NETUTILS_MQTT_SECURITY
        bool "MQTT with security"
        default n
	depends on NET_SECURITY_TLS
	---help---
		Enable support for security mode in MQTT.
		MQTT security mode will work with mbedTLS library.
		If you want to change Certificate of Key file or change
                configurations of security, Please reference mqtt examples.

endif # NETUTILS_MQTT
```

## framework/src/preference/Kconfig
```kconfig
#
# For a description of the syntax of this configuration file,
# see kconfig-language at https://www.kernel.org/doc/Documentation/kbuild/kconfig-language.txt
#

config PREFERENCE
	bool "Enable Preference"
	default n
	depends on FS_SMARTFS
	---help---
		Enables Preference.
```

## framework/src/seclink/Kconfig
```kconfig
#
# For a description of the syntax of this configuration file,
# see kconfig-language at https://www.kernel.org/doc/Documentation/kbuild/kconfig-language.txt
#

config SECURITY_LINK
    bool "Enable Security Link"
    default n
    ---help---
        Intercommunicate between Security features in User space and HAL which is in kernel space
```

## framework/src/security/Kconfig
```kconfig
#
# For a description of the syntax of this configuration file,
# see kconfig-language at https://www.kernel.org/doc/Documentation/kbuild/kconfig-language.txt
#

config SECURITY_API
    bool "Security API"
    default n
    ---help---
        Enable security API

if SECURITY_API

config DEBUG_SECURITY_FRAMEWORK_ERROR
	bool "Secure framework debug ERROR"
	default n
	depends on DEBUG_ERROR
	---help---
		Enable Secure Framework ERROR Debug

config DEBUG_SECURITY_FRAMEWORK_INFO
	bool "Secure framework debug INFO"
	default n
	depends on DEBUG_VERBOSE
	---help---
		Enable Secure Framework INFO Debug

config SECURITY_AUTH
    bool "Authentication"
    default n
    ---help---
        Enable authentication

config SECURITY_CRYPTO
    bool "Cryptography"
    default n
    ---help---
        Enable crypto

config SECURITY_KEYMGR
    bool "Key manager"
    default n
    ---help---
        Enable key manager

config SECURITY_SS
    bool "Secure storage"
    default n
    ---help---
        Enable secure storage

endif
```

## framework/src/st_things/Kconfig
```kconfig
#
# For a description of the syntax of this configuration file,
# see kconfig-language at https://www.kernel.org/doc/Documentation/kbuild/kconfig-language.txt
#

config ST_THINGS
	bool "SmartThings Things Management"
	default n
	select ENABLE_IOTIVITY
	select ENABLE_IOTIVITY_SECURED
	select ENABLE_IOTIVITY_CLOUD
	select NETUTILS_WIFI
	select WIFI_MANAGER
	select WPA_SUPPLICANT
	select SCSC_WLAN
	select NETUTILS_JSON
	select NETUTILS_NTPCLIENT
	depends on FS_ROMFS
	---help---
		SmartThings Things Management for applications to use and control devices

if ST_THINGS

comment "ST_Things Config Parameters"

config ST_THINGS_ARTIK_HW_CERT_KEY
	bool "Enable Artik H/W Certificate & Key"
	depends on ARCH_BOARD_ARTIK05X_FAMILY && ST_THINGS_SECURESTORAGE
	default n
	select TLS_WITH_SSS
	---help---
		Build ST Things to save hardware certification to securestorage(limited under 8KB)

config ST_THINGS_SECURESTORAGE
	bool "Enable Secure Storage"
	depends on ARCH_BOARD_ARTIK05X_FAMILY
	default n
	select TLS_WITH_SSS
	select SUPPORT_FULL_SECURITY
	---help---
		Build ST Things for Secure Storage

config ST_THINGS_STG_MODE
	bool "Enable ST Things STG Mode"
	default n
	---help---
		Build ST Things for STG Server

config ST_THINGS_FOTA
	bool "Enable ST Things FOTA Service"
	depends on SYSTEM_FOTA_HAL
	default n
	---help---
		Enable a FOTA service for ST Things
endif # ST_THINGS
```

## framework/src/task_manager/Kconfig
```kconfig
#
# For a description of the syntax of this configuration file,
# see kconfig-language at https://www.kernel.org/doc/Documentation/kbuild/kconfig-language.txt
#

config TASK_MANAGER
	bool "Enable Task Manager"
	default n
	select SCHED_ATEXIT
	select SCHED_WORKQUEUE if !BUILD_PROTECTED
	select LIB_USRWORK if BUILD_PROTECTED
	depends on !DISABLE_SIGNALS && !DISABLE_MQUEUE && TASK_NAME_SIZE != 0
	---help---
		Enables Task Manager.

if TASK_MANAGER

config TASK_MANAGER_MAX_TASKS
	int "Task Manager Max Task Num"
	default MAX_TASKS
	---help---
		Task Manager can register this number of tasks.
		Maximum MAX_TASKS tasks can be alive at the same time although it is greater than MAX_TASKS.

config TASK_MANAGER_MAX_MSG
	int "Task Manager Max Msg number"
	default MAX_TASKS
	---help---
		Task Manager can receive under this value.

config TASK_MANAGER_USER_SPECIFIC_BROADCAST
	bool "Enable User Specific Broadcast Message"
	default n
	---help---
		User defined broadcast messages are enabled to use at the Task Manager.

config TASK_MANAGER_UNICAST_REPLY_TIMEOUT
	int "Task Manager Unicast Reply Timeout(sec)"
	default 0
	---help---
		If timeout argument in task_manager_unicast is TM_RESPONSE_WAIT_INF, 
		Task Manager will wait for reply during this seconds.
		But if this config is zero, Task Manager will wait forever until receiving reply.

endif
```

## framework/src/wifi_manager/Kconfig
```kconfig
#
# For a description of the syntax of this configuration file,
# see kconfig-language at https://www.kernel.org/doc/Documentation/kbuild/kconfig-language.txt
#

config WIFI_MANAGER
    bool "Enable Wi-Fi Manager"
    default n
	select DRIVERS_WIRELESS
	select NETUTILS_NETLIB
	select PIPES
    ---help---
        Easy APIs for applications to use and control Wi-Fi features

if WIFI_MANAGER

choice
	prompt "WiFi Driver"
	default SELECT_NO_DRIVER

config SELECT_NO_DRIVER
	bool "Virtual Driver"

config SELECT_SCSC_WLAN
	bool "Enable SCSC Wireless Module"
	select SCSC_WLAN

config SELECT_RTK_WLAN
	bool "Enable RTK Wireless Module"
	select RTK_WLAN

config SELECT_PROPRIETARY_WLAN
	bool "Enable vendor-specific Wireless Module"
endchoice # WiFi driver choice

choice
	prompt "WiFi library"
	default SELECT_PROPRIETARY_SUPPLICANT

config SLSI_WPA_SUPPLICANT
	bool "Enable wpa_supplicant"
	select WPA_SUPPLICANT
	depends on SELECT_SCSC_WLAN
	---help---
		Select the wpa_supplicant

config SELECT_PROPRIETARY_SUPPLICANT
	depends on !SELECT_SCSC_WLAN && !SELECT_NO_DRIVER
	bool "Enable vendor-specific supplicant"
	---help---
		Select the third party supplicant

config SELECT_NO_SUPPLICANT
	depends on SELECT_NO_DRIVER
	bool "Enable virtual supplicant"
	---help---
		Select the virtual set of drivers

endchoice # WiFi supplicant library

if SLSI_WPA_SUPPLICANT
source "$EXTERNALDIR/wpa_supplicant/Kconfig"
endif #SLSI_WPA_SUPPLICANT

config WIFI_MANAGER_SAVE_CONFIG
	bool "Store the Wi-Fi Profile to permanent storage"
	default n

if WIFI_MANAGER_SAVE_CONFIG
config WIFI_PROFILE_SECURESTORAGE
	bool "Store the Wi-Fi Profile in a Secure Storage"
	depends on SECURITY_SS
	default n
	---help---
		if this options is disable then Wi-Fi manager stores information
		to file system which doesn't support encryption

endif # WIFI_MANAGER_SAVE_CONFIG

config WIFIMGR_SOFTAP_IFNAME
	string "Interface name of softap mode"
	default "wl1"

config WIFIMGR_STA_IFNAME
	string "Interface name of station mode"
	default "wl1"

config WIFIMGR_DISABLE_DHCPC
	bool "Disable auto get ip (ipv4 dhcp client)"
	default n

config WIFIMGR_DISABLE_DHCPS
	bool "Disable auto run dhcp server (ipv4 dhcp server)"
	default n
    help
        If say yes,it allows WiFi vendor to run dhcp server. 

config DISABLE_EXTERNAL_AUTOCONNECT
	bool "Disable external autoconnect"
	default n

if DISABLE_EXTERNAL_AUTOCONNECT
config WIFIMGR_INTERNAL_AUTOCONNECT
	bool "Enable internal auto(re)connect"
	default y

endif #WIFIMGR_DISABLE_EXTERNAL_AUTOCONNECT

config WIFI_MANAGER_USE_PRINTF
	bool "Use printf instead of ndbg to sync log output ot app"
	default n

endif #WIFI_MANAGER
```
