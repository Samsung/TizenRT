## external/wpa_supplicant/Kconfig
```kconfig
#
# For a description of the syntax of this configuration file,
# see kconfig-language at https://www.kernel.org/doc/Documentation/kbuild/kconfig-language.txt
#

menu "wpa_supplicant"

config WPA_SUPPLICANT
	bool "wpa_supplicant"
	default n
	---help---
		Start the wpa_supplicant

if WPA_SUPPLICANT

config WPA_SUPPLICANT_PRIORITY
	int "wpa_supplicant task priority"
	default 100

config WPA_SUPPLICANT_STACKSIZE
	int "wpa_supplicant stack size"
	default 16384

config WPA_SUPPLICANT_ENTRYPOINT
	string "wpa_supplicant entry point"
	default "wpa_supplicant_main"

config CTRL_IFACE
	bool "wpa_supplicant ctrl_iface flag"
	default y

config CTRL_IFACE_FIFO
    bool "wpa_supplicant ctrl_iface type - fifo"
    default y

if CTRL_IFACE_FIFO
config WPA_CTRL_FIFO_DEV_REQ
    string "Path to WPA Control FIFO device for requests"
    default "/dev/wpa_ctrl_req"

config WPA_CTRL_FIFO_DEV_CFM
    string "Path to WPA Control FIFO device for confirm"
    default "/dev/wpa_ctrl_cfm"

config WPA_CTRL_FIFO_DEV_GLOBAL_REQ
    string "Path to WPA Control global FIFO device for requests"
    default "/dev/wpa_ctrl_global_req"

config WPA_CTRL_FIFO_DEV_GLOBAL_CFM
    string "Path to WPA Control global FIFO device for confirm"
    default "/dev/wpa_ctrl_global_cfm"

config WPA_MONITOR_FIFO_DEV
    string "Path to WPA Control monitor FIFO device"
    default "/dev/wpa_monitor"

config WPA_CTRL_FIFO_MK_MODE
    int "File access mode for WPA control FIFOs"
    default 666

endif

config ELOOP_POLL
	bool "wpa_supplicant eloop poll mechanism - poll"
	default y

config WPA_SUPPLICANT_CMD
	bool "wpa_supplicant command line interface"
	default n

config DRIVER_T20
	bool "Driver T20 for SLSI WiFi"
	default y
	depends on SCSC_WLAN

config ENABLE_EAP_FOR_SUPPLICANT
	bool
	default n
	---help---
		Enable EAP support for the supplicant. This is disabled by default,
		because of pending CVE issues in some affected files.
endif

endmenu # wpa_supplicant
```

## external/zlib/Kconfig
```kconfig
#
# For a description of the syntax of this configuration file,
# see kconfig-language at https://www.kernel.org/doc/Documentation/kbuild/kconfig-language.txt
#

config ZLIB
	bool "ZLIB library"
	default n
	---help---
		ZLIB Library
```

## framework/src/aifw/Kconfig
```kconfig
#
#For a description of the syntax of this configuration file,
#see kconfig - language at https: //www.kernel.org/doc/Documentation/kbuild/kconfig-language.txt
#

config AIFW
	bool "AI Framework"
	default n
	select HAVE_CXX
	select HAVE_CXXINITIALIZE if BUILD_FLAT
	---help---
		Enables AI Framework.

if AIFW

choice
	prompt "Select runtime for the AI Framework"
	default AIFW_USE_TFMICRO

config AIFW_USE_TFMICRO
	bool "Use TFMICRO runtime"
	select EXTERNAL_TFMICRO

endchoice

menu "AIFW Debug Logs"

config AIFW_LOGS
	bool "AIFW Logs"
	default y
	---help---
		Enables AIFW logs

if AIFW_LOGS

config AIFW_LOGE
	bool "AIFW Error Logs"
	default y
	---help---
		Enables AIFW Error Logs

config AIFW_LOGI
	bool "AIFW Information Logs"
	default n
	---help---
		Enables AIFW Information Logs

config AIFW_LOGD
	bool "AIFW Debug Logs"
	default n
	---help---
		Enables AIFW Debug Logs

config AIFW_LOGV
	bool "AIFW Verbose Logs"
	default n
	---help---
		Enables AIFW Verbose Logs

endif #AIFW_LOGS

endmenu

endif #if AIFW
```

## framework/src/app/Kconfig
```kconfig
#
# For a description of the syntax of this configuration file,
# see kconfig-language at https://www.kernel.org/doc/Documentation/kbuild/kconfig-language.txt
#

source "$FRAMEWORK_DIR/src/app/bundle/Kconfig"

config APP
	bool "Application Framework Support"
	default n
	select EVENTLOOP
	select UI
	select DATA_BUNDLE
	---help---
		Enables overall support for Application Framework.
```

## framework/src/app/bundle/Kconfig
```kconfig
#
# For a description of the syntax of this configuration file,
# see kconfig-language at https://www.kernel.org/doc/Documentation/kbuild/kconfig-language.txt
#

config DATA_BUNDLE
	bool "Enable Data Bundle"
	default n
	depends on CODECS_BASE64 && CODECS_HASH_MD5
	---help---
		Enables Data Bundle.
```

## framework/src/arastorage/Kconfig
```kconfig
#
# For a description of the syntax of this configuration file,
# see kconfig-language at https://www.kernel.org/doc/Documentation/kbuild/kconfig-language.txt
#

config ARASTORAGE
	bool "AraStorage database Support"
	default n
	---help---
		Enables overall support for AraStorage library.

if ARASTORAGE

config NODE_LIMIT
        int "AraStorage Bplustree node limit"
        default 110
        ---help---
                Default : 110

config BUCKETS_LIMIT
        int "AraStorage Bplustree bucket limit"
        default 80
        ---help---
                Default : 80

config BRANCH_FACTOR
        int "AraStorage Bplustree Branch Factor"
        default 5
        ---help---
                Default : 5

config DB_TUPLES_LIMIT
        int "AraStorage Bplustree tuples limit"
        default 1000
        ---help---
                Default : 1000

config ARASTORAGE_ENABLE_FLUSHING
        bool "Enable Flushing"
        default n
        ---help---
                Enables delete old tuples based on policies

config ARASTORAGE_ENABLE_VACUUM
        bool "Enable Vacuum"
        default y
        ---help---
                Enables Vacuum Functionality

config ARASTORAGE_ENABLE_WRITE_BUFFER
	bool "Enable Write Buffer"
	default y
	---help---
		Enables insert buffer for AraStorage.
endif
```

## framework/src/araui/Kconfig
```kconfig
#
# For a description of the syntax of this configuration file,
# see kconfig-language at https://www.kernel.org/doc/Documentation/kbuild/kconfig-language.txt
#

config UI
	bool "AraUI Framework Support"
	default n
	select CLOCK_MONOTONIC
	select EXTERNAL_VEC
	---help---
		Enables overall support for AraUI Framework

if UI

config UI_DISPLAY_WIDTH
	int "Display width"
	default 256
	---help---
		Display width value

config UI_DISPLAY_HEIGHT
	int "Display height"
	default 96
	---help---
		Display height value

choice
	prompt "Display color depth"
	default UI_DISPLAY_RGB565

config UI_DISPLAY_RGB888
	bool "24bit Color (RGB888)"

config UI_DISPLAY_RGB565
	bool "16bit Color (RGB565)"

config UI_DISPLAY_GRAY4
	bool "4bit Grayscale (GRAY4)"

endchoice # Display color depth

config UI_PARTIAL_UPDATE
	bool "Enable partial display update feature"
	default n

config UI_ENABLE_TOUCH
	bool "Enable touch interface"
	default n

if UI_ENABLE_TOUCH

config UI_TOUCH_THRESHOLD
	int "Touch threshold"
	default 10
	---help---
		Touch threshold value

endif # UI_ENABLE_TOUCH

config UI_ENABLE_EMOJI
	bool "Enable UTF-8 Emoji"
	default n

if UI_ENABLE_EMOJI

config UI_USE_BUILTIN_EMOJI
	bool "Use build-in emoji graphics(40x40x32bpp)"
	default y

endif # UI_ENABLE_EMOJI

config UI_STACK_SIZE
	int "Stack size"
	default 4096
	---help---
		Stack size

config UI_MAXIMUM_FPS
	int "Maximum FPS"
	default 30
	range 0 100
	---help---
		Maximum allowable frame rate of the UI framework
		If this value is set to 0, then screen is continuously updated with
		the maximum possible FPS.
		The range of FPS is [0, 100].

config UI_UPDATE_MEMPOOL_SIZE
	int "Mempool size"
	default 128
	---help---
		Maximum mempool size of the update list.

config UI_USE_EXTERNAL_DAL_IMPL
	bool "Use external DAL implementation"
	default n

config UI_ENABLE_HW_ACC
	bool "Use the Hardware Acceleration"
	default n

if UI_ENABLE_HW_ACC

config UI_ENABLE_HW_ACC_CHROM_ART
	bool "Use the Chrom-Art(DMA2D)"
	default n

endif # UI_ENABLE_HW_ACC

endif # UI
```

## framework/src/ble_manager/Kconfig
```kconfig
#
# For a description of the syntax of this configuration file,
# see kconfig-language at https://www.kernel.org/doc/Documentation/kbuild/kconfig-language.txt
#

config BLE_MANAGER
	bool "Enable BLE Manager"
	default n
	select PIPES
	depends on DRIVERS_BLE
	---help---
		APIs for app to use and control BLE features

if BLE_MANAGER

endif #BLE_MANAGER
```

## framework/src/bluetooth/Kconfig
```kconfig
#
# For a description of the syntax of this configuration file,
# see kconfig-language at https://www.kernel.org/doc/Documentation/kbuild/kconfig-language.txt
#

config BT_CAPI
	bool "Enable Bluetooth CAPI"
	default y
	depends on BLUETOOTH
	---help---
		Enable Bluetooth CAPI
```

## framework/src/csifw/Kconfig
```kconfig
#
#For a description of the syntax of this configuration file,
#see kconfig - language at https: //www.kernel.org/doc/Documentation/kbuild/kconfig-language.txt
#

config CSIFW
	bool "CSI Framework"
	default n
	---help---
		Enables CSI Framework.
```

## framework/src/csimanager/Kconfig
```kconfig
#
#For a description of the syntax of this configuration file,
#see kconfig - language at https: //www.kernel.org/doc/Documentation/kbuild/kconfig-language.txt
#

config CSIFW
	bool "CSI Framework"
	default n
	select WIFI_CSI
	depends on TASK_MANAGER
	---help---
		Enables CSI Framework.

if CSIFW

menu "CSIFW Debug Logs"

config CSIFW_LOGS
	bool "CSIFW Logs"
	default y
	---help---
		Enables CSIFW logs

if CSIFW_LOGS

config CSIFW_LOGE
	bool "CSIFW Error Logs"
	default y
	---help---
		Enables CSIFW Error Logs

config CSIFW_LOGI
	bool "CSIFW Information Logs"
	default n
	---help---
		Enables CSIFW Information Logs

config CSIFW_LOGD
	bool "CSIFW Debug Logs"
	default n
	---help---
		Enables CSIFW Debug Logs

config CSIFW_LOGV
	bool "CSIFW Verbose Logs"
	default n
	---help---
		Enables CSIFW Verbose Logs

endif #CSIFW_LOGS

endmenu

endif #if CSIFW
```

## framework/src/dm/Kconfig
```kconfig
#
# For a description of the syntax of this configuration file,
# see kconfig-language at https://www.kernel.org/doc/Documentation/kbuild/kconfig-language.txt
#

config DM
	bool "DM"
	default n
	depends on NET
	select NET_LWIP_NETDB
	select LWM2M_WAKAAMA
	---help---
		enable the DM functionality

if DM
menuconfig DM_WIFI
	bool "Set Up Wifi Info For DM Demo"
	default y
	---help---
		Enable the artik demo example

if DM_WIFI

config DM_AP_SSID
	string "wifi ap ssid"
	default "SSID"

config DM_AP_PASS
	string "wifi ap password"
	default "PASSWORD"

config DM_AP_SECURITY
	string "wifi join security"
	default "wpa2_aes"

endif #DM_WIFI

endif
```

## framework/src/eventloop/Kconfig
```kconfig
#
# For a description of the syntax of this configuration file,
# see kconfig-language at https://www.kernel.org/doc/Documentation/kbuild/kconfig-language.txt
#

config EVENTLOOP
	bool "Enable Event Loop Framework"
	default n
	select LIBTUV
	---help---
		Enables Event Loop Framework.

if EVENTLOOP

config EVENTLOOP_DYNAMIC_CB_LIST
	bool "Enable Dynamic Thread-safe Callback List Management"
	default n
	---help---
		Enables dynamic management of thread-safe callback lists using sq_queue_t.
		When disabled, callback lists are managed using static arrays.
		When enabled, callback lists are dynamically allocated for better memory efficiency.
endif
```

## framework/src/iotbus/Kconfig
```kconfig
#
# For a description of the syntax of this configuration file,
# see kconfig-language at https://www.kernel.org/doc/Documentation/kbuild/kconfig-language.txt
#

config IOTBUS
	bool "IoTbus framework Support"
	default y
	---help---
		Enables IoTBus (GPIO, I2C, PWM, SPI, UART, ADC) framework.

if IOTBUS

config IOTBUS_GPIO
	bool "IoTbus GPIO"
	default y
	select GPIO
	---help---
		Enables IoTbus GPIO

config IOTBUS_I2C
	bool "IoTbus I2C"
	default y
	select I2C_USERIO
	depends on I2C
	---help---
		Enables IoTbus I2C

config IOTBUS_PWM
	bool "IoTbus PWM"
	default y
	depends on PWM
	---help---
		Enables IoTbus PWM

config IOTBUS_SPI
	bool "IoTbus SPI"
	default y
	select SPI_USERIO
	depends on SPI
	---help---
		Enables IoTbus SPI

config IOTBUS_UART
	bool "IoTbus UART"
	default y
	depends on SERIAL
	---help---
		Enables IoTbus Uart

config IOTBUS_ADC
	bool "IoTbus ADC"
	default y
	depends on ADC
	---help---
		Enables IoTbus ADC
		
endif
```

## framework/src/lw_aifw/Kconfig
```kconfig
#
# For a description of the syntax of this configuration file,
# see kconfig-language at https://www.kernel.org/doc/Documentation/kbuild/kconfig-language.txt
#

config LW_AIFW
	bool "On-Device Lightweight AI Framework"
	default n
	select HAVE_CXX
	select HAVE_CXXINITIALIZE
	select EXTERNAL_TFMICRO
	---help---
		Enables overall support for On-Device AI Framework.

if LW_AIFW

config LW_AIFW_SERVICE_INTERVAL
	int "Collect time interval in milliseconds"
	default 2000
	---help---
		Collect time interval in milliseconds
		
config LW_AIFW_INFERENCE_PERIOD
	int "Inference period per collect time"
	default 1
	---help---
		Inference period per collect time
		For example, if CONFIG_LW_AIFW_SERVICE_INTERVAL is 60000 and
		CONFIG_LW_AIFW_INFERENCE_PERIOD is 5,
		then it will collect sensor data for every 1 minute,
		and inference will be happened for every 5 minutes
		
config LW_AIFW_MAXM_MODEL_COUNT
	int "Maximum number of models supported in LW AIFW"
	default 2
	---help---
		Maximum number of models that LW AIFW can load

config LW_AIFW_MODEL_MEM_POOL_SIZE
	int "Memory size for each model"
	default 4096
	---help---
		Every model need its own memory pool. This value is used for it.

config LW_AIFW_BUFFER_SIZE
	int "Buffer size in number of bytes"
	default 4096
	---help---
		Buffer size in number of bytes

config LW_AIFW_READ_FROM_FS
	bool "Enable reading files from file system"
	default n
	---help---
		Enable reading files from file system

config LW_AIFW_READ_FROM_MANIFEST_FILE
	bool "Application manifest file"
	depends on LW_AIFW_READ_FROM_FS
	default n
	select NETUTILS_JSON
	---help---
		Enables reading manifest file

menu "LW_AIFW Debug Logs"

config LW_AIFW_LOGS
	bool "LW_AIFW Logs"
	default y
	---help---
		Enables LW_AIFW logs

if LW_AIFW_LOGS

config LW_AIFW_LOGE
	bool "LW_AIFW Error Logs"
	default y
	---help---
		Enables LW_AIFW Error Logs

config LW_AIFW_LOGI
	bool "LW_AIFW Information Logs"
	default n
	---help---
		Enables LW_AIFW Information Logs

config LW_AIFW_LOGV
	bool "LW_AIFW Verbose Logs"
	default n
	---help---
		Enables LW_AIFW Verbose Logs

endif #LW_AIFW_LOGS

endmenu

endif
```
