## external/nanopb/Kconfig
```kconfig
#
# For a description of the syntax of this configuration file,
# see kconfig-language at https://www.kernel.org/doc/Documentation/kbuild/kconfig-language.txt
#

config NANOPB
	bool "Nanopb"
	default n
	---help---
		enable Nanopb - Protocol Buffers for Embedded Systems
```

## external/netutils/Kconfig.netutil
```kconfig
#
# For a description of the syntax of this configuration file,
# see kconfig-language at https://www.kernel.org/doc/Documentation/kbuild/kconfig-language.txt
#

config NETUTILS_NETLIB
	bool "Network support library"
	depends on NET
	default n
	---help---
		Enable support for the network support library.

if NETUTILS_NETLIB
config NET_NETMON
	bool "Enable network monitor"
	default y
	---help---
		Enable support for the network monitor.

config NETUTILS_STATS_DISPLAY_TOOL
	bool "Enable network statistics Tool"
	depends on NET_STATS
	default y
	---help---
		Enable support for the network statistics.

endif
```

## external/nghttp2/Kconfig
```kconfig
config ENABLE_NGHTTP2
	bool "Enable NGHTTP2"
	default n
	depends on MBEDTLS
	---help---
		nghttp2 is an implementation of HTTP/2 and its header compression algorithm HPACK.

if ENABLE_NGHTTP2
config NGHTTP2_DEBUG
	bool "Nghttp2 Debug"
	default n
	depends on DEBUG
endif #ENABLE_NGHTTP2
```

## external/ntpclient/Kconfig.protocol
```kconfig
#
# For a description of the syntax of this configuration file,
# see kconfig-language at https://www.kernel.org/doc/Documentation/kbuild/kconfig-language.txt
#

config NETUTILS_NTPCLIENT
	bool "NTP client"
	default n
	depends on NET_LWIP_NETDB
	---help---
		Enable support for the minimal NTP client.

if NETUTILS_NTPCLIENT

config NETUTILS_NTPCLIENT_STACKSIZE
	int "NTP client daemon stack stack size"
	default 2048

config NETUTILS_NTPCLIENT_SERVERPRIO
	int "NTP client daemon priority"
	default 100

config NETUTILS_NTPCLIENT_SIGWAKEUP
	int "NTP client wakeup signal number"
	default 18
	depends on !DISABLE_SIGNALS

config NETUTILS_NTPCLIENT_DEFAULT_SERVER
	string "NTP client default server"
	default "time.google.com"

config NETUTILS_NTPCLIENT_DEFAULT_SERVER_PORT
	int "NTP client default server port"
	default 123

config NETUTILS_NTPCLIENT_DEFAULT_INTERVAL_SECONDS
	int "NTP client default interval seconds"
	default 60

config NETUTILS_NTPCLIENT_DEBUG
	bool "NTP client debug message option"
	default n
	---help---
		Enable NTP client debug message

endif # NETUTILS_NTPCLIENT
```

## external/onert-micro/Kconfig
```kconfig
#
# For a description of the syntax of this configuration file,
# see kconfig-language at https://www.kernel.org/doc/Documentation/kbuild/kconfig-language.txt
#

config EXTERNAL_ONERT_MICRO
bool "ONERT for Microcontroller"
default n
    select HAVE_CXX
    select HAVE_CXXINITIALIZE if BUILD_FLAT
    ---help---
        Enables the ONERT for Microcontroller
```

## external/protobuf/Kconfig
```kconfig
#
# For a description of the syntax of this configuration file,
# see kconfig-language at https://www.kernel.org/doc/Documentation/kbuild/kconfig-language.txt
#

config PROTOBUF
	bool "protocol buffer"
	default n
	depends on LIBCXX
	---help---
		enable Protocol Buffer
```

## external/resample/Kconfig
```kconfig
#
# For a description of the syntax of this configuration file,
# see kconfig-language at https://www.kernel.org/doc/Documentation/kbuild/kconfig-language.txt
#

config MEDIA_RESAMPLER
	bool "Media Resampler"
	default y
	depends on MEDIA
	---help---
		Enable media resampler
```

## external/rtk_wifi/Kconfig
```kconfig
#
# For a description of the syntax of this configuration file,
# see kconfig-language at https://www.kernel.org/doc/Documentation/kbuild/kconfig-language.txt
#
config RTK_WIFI
	bool "REALTEK Wi-Fi API"
	default n
	select SELECT_RTK_WLAN
	depends on !LWNL80211_RTK
	---help---
		Enable support for the REALTEK WI-Fi Networking API.
```

## external/slsi_wifi/Kconfig
```kconfig
#
# For a description of the syntax of this configuration file,
# see kconfig-language at https://www.kernel.org/doc/Documentation/kbuild/kconfig-language.txt
#

config NETUTILS_WIFI
	bool "SLSI Wi-Fi API"
	default n
	select SCSC_WLAN
	select WPA_SUPPLICANT
	---help---
		Enable support for the SLSI WI-Fi Networking API.

if NETUTILS_WIFI
config SLSI_WIFI_DEFAULT_WLAN_COUNTRY_CODE
	string "Country code (2 chars)"
	default "00"
	---help---
		The country code to use for the board when starting the first time.
		The country code is a two char upper-case value, e.g. DK, KR, JP, US.
		Use "00" for multi-country international.

config SLSI_WIFI_DEFAULT_WLAN_TX_POWER
	int "TX power in dBm (12-30)"
	range 12 30
	default 30
	---help---
		The default tx power value in dBm to use for the board when starting the first time.
		The tx power value is in the range 0-30 and is of the type dBm.

config SLSI_WIFI_FILESYSTEM_SUPPORT
	bool "Support filesystem"
	default n
	---help---
		The API can utilize the filesystem for configuration files and log files if needed.
		This is the default behavior but can be disabled on systems without filesystems.
		If filesystem support is disabled then functionality like auto-reconnect will not work as
		this uses the config file to store the relevant info across reboots.

if SLSI_WIFI_FILESYSTEM_SUPPORT

config SLSI_WIFI_DIR
	string "Path to where wifi can store the config files (ommit the trailing /)"
	default "/mnt/wifi"
	---help---
		The path where the wifi system can store the config and log files if needed. The path must be
		without the trailing /.

config SLSI_WIFI_LOG_FILE_NAME
	string "Name of the log file to use"
	default "slsiwifi.log"
	---help---
		The name of the file used to store logs from the wifi system.

config SLSI_WIFI_CONFIG_FILE_NAME
	string "name of the configuration file to use"
	default "slsiwifi.conf"
	---help---
		The name of the file used to store information about the wifi system.
endif
endif
```

## external/smtp/Kconfig.protocol
```kconfig
#
# For a description of the syntax of this configuration file,
# see kconfig-language at https://www.kernel.org/doc/Documentation/kbuild/kconfig-language.txt
#

config NETUTILS_SMTP
	bool "SMTP"
	default n
	---help---
		Enable support for SMTP.
```

## external/stdk/Kconfig
```kconfig
#
# For a description of the syntax of this configuration file,
# see kconfig-language at https://www.kernel.org/doc/Documentation/kbuild/kconfig-language.txt
#

config STDK_IOT_CORE
	bool "Enable SmartThings IoT Core"
	default n
	depends on NET_SECURITY_TLS
	select OPENSSL_WRAPPER
	select LIBSODIUM
	---help---
		Select this option to enable support for the Samsung SmartThings
		IoT Core via the esp-idf component for the Samsung SmartThings IoT Device C SDK.

if STDK_IOT_CORE

config STDK_IOT_CORE_EASYSETUP_HTTP
	bool "Use http for easysetup"
	default y
	depends on STDK_IOT_CORE
	---help---
		If this option is enabled, STDK will use httpd for easy setup.

config STDK_IOT_CORE_EASYSETUP_HTTP_LOG_SUPPORT
	bool "Logging via device-to-device"
	default n
	depends on STDK_IOT_CORE_EASYSETUP_HTTP
	---help---
		If this option is enabled, STDK will support logging via device-to-device mechanism.

config STDK_IOT_CORE_EASYSETUP_HTTP_LOG_SIZE
	int "log buffer size in byte"
	default 1024
	depends on STDK_IOT_CORE_EASYSETUP_HTTP_LOG_SUPPORT
	---help---
		Configuration for easysetup log size

config STDK_IOT_CORE_EASYSETUP_POSIX_TESTING
	bool "Skip easysetup for posix testing"
	default n
	depends on STDK_IOT_CORE && (!STDK_IOT_CORE_EASYSETUP_HTTP)
	---help---
		This option is only for posix testing.
		If this option is enabled, STDK will use hard coded crendtial information instead of eaysetup.
		This option isn't for development or production. only for posix testing.

config STDK_IOT_CORE_LOG_LEVEL_ERROR
	bool "Enable Log Level ERROR"
	default y
	depends on STDK_IOT_CORE
	---help---
		If this option is disabled, STDK will exclude ERROR message code.

config STDK_IOT_CORE_LOG_LEVEL_WARN
	bool "Enable Log Level WARNING"
	default y
	depends on STDK_IOT_CORE
	---help---
		If this option is disabled, STDK will exclude WARN message code.

config STDK_IOT_CORE_LOG_LEVEL_INFO
	bool "Enable Log Level INFO"
	default n
	depends on STDK_IOT_CORE
	---help---
		If this option is disabled, STDK will exclude INFO message code.

config STDK_IOT_CORE_LOG_LEVEL_DEBUG
	bool "Enable Log Level DEBUG"
	default n
	depends on STDK_IOT_CORE
	---help---
		If this option is disabled, STDK will exclude DEBUG message code.

config STDK_IOT_CORE_SUPPORT_STNV_PARTITION
	bool "Use STNV Partition"
	default n
	depends on STDK_IOT_CORE
	---help---
		If this option is enabled, STDK will use STNV partition data for easysetup.

config STDK_DEBUG_MEMORY_CHECK
	bool "Enable debug option to check memory utilization"
	default n
	depends on STDK_IOT_CORE
	---help---
		If this debug option is enabled, IOT_MEM_CHECK will print memory utilization.

menu "Crypto"
	depends on STDK_IOT_CORE

config STDK_IOT_CORE_USE_MBEDTLS
	bool "Use mbedTLS for Crypto operations"
	default y
	depends on STDK_IOT_CORE
	---help---
		If this option is enabled, STDK will use thin wrappers around
		mbedTLS for Crypto (sha, sign, ...) operations.

config STDK_IOT_CORE_CRYPTO_SUPPORT_RSA
	bool "Support RSA based crypto"
	default n
	depends on STDK_IOT_CORE
	---help---
		Support RSA based sign, encryption functions.

config STDK_IOT_CORE_CRYPTO_SUPPORT_ED25519
	bool "Support Ed25519 based crypto"
	default n
	depends on STDK_IOT_CORE
	---help---
		Support Ed25519 based sign, encryption functions.

choice STDK_IOT_CORE_FS_ENCRYPTION
	prompt "Choose FS encryption method"
	default STDK_IOT_CORE_FS_HW_ENCRYPTION
	depends on STDK_IOT_CORE
	---help---
		Choose the file system encryption method.

		Software based encryption or Hardware based encryption or
		SE(Secure Element) based encryption.

config STDK_IOT_CORE_FS_SW_ENCRYPTION
	bool "Software"
config STDK_IOT_CORE_FS_HW_ENCRYPTION
	bool "Hardware"
config STDK_IOT_CORE_FS_SE_ENCRYPTION
	bool "Hardware (SE)"
endchoice

endmenu # Crypto

menu "Network"
    depends on STDK_IOT_CORE

choice STDK_IOT_CORE_NET_INTERFACE
    prompt "Choose Network interface"
    default STDK_IOT_CORE_NET_MBEDTLS
    depends on STDK_IOT_CORE
    help
       Choose the network interface library which mqtt want to use

config STDK_IOT_CORE_NET_MBEDTLS
    bool "mbedTLS"
config STDK_IOT_CORE_NET_OPENSSL
    bool "OpenSSL"
endchoice

endmenu # Network

endif  #STDK_IOT_CORE
```

## external/stress_tool/Kconfig
```kconfig
#
# For a description of the syntax of this configuration file,
# see kconfig-language at https://www.kernel.org/doc/Documentation/kbuild/kconfig-language.txt
#

config STRESS_TOOL
	bool "Enable Stress Tool"
	default n
	---help---
		Enable support for stress tool APIs.
```

## external/swepd/Kconfig
```kconfig
#
# For a description of the syntax of this configuration file,
# see kconfig-language at https://www.kernel.org/doc/Documentation/kbuild/kconfig-language.txt
#

config VOICE_SOFTWARE_EPD
	bool "Software EndPoint Detector(Fixed Float) Support"
	default n
	---help---
		Enable software endpoint detector(Fixed float) functions

config VOICE_SOFTWARE_EPD_FRAMESIZE
	int "Software End Point Detector Framesize"
	default 256
	depends on VOICE_SOFTWARE_EPD
	---help---
		Software end point detector frame size that used for processing end point.
```

## external/sysview/Kconfig
```kconfig
#
# For a description of the syntax of this configuration file,
# see kconfig-language at https://www.kernel.org/doc/Documentation/kbuild/kconfig-language.txt
#

config SYSVIEW
	bool "SystemView"
	default n
	---help---
		SEGGER SystemView

if SYSVIEW
menu "SystemView configuration"

config SYSVIEW_HWTIMER
	bool "Use H/W Timer"
	default y
    depends on S5J_TIMER2
	---help---
		If you want to measure more accuracy time, Enable H/W Timer

config SYSVIEW_POST_MORTEM
	bool "POST Mortem"
	default n
	---help---
		POST MORTEM mode

config SYSVIEW_BUFFER_SIZE
	int "Number of bytes that SystemView uses for a buffer"
	default 32768
	---help---
		SEGGER Buffer size

config SYSVIEW_RESOURCE_SIZE
	int "Number of bytes for resource"
	default 128
	---help---
		This space is used to store MsgQ, Semaphore, memory allocation information

config SYSVIEW_MONITOR_TASK
	bool "Monitor OS Task"
	default y
	---help---
		Monitor Task

config SYSVIEW_MONITOR_SEMAPHORE
	bool "Monitor OS semaphore"
	default n
	---help---
		Monitor semaphore

config SYSVIEW_MONITOR_MSGQ
	bool "Monitor OS Message queue"
	default y
	---help---
		Monitor MsgQ

config SYSVIEW_MONITOR_MEMINFO
	bool "Monitor OS Memory allocation/free"
	default y
	---help---
		Monitor Memory allocation/free

config SYSVIEW_MONITOR_INTERRUPT
	bool "Monitor interrupt"
	default y
	---help---
		Monitor Interrupt

config SYSVIEW_MONITOR_OSTICK
	bool "Monitor OS tick interval"
	default n
	---help---
		OS tick

endmenu
endif
```

## external/telnetd/Kconfig.protocol
```kconfig
#
# For a description of the syntax of this configuration file,
# see kconfig-language at https://www.kernel.org/doc/Documentation/kbuild/kconfig-language.txt
#

config NETUTILS_TELNETD
	bool "Telnet daemon"
	default n
	select NETDEV_TELNET
	---help---
		Enable support for the Telnet daemon.
```

## external/tfmicro/Kconfig
```kconfig
#
# For a description of the syntax of this configuration file,
# see kconfig-language at https://www.kernel.org/doc/Documentation/kbuild/kconfig-language.txt
#

config EXTERNAL_TFMICRO
	bool "Tensorflow Lite for Microcontroller"
	default n
	select HAVE_CXX
	select HAVE_CXXINITIALIZE
	---help---
		Enables the Tensorflow lite for Microcontroller

if EXTERNAL_TFMICRO
config TFLM_MEM_POOL_SIZE
	int "Memory size for each model"
	default 8192
	---help---
		Every model need its own memory pool. This value is used for it.
endif #if EXTERNAL_TFMICRO
```

## external/tftpc/Kconfig.protocol
```kconfig
#
# For a description of the syntax of this configuration file,
# see kconfig-language at https://www.kernel.org/doc/Documentation/kbuild/kconfig-language.txt
#

config NETUTILS_TFTPC
	bool "TFTP client"
	default n
	---help---
		Enable support for the TFTP client.
```

## external/tiny_evtmgr/Kconfig
```kconfig
#
# For a description of the syntax of this configuration file,
# see kconfig-language at https://www.kernel.org/doc/Documentation/kbuild/kconfig-language.txt
#

config TINY_EVENT_MANAGER
	bool "Tiny event manager"
	default n
	---help---
		Enable Event Manager
```

## external/vec/Kconfig
```kconfig
#
# For a description of the syntax of this configuration file,
# see kconfig-language at https://www.kernel.org/doc/Documentation/kbuild/kconfig-language.txt
#

config EXTERNAL_VEC
	bool "vector list library"
	default n
	---help---
		Enables the vector list(rxi/vec) library.
```

## external/wakaama-client/Kconfig
```kconfig
#
# For a description of the syntax of this configuration file,
# see kconfig-language at https://www.kernel.org/doc/Documentation/kbuild/kconfig-language.txt
#

config LWM2M_WAKAAMA_CLIENT
	bool "LWM2M_WAKAAMA_CLIENT"
	---help---
		enable LWM2M Artik Cloud client
```

## external/wakaama/Kconfig
```kconfig
#
# For a description of the syntax of this configuration file,
# see kconfig-language at https://www.kernel.org/doc/Documentation/kbuild/kconfig-language.txt
#

config LWM2M_WAKAAMA
	bool "LWM2M_WAKAAMA"
	default n
	depends on NET_LWIP_NETDB
	---help---
		enable LWM2M WAKAAMA external feature

if LWM2M_WAKAAMA

choice
	prompt "LWM2M WAKAAMA modes"
	default LWM2M_CLIENT_MODE

config LWM2M_CLIENT_MODE
	bool "CLIENT_MODE"
	---help---
		enable LWM2M WAKAAMA client mode

config LWM2M_SERVER_MODE
	bool "SERVER_MODE"
	---help---
		enable LWM2M WAKAAMA server mode
endchoice

config LWM2M_LITTLE_ENDIAN
	bool "LITTLE_ENDIAN"
	default y
	---help---
		LWM2M supports LITTLE_ENDIAN and BIG_ENDIAN mode.
		according to server configuration, LWM2M client should match it.
		default value is LITTLE_ENDIAN and if you do not select as LITTLE_ENDIAN,
		BIG_ENDIAN will be used instead of it
endif
```
