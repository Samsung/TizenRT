## external/webclient/Kconfig.protocol
```kconfig
#
# For a description of the syntax of this configuration file,
# see kconfig-language at https://www.kernel.org/doc/Documentation/kbuild/kconfig-language.txt
#

config NETUTILS_WEBCLIENT
	bool "Webclient"
	default n
	depends on NET
	depends on NETUTILS_WEBSERVER
	---help---
		Enables the webclient.
		This webclient supports to send request by sync/async mode.
		Sync mode is excuted on same task with caller.
		Async mode is excuted on new task.

if NETUTILS_WEBCLIENT
	config WEBCLIENT_MAXHTTPLINE
	int "Maximum Httpline Size"
	default 200
	---help---
		Sets Buffer HTTP header data and parse line at a time.

	config WEBCLIENT_MAXMIMESIZE
	int "Maximum MimeType Size"
	default 32
	---help---
		Sets Maximum Mimetype Size.

	config WEBCLIENT_MAXHOSTNAME
	int "Maximum Hostname Size"
	default 128
	---help---
		Sets Maximum Hostname Size.

	config WEBCLIENT_MAXFILENAME
	int "Maximum Filename Size"
	default 128
	---help---
		Sets Maximum Filename Size.

	config WGET_USERAGENT
	string "User Agent"
	default "TinyARA"
	---help---
		Sets user agent. It apply to request message.

endif
```

## external/webserver/Kconfig.protocol
```kconfig
#
# For a description of the syntax of this configuration file,
# see kconfig-language at https://www.kernel.org/doc/Documentation/kbuild/kconfig-language.txt
#

config NETUTILS_WEBSERVER
	bool "Webserver"
	default n
	depends on NET
	---help---
		Enables the webserver.
		This webserver supports multi requests and multi instance.
		User can configure webserver by modifying CONF values in http_server.h.

if NETUTILS_WEBSERVER
	config NETUTILS_WEBSERVER_MAX_CLIENT_HANDLER
	int "HTTP maximum client handler"
	default 1
	---help---
		Set maximum client handler number in webserver.

	config NETUTILS_WEBSERVER_LOGD
	bool "HTTP debugging log"
	default n
	---help---
		Enables HTTP debugging logs.

	config NETUTILS_WEBSERVER_LOGE
	bool "HTTP error log"
	default n
	---help---
		Enables HTTP error logs.
endif
```

## external/websocket/Kconfig.protocol
```kconfig
#
# For a description of the syntax of this configuration file,
# see kconfig-language at https://www.kernel.org/doc/Documentation/kbuild/kconfig-language.txt
#

config NETUTILS_WEBSOCKET
	bool "Web socket"
	default n
	depends on NET_SECURITY_TLS
	---help---
		Enable support for the web socket.
```

## external/wifi_mbox/Kconfig
```kconfig
config WIFI_MBOX
	bool "Wifi message box"
	default n
	---help---
		Enable wi-fi message box to pass message from callback to main thread
```
