## apps/examples/protobuf_test/Kconfig
```kconfig
#
# For a description of the syntax of this configuration file,
# see kconfig-language at https://www.kernel.org/doc/Documentation/kbuild/kconfig-language.txt
#

config EXAMPLES_PROTOBUF_TEST
	bool "Protocol Buffers test"
	default n
	depends on HAVE_CXXINITIALIZE && LIBCXX && PROTOBUF && GMOCK
	---help---
		Enable the Protocol Buffers test

config USER_ENTRYPOINT
	string
	default "gtest_main" if ENTRY_PROTOBUF_TEST
```

## apps/examples/rdp/Kconfig
```kconfig
#
# For a description of the syntax of this configuration file,
# see kconfig-language at https://www.kernel.org/doc/Documentation/kbuild/kconfig-language.txt
#

config EXAMPLES_RDP
	bool "Read Protect example"
	default n
	depends on ARMV8M_TRUSTZONE
	select DRIVERS_KERNEL_TEST
	---help---
		Enable the Read Protect example

config USER_ENTRYPOINT
	string
	default "rdp_main" if ENTRY_RDP
```

## apps/examples/reboot_reason_test/Kconfig
```kconfig
#
# For a description of the syntax of this configuration file,
# see kconfig-language at https://www.kernel.org/doc/Documentation/kbuild/kconfig-language.txt
#

config EXAMPLES_REBOOT_REASON
	bool "\"Reboot Reason\" example"
	default n
	depends on SYSTEM_REBOOT_REASON
	select MM_ASSERT_ON_FAIL
	select WATCHDOG
	---help---
		TizenRT provides the functionality to know the reason of previous rebooting.
		This example gives several options to check it.

config USER_ENTRYPOINT
	string
	default "reboot_reason_main" if ENTRY_REBOOT_REASON
```
