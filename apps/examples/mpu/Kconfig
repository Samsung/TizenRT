## apps/examples/mpu/Kconfig
```kconfig
#
# For a description of the syntax of this configuration file,
# see kconfig-language at https://www.kernel.org/doc/Documentation/kbuild/kconfig-language.txt
#

config EXAMPLES_MPU_TEST
	bool "MPU TestCase Example"
	depends on BUILD_PROTECTED
	select DRIVERS_KERNEL_TEST
	---help---
		Enable the MPU TestCase Example

config USER_ENTRYPOINT
	string
	default "mpu_tc_main" if ENTRY_MPU_TEST
```

## apps/examples/mqtt_test/Kconfig
```kconfig
#
# For a description of the syntax of this configuration file,
# see misc/tools/kconfig-language.txt.
#

config EXAMPLES_MQTT_TEST
	bool "\"MQTT Test\" example"
	default n
	depends on NETUTILS_MQTT
	---help---
		Enable the \"MQTT Test\" example
```

## apps/examples/mtdpart/Kconfig
```kconfig
#
# For a description of the syntax of this configuration file,
# see kconfig-language at https://www.kernel.org/doc/Documentation/kbuild/kconfig-language.txt
#

config EXAMPLES_MTDPART
	bool "MTD partition test"
	default n
	depends on MTD_PARTITION && !BUILD_PROTECTED && !BUILD_KERNEL
	---help---
		Enable the MTD partition test example.

		NOTE: This example uses some internal NuttX interfaces and, hence,
		is not available in the kernel build.

if EXAMPLES_MTDPART

config EXAMPLES_MTDPART_ARCHINIT
	bool "Architecture-specific initialization"
	default n
	---help---
		The default is to use the RAM MTD device at drivers/mtd/rammtd.c.
		But an architecture-specific MTD driver can be used instead by
		defining EXAMPLES_MTDPART_ARCHINIT.  In this case, the
		initialization logic will call mtdpart_archinitialize() to obtain
		the MTD driver instance.

config EXAMPLES_MTDPART_NEBLOCKS
	int "Number of erase blocks (simulated)"
	default 16
	depends on !EXAMPLES_MTDPART_ARCHINIT
	---help---
		When EXAMPLES_MTDPART_ARCHINIT is not defined, this test will use
		the RAM MTD device at drivers/mtd/rammtd.c to simulate FLASH.  In
		this case, this value must be provided to give the nubmer of erase
		blocks in MTD RAM device.

		The size of the allocated RAM drive will be:

			EXAMPLES_MTDPART_ERASESIZE * EXAMPLES_MTDPART_NEBLOCKS

config EXAMPLES_MTDPART_NPARTITIONS
	int "Number of partitions"
	default 2
	---help---
		This setting provides the number of partitions to test.  The
		test will divide the reported size of the MTD device into equal-
		sized sub-regions for each test partition.

endif
```

## apps/examples/nanopb_simple/Kconfig
```kconfig
#
# For a description of the syntax of this configuration file,
# see kconfig-language at https://www.kernel.org/doc/Documentation/kbuild/kconfig-language.txt
#

config EXAMPLES_NANOPB_SIMPLE
	bool "Nanopb simple example"
	depends on NANOPB
	default n
	---help---
		Enable the Nanopb simple example

config USER_ENTRYPOINT
	string
	default "hello_main" if ENTRY_NANOPB_SIMPLE
```

## apps/examples/netstresstest/Kconfig
```kconfig
#
# For a description of the syntax of this configuration file,
# see kconfig-language at https://www.kernel.org/doc/Documentation/kbuild/kconfig-language.txt
#

config EXAMPLES_NETSTRESSTEST
	bool "Sample App for testing network related functionalities like TCP/UDP/IGMP/ICMP (all at one time) etc."
	default n
	---help---
		Enable the network test API's and spawn each in a separate thread with single command
```

## apps/examples/nettest/Kconfig
```kconfig
#
# For a description of the syntax of this configuration file,
# see kconfig-language at https://www.kernel.org/doc/Documentation/kbuild/kconfig-language.txt
#

config EXAMPLES_NETTEST
	bool "TCP/UDP/IP multicast test app."
	default n
	depends on NET_LWIP
	---help---
		IPV4/IPV6 compatible TCP/UDP/IP multicast test application

config USER_ENTRYPOINT
	string
	default "nettest_main" if ENTRY_NETTEST
```

## apps/examples/ntpclient_test/Kconfig
```kconfig
#
# For a description of the syntax of this configuration file,
# see kconfig-language at https://www.kernel.org/doc/Documentation/kbuild/kconfig-language.txt
#

config EXAMPLES_NTPCLIENT_TEST
	bool "\"NTP Client Test\" example"
	default n
	depends on NETUTILS_NTPCLIENT
	---help---
		Enable the \"NTP Client Test\" example

if EXAMPLES_NTPCLIENT_TEST

config EXAMPLES_NTPCLIENT_TEST_SERVER_PORT
	int "NTP server port number"
	default 123
	---help---
		This is the port number of NTP server.

endif

config USER_ENTRYPOINT
	string
	default "ntpclient_main" if ENTRY_NTPCLIENT_TEST
```

## apps/examples/nxp_example/Kconfig
```kconfig
#
# For a description of the syntax of this configuration file,
# see kconfig-language at https://www.kernel.org/doc/Documentation/kbuild/kconfig-language.txt
#

config EXAMPLES_NXP_DEMO
	bool "NXP Demos example"
	default n
	---help---
		Enable the NXP demo example

config USER_ENTRYPOINT
	string
	default "nxp_demo_sample_main" if EXAMPLES_NXP_DEMO
```

## apps/examples/nxplayer/Kconfig
```kconfig
#
# For a description of the syntax of this configuration file,
# see kconfig-language at https://www.kernel.org/doc/Documentation/kbuild/kconfig-language.txt
#

config EXAMPLES_NXPLAYER
	bool "NxPlayer Media Player"
	default n
	depends on AUDIO
	---help---
		Enable support for the NxPlayer media player library and optional
		command line interface.

if EXAMPLES_NXPLAYER

config EXAMPLES_NXPLAYER_PLAYTHREAD_STACKSIZE
	int "NxPlayer thread stack size"
	default 1500
	---help---
		Stack size to use with the NxPlayer play thread.

config EXAMPLES_NXPLAYER_COMMAND_LINE
	bool "Include nxplayer command line application"
	default y
	---help---
		Compiles in code for the nxplayer command line control.
		This is a text-based command line interface that uses
		the nxplayer library to play media files, control the
		volume, balance, bass, etc.

if EXAMPLES_NXPLAYER_COMMAND_LINE

config EXAMPLES_NXPLAYER_INCLUDE_HELP
	bool "Include HELP command and text"
	default y
	---help---
		Compiles in the NxPlayer help text to provide online help
		for available commands with syntax.

endif

config EXAMPLES_NXPLAYER_INCLUDE_DEVICE_SEARCH
	bool "Include audio device search code"
	default y
	---help---
		Compiles in extra code to search the audio device directory
		for a suitable audio device to play the specified file.
		Disabling this feature saves some code space, but it will
		mean the calling application must specify the path of the
		audio device to use before performing any other operations.

config EXAMPLES_NXPLAYER_INCLUDE_PREFERRED_DEVICE
	bool "Include preferred audio device specification code"
	default y
	---help---
		Adds support for identifying a specific audio device  to use
		for audio operations.  If this feature is not enabled, then
		an audio device search will be performed.

config EXAMPLES_NXPLAYER_FMT_FROM_EXT
	bool "Include code to determine Audio format from extension"
	default y
	---help---
		Compiles in extra code to determine audio format based
		on the filename extension for known file types.
		This feature is used if the format is not manually
		specified, and will take priority over the more lengthy
		file content detection approach.

config EXAMPLES_NXPLAYER_FMT_FROM_HEADER
	bool "Include code to find Audio format from file content"
	default n
	---help---
		Compiles in extra code to determine audio format based
		on the header content of a file for known file types.
		This feature is used when the format type cannot be
		determined from the filename extension.

config EXAMPLES_NXPLAYER_INCLUDE_MEDIADIR
	bool "Include support for specifying a media directory"
	default y
	---help---
		Compiles in extra code to set a media directory which
		will be searched when a request is made to play a file
		which is not fully qualified.

if EXAMPLES_NXPLAYER_INCLUDE_MEDIADIR

config EXAMPLES_NXPLAYER_DEFAULT_MEDIADIR
	string "Default root directory to search for media files"
	default "/mnt"
	---help---
		Specifies a root directory to search for media files
		when an absolute path is not provided.  This can be
		changed at the nxplayer command line, but will default
		to this value each time nxplayer is launched.

config EXAMPLES_NXPLAYER_RECURSIVE_MEDIA_SEARCH
	bool "Perform recursive directory search for media files"
	default n
	---help---
		When enabled, this feature will add code to perform
		a complete recursive directory search within the
		MEDIADIR for any media files that do not have a
		qualified path (i.e. contain no '/' characters).

endif

config EXAMPLES_NXPLAYER_INCLUDE_SYSTEM_RESET
	bool "Include support for system / hardware reset"
	default n
	---help---
		When enabled, this feature will add code to enable issuing
		a HW reset via program call.  The system reset will perform
		a reset on all registered audio devices.

endif
```

## apps/examples/ocf_mylight/Kconfig
```kconfig
#
# For a description of the syntax of this configuration file,
# see kconfig-language at https://www.kernel.org/doc/Documentation/kbuild/kconfig-language.txt
#

config EXAMPLES_OCFMYLIGHT
	bool "OCF My Light sample application"
	default n
	select ENABLE_IOTIVITY
	select ENABLE_IOTIVITY_SECURED
	select NETUTILS_JSON
	select NETUTILS_NTPCLIENT
	---help---
		Enable OCF My Light example application

if EXAMPLES_OCFMYLIGHT
config EXAMPLES_OCFMYLIGHT_DIMMER
	bool "Add dimmer resource (oic.r.light.dimming)"
	default n
	---help---
		Add dimmer resource (oic.r.light.dimming) to /dimm uri path
endif # EXAMPLES_OCFMYLIGHT
```

## apps/examples/ota/Kconfig
```kconfig
#
# For a description of the syntax of this configuration file,
# see kconfig-language at https://www.kernel.org/doc/Documentation/kbuild/kconfig-language.txt
#

config EXAMPLES_OTA
	bool "OTA downloader"
	select NETUTILS_WEBCLIENT
	default n
	---help---
		Enables the ota example.
```

## apps/examples/performance/tls_benchmark/Kconfig
```kconfig
#
# For a description of the syntax of this configuration file,
# see kconfig-language at https://www.kernel.org/doc/Documentation/kbuild/kconfig-language.txt
#

config EXAMPLES_TLS_BENCHMARK
	bool "TLS benchmark program"
	default n
	depends on NET_SECURITY_TLS

if EXAMPLES_TLS_BENCHMARK

config EXAMPLES_TLS_BENCHMARK_PROGNAME
	string "Program name"
	default "tls_benchmark"
	depends on BUILD_KERNEL

endif # EXAMPLE_TLS_BENCHMARK

config USER_ENTRYPOINT
	string
	default "tls_benchmark_main" if ENTRY_TLS_BENCHMARK
```

## apps/examples/performance/tls_handshake/Kconfig
```kconfig
#
# For a description of the syntax of this configuration file,
# see kconfig-language at https://www.kernel.org/doc/Documentation/kbuild/kconfig-language.txt
#

config EXAMPLES_TLS_HANDSHAKE
	bool "TLS handshake benchmark"
	default n
	depends on NET_SECURITY_TLS

if EXAMPLES_TLS_HANDSHAKE

config EXAMPLES_TLS_HANDSHAKE_PROGNAME
	string "Program name"
	default "tls_handshake"

endif

config USER_ENTRYPOINT
	string
	default "tls_handshake_main" if ENTRY_TLS_HANDSHAKE
```

## apps/examples/performance/tls_seclink/Kconfig
```kconfig
#
# For a description of the syntax of this configuration file,
# see kconfig-language at https://www.kernel.org/doc/Documentation/kbuild/kconfig-language.txt
#

config EXAMPLES_TLS_SECLINK
	bool "TLS Loopback Test with SECLINK"
	default n
	depends on NET_SECURITY_TLS

if EXAMPLES_TLS_SECLINK

config EXAMPLES_TLS_SECLINK_PROGNAME
	string "Program name"
	default "tls_seclink"

config TLS_SECLINK_USE_FRT_TIMER
	bool "TLS Test Use FRT Timer"
	default n
	depends on TIMER

if TLS_SECLINK_USE_FRT_TIMER
	
	config TLS_SECLINK_FRT_TIMER_PATH
		string "TLS Test Use FRT Timer"
		default "/dev/timer0"

endif 

config TLS_SECLINK_DEBUG
	bool "TLS Loopback test Log"
	default y

if TLS_SECLINK_DEBUG

config TLS_SECLINK_DEBUG_LEVEL
	int "Log Level (0: None / 5: All)"
	default 0

endif # TLS_SECLINK_DEBUG

endif # EXAMPLES_TLS_SECLINK

config USER_ENTRYPOINT
	string
	default "tls_seclink_main" if ENTRY_TLS_SECLINK
```

## apps/examples/pm/Kconfig
```kconfig
#
# For a description of the syntax of this configuration file,
# see kconfig-language at https://www.kernel.org/doc/Documentation/kbuild/kconfig-language.txt
#

config EXAMPLES_PM_TEST
	bool "Power Module test application"
	default n
	select PM
	select DEBUG_PM
	select PM_METRICS
	select PM_TEST
	---help---
		Enable the Power Module test application. This application features a set
		of API calls to register dummy drivers to the PM framework, & calling the
		registered callback funcions associated with these drivers. It also ensures
		device enters different power states & notes timeout in each one of them.

config USER_ENTRYPOINT
	string
	default "pm_test_main" if ENTRY_PM_TEST
```

## apps/examples/power/Kconfig
```kconfig
#
# For a description of the syntax of this configuration file,
# see kconfig-language at https://www.kernel.org/doc/Documentation/kbuild/kconfig-language.txt
#

config EXAMPLES_POWER
	bool "Power Management Test"
	default n
	depends on PM && PM_TICKSUPPRESS
	---help---
		This application is testing chipset enter power-saving mode and wake-up
		and locking enter power-saving mode apis

config USER_ENTRYPOINT
	string
	default "power_main" if ENTRY_POWER

endif #EXAMPLES_POWER
```

## apps/examples/proc_test/Kconfig
```kconfig
#
# For a description of the syntax of this configuration file,
# see kconfig-language at https://www.kernel.org/doc/Documentation/kbuild/kconfig-language.txt
#

config EXAMPLES_PROC_TEST
	bool "\"Procfs\" example"
	default n
	depends on !DISABLE_MOUNTPOINT && FS_PROCFS
	---help---
		Enable the \"Procfs\" example

config USER_ENTRYPOINT
	string
	default "proc_test_main" if ENTRY_PROC_TEST
```

## apps/examples/protobuf/Kconfig
```kconfig
#
# For a description of the syntax of this configuration file,
# see kconfig-language at https://www.kernel.org/doc/Documentation/kbuild/kconfig-language.txt
#

config EXAMPLES_PROTOBUF
	bool "Protocol Buffers example"
	default n
	depends on PROTOBUF
	depends on HAVE_CXXINITIALIZE
	---help---
		Enable the Protocol Buffers example

config USER_ENTRYPOINT
	string
	default "addressbook_main" if ENTRY_PROTOBUF
```

## apps/examples/protobuf/basic_test/Kconfig
```kconfig
#
# For a description of the syntax of this configuration file,
# see kconfig-language at https://www.kernel.org/doc/Documentation/kbuild/kconfig-language.txt
#

config EXAMPLES_PROTOBUF_TEST
	bool "Protocol Buffers example"
	default n
	depends on PROTOBUF
	depends on HAVE_CXXINITIALIZE
	---help---
		Enable the Protocol Buffers example

config USER_ENTRYPOINT
	string
	default "addressbook_main" if ENTRY_PROTOBUF_TEST
```

## apps/examples/protobuf/gtest/Kconfig
```kconfig
#
# For a description of the syntax of this configuration file,
# see kconfig-language at https://www.kernel.org/doc/Documentation/kbuild/kconfig-language.txt
#

config EXAMPLES_PROTOBUF_GTEST
	bool "Protocol Buffers gtest"
	default n
	depends on LIBCXX && PROTOBUF && GMOCK
	---help---
		Enable the Protocol Buffers gtest

config USER_ENTRYPOINT
	string
	default "gtest_main" if ENTRY_PROTOBUF_GTEST
```

## apps/examples/protobuf/msgtype_test/Kconfig
```kconfig
#
# For a description of the syntax of this configuration file,
# see kconfig-language at https://www.kernel.org/doc/Documentation/kbuild/kconfig-language.txt
#

config EXAMPLES_PROTOBUF_MSGTYPE_TEST
	bool "Protocol Buffers Serialize/Deserialize Tests"
	default n
	depends on PROTOBUF
	depends on HAVE_CXX
	---help---
		Test the Protocol Buffers Serialize/Deserialize by Type

config USER_ENTRYPOINT
	string
	default "prototest_main" if ENTRY_PROTOBUF_MSGTYPE_TEST
```

## apps/examples/protobuf_enc/Kconfig
```kconfig
#
# For a description of the syntax of this configuration file,
# see kconfig-language at https://www.kernel.org/doc/Documentation/kbuild/kconfig-language.txt
#

config EXAMPLES_PROTOTEST
	bool "Protocol Buffers Serialize/Deserialize Tests"
	default n
	depends on PROTOBUF
	depends on HAVE_CXX && HAVE_CXXINITIALIZE
	---help---
		Test the Protocol Buffers Serialize/Deserialize by Type

config USER_ENTRYPOINT
	string
	default "prototest_main" if ENTRY_PROTOTEST
```
