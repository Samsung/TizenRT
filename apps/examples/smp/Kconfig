## apps/examples/smp/Kconfig
```kconfig
#
# For a description of the syntax of this configuration file,
# see the file kconfig-language.txt in the NuttX tools repository.
#

config TESTING_SMP
	tristate "SMP example"
	default n
	depends on SMP
	---help---
		Enable the SMP example.  This example basically extracts the pthread
		barrier test from apps/testing/ostest and adds some instrumentation
		useful for debugging SMP implementations.

if TESTING_SMP

config TESTING_SMP_NBARRIER_THREADS
	int "Number of barrier threads"
	default 8
	---help---
		Specifies the number of threads to create in the SMP test.  The default
		is 8 but a smaller number may be needed on systems without sufficient memory
		to start so many threads.

config SMP_TEST_PTHREAD
	bool "Test SMP with Pthreads"
	default y
	---help---
		Test smp functionality using pthreads if this is enabled. Else, test the
		smp functionality with tasks.

endif
```

## apps/examples/smtp_client/Kconfig
```kconfig
#
# For a description of the syntax of this configuration file,
# see kconfig-language at https://www.kernel.org/doc/Documentation/kbuild/kconfig-language.txt
#

config EXAMPLES_SMTPCLIENT
	bool "SMTP client example"
	depends on NETUTILS_SMTP
	default n
	---help---
		Enable the SMTP client example

config USER_ENTRYPOINT
	string
	default "smtpc_main" if ENTRY_SMTPCLIENT
```

## apps/examples/softlockup_test/Kconfig
```kconfig
#
# For a description of the syntax of this configuration file,
# see kconfig-language at https://www.kernel.org/doc/Documentation/kbuild/kconfig-language.txt
#

config EXAMPLES_SOFTLOCKUP_TEST
	bool "Soft lockup Test example"
	default n
	depends on !DISABLE_PTHREAD
	depends on !DISABLE_SIGNALS
	select SOFT_LOCKUP_DETECT
	---help---
		Enable testcases to validate soft lockup detect feature.
```

## apps/examples/speech_detector_test/Kconfig
```kconfig
#
# For a description of the syntax of this configuration file,
# see kconfig-language at https://www.kernel.org/doc/Documentation/kbuild/kconfig-language.txt
#

config EXAMPLES_SPEECH_DETECTOR_TEST
	bool "\"Speech Detector Test\" Application"
	default n
	depends on HAVE_CXXINITIALIZE
	---help---
		Enable the \"Speech Detector Test\" Application

config USER_ENTRYPOINT
	string
	default "speech_detector_test_main" if ENTRY_SPEECH_DETECTOR_TEST
```

## apps/examples/st_things/Kconfig
```kconfig
#
# For a description of the syntax of this configuration file,
# see kconfig-language at https://www.kernel.org/doc/Documentation/kbuild/kconfig-language.txt
#

config EXAMPLES_ST_THINGS
	bool "ST Things example"
	default n
	select IOTBUS
	---help---
		Enable the ST(SmartThings) Things example

if EXAMPLES_ST_THINGS
choice
	prompt "ST Things Sample list"
	default EXAMPLES_ST_THINGS_LIGHT
	---help---
		This selection builds a sample of ST_things.

config EXAMPLES_ST_THINGS_LIGHT
	bool "LIGHT"
	select IOTBUS_GPIO
	---help---
		This is a Light Sample.

config EXAMPLES_ST_THINGS_BLINK
	bool "BLINK"
	select IOTBUS_GPIO
	---help---
		This is a Blink Sample.

config EXAMPLES_ST_THINGS_MSG_HANDLING
	bool "Message Handling Example"
	select IOTBUS_GPIO
	---help---
		This is a Message handling Sample.

endchoice

config RESET_BUTTON
	bool "Reset_Button"
	default y
	depends on EXAMPLES_ST_THINGS_LIGHT
	---help---
		Decide whether to use the button to reset the connection on your board.
config LIGHT_SWITCH_BUTTON
	bool "Light_Switch_Button"
	default y
	depends on EXAMPLES_ST_THINGS_LIGHT
	---help---
		Decide whether to use the button to trigger the light switch on your board.

config RESET_BUTTON_PIN_NUMBER
	int "Pin Number"
	default 44
	depends on RESET_BUTTON
	---help---
		The default is the reset button pin number 44 for the ARTIK 053.
		If you use another board, you can set the pin number for the board.

config LIGHT_SWITCH_BUTTON_PIN_NUMBER
	int "GPIO Number of handle notify switch resource observers manually"
	default 42
	depends on LIGHT_SWITCH_BUTTON
	---help---
		The default value of switch SW702 for the ARTIK 053 is 42 gpio number.
		If you use another board, you can set the pin number for the board.

config EXAMPLES_ST_THINGS_RED_LED_GPIO_NUM
	int "GPIO number of RED LED"
	default 45
	depends on EXAMPLES_ST_THINGS_BLINK
	---help---
		This is a red led gpio num.

endif

config USER_ENTRYPOINT
	string
	default "st_things_sample_main" if EXAMPLES_ST_THINGS
```

## apps/examples/stack_guard/Kconfig
```kconfig
#
# For a description of the syntax of this configuration file,
# see kconfig-language at https://www.kernel.org/doc/Documentation/kbuild/kconfig-language.txt
#

menuconfig EXAMPLES_STACKGUARD_TEST
	bool "Stack Guard TestCase Examples"
	depends on MPU_STACKGUARD
	---help---
		Enable the TestCase to test the stack guard feature.
		This feature enables the hardware enabled stack guard.

if EXAMPLES_STACKGUARD_TEST

config TC_SG_RECURSION_TEST
	bool "Recursive call Test for Stack guard feature"
	default n

endif #EXAMPLES_STACKGUARD_TEST

config USER_ENTRYPOINT
	string
	default "sg_tc_main" if ENTRY_STACKGUARD_TEST
```

## apps/examples/stack_protection/Kconfig
```kconfig
#
# For a description of the syntax of this configuration file,
# see kconfig-language at https://www.kernel.org/doc/Documentation/kbuild/kconfig-language.txt
#

config EXAMPLES_STACK_PROTECTION
	bool "Stack Protection Test Example"
	depends on (MPU_STACK_OVERFLOW_PROTECTION || REG_STACK_OVERFLOW_PROTECTION)
	select DRIVERS_KERNEL_TEST
	---help---
		Enable the Stack Overflow Protection Test Example

config USER_ENTRYPOINT
	string
	default "stack_prot_main" if ENTRY_STACK_PROTECTION
```

## apps/examples/stack_test/Kconfig
```kconfig
#
# For a description of the syntax of this configuration file,
# see kconfig-language at https://www.kernel.org/doc/Documentation/kbuild/kconfig-language.txt
#

config EXAMPLES_STACKTEST
	bool "\"Stack Protection Test\" example"
	default n
	---help---
		Enable the \"Stack Protection Test\" example

config USER_ENTRYPOINT
	string
	default "stack_test_main" if ENTRY_STACKTEST
```

## apps/examples/stdk_smart_lamp/Kconfig
```kconfig
#
# For a description of the syntax of this configuration file,
# see misc/tools/kconfig-language.txt.
#

config EXAMPLES_STDK_SMART_LAMP
	bool "STDK smart_lamp example"
	default n
	depends on STDK_IOT_CORE
	---help---
		Enable the smart switch example of STDK
```

## apps/examples/syscall_performance/Kconfig
```kconfig
#
# For a description of the syntax of this configuration file,
# see kconfig-language at https://www.kernel.org/doc/Documentation/kbuild/kconfig-language.txt
#

config EXAMPLES_SYSCALL_PERFORMANCE
	bool "Syscall Performance Example"
	default n
	---help---
		Enable the Syscall Performance Example

config USER_ENTRYPOINT
	string
	default "syscall_performance_main" if ENTRY_SYSCALL_PERFORMANCE
```

## apps/examples/sysio_test/Kconfig
```kconfig
#
# For a description of the syntax of this configuration file,
# see kconfig-language at https://www.kernel.org/doc/Documentation/kbuild/kconfig-language.txt
#

config EXAMPLES_SYSIO_TEST
	bool "\"System I/O Test (GPIO,PWM,I2C,SPI,UART) \" example"
	default n
	---help---
		Enable the \"System I/O Test\" example

if EXAMPLES_SYSIO_TEST

config EXAMPLES_SYSIO_TEST_PROGNAME
	string "Program name"
	default "sysio"
	depends on BUILD_KERNEL
	---help---
		This is the name of the program that will be use when the NSH ELF
		program is installed.

endif

config USER_ENTRYPOINT
	string
	default "sysio_main" if ENTRY_SYSIO_TEST
```

## apps/examples/tahi/Kconfig
```kconfig
#
# For a description of the syntax of this configuration file,
# see kconfig-language at https://www.kernel.org/doc/Documentation/kbuild/kconfig-language.txt
#

config EXAMPLES_TAHI
	bool "TAHI Self Test App"
	default n
	---help---
		Enable the TAHI Self Test App

config USER_ENTRYPOINT
	string
	default "tahi_main" if ENTRY_TAHI
```

## apps/examples/task_manager_sample/Kconfig
```kconfig
#
# For a description of the syntax of this configuration file,
# see kconfig-language at https://www.kernel.org/doc/Documentation/kbuild/kconfig-language.txt
#

config EXAMPLES_TASK_MANAGER_SAMPLE
	bool "Task Manager Sample"
	default n
	depends on TASK_MANAGER
	---help---
		Enable the Task Manager Sample

config USER_ENTRYPOINT
	string
	default "task_manager_sample_main" if ENTRY_TASK_MANAGER_SAMPLE
```

## apps/examples/telnetd/Kconfig
```kconfig
#
# For a description of the syntax of this configuration file,
# see kconfig-language at https://www.kernel.org/doc/Documentation/kbuild/kconfig-language.txt
#

config EXAMPLES_TELNETD
	bool "Telnet daemon example"
	depends on NETUTILS_TELNETD
	default n
	---help---
		Enable the Telnet daemon example

if EXAMPLES_TELNETD

config EXAMPLES_TELNETD_NOMAC
	bool "Use Canned MAC Address"
	default n
	---help---
		If the hardware has no MAC address of its own, define this =y to
		provide a bogus address for testing.

config EXAMPLES_TELNETD_IPADDR
	hex "Target IP address"
	default 0x0a000002
	---help---
		The target IP address.  Default 10.0.0.2 (0x0a000002)

config EXAMPLES_TELNETD_DRIPADDR
	hex "Default Router IP address (Gateway)"
	default 0x0a000001
	---help---
		The default router address. Default 10.0.0.1 (0x0a000001)

config EXAMPLES_TELNETD_NETMASK
	hex "Network Mask"
	default 0xffffff00
	---help---
		The network mask.  Default: 255.255.255.0 (0xffffff00)

config EXAMPLES_TELNETD_DAEMONPRIO
	int "Telnet daemon priority"
	default 100
	---help---
		Priority of the Telnetd server daemon.  Default: 100

config EXAMPLES_TELNETD_DAEMONSTACKSIZE
	int "Telnet daemon stack size"
	default 2048
	---help---
		Stack size allocated for the Telnet daemon. Default: 2048

config EXAMPLES_TELNETD_CLIENTPRIO
	int "Telnet client priority"
	default 100
	---help---
		Priority of the Telnet client.  Default: 100

config EXAMPLES_TELNETD_CLIENTSTACKSIZE
	int "Telnet client stack size"
	default 2048
	---help---
		Stack size allocated for the Telnet client. Default: 2048

endif

config USER_ENTRYPOINT
	string
	default "telnetd_main" if ENTRY_TELNETD
```

## apps/examples/testcase/Kconfig
```kconfig
#
# For a description of the syntax of this configuration file,
# see kconfig-language at https://www.kernel.org/doc/Documentation/kbuild/kconfig-language.txt
#

menuconfig EXAMPLES_TESTCASE
	bool "TestCase Example"
	default n
	---help---
		Enable the TestCase Example

if EXAMPLES_TESTCASE
config DISABLE_MANUAL_TESTCASE
	bool "Disable Manual Testcase"
	default n

source "$APPSDIR/examples/testcase/le_tc/drivers/Kconfig"
source "$APPSDIR/examples/testcase/le_tc/filesystem/Kconfig"
source "$APPSDIR/examples/testcase/le_tc/kernel/Kconfig"
source "$APPSDIR/examples/testcase/le_tc/network/Kconfig"
source "$APPSDIR/examples/testcase/le_tc/ttrace/Kconfig"
source "$APPSDIR/examples/testcase/le_tc/tcp_tls/Kconfig"
source "$APPSDIR/examples/testcase/ta_tc/arastorage/utc/Kconfig"
source "$APPSDIR/examples/testcase/ta_tc/arastorage/itc/Kconfig"
source "$APPSDIR/examples/testcase/ta_tc/audio/utc/Kconfig"
source "$APPSDIR/examples/testcase/ta_tc/audio/itc/Kconfig"
source "$APPSDIR/examples/testcase/ta_tc/device_management/utc/Kconfig"
source "$APPSDIR/examples/testcase/ta_tc/device_management/itc/Kconfig"
source "$APPSDIR/examples/testcase/ta_tc/mqtt/utc/Kconfig"
source "$APPSDIR/examples/testcase/ta_tc/mqtt/itc/Kconfig"
source "$APPSDIR/examples/testcase/ta_tc/media/utc/Kconfig"
source "$APPSDIR/examples/testcase/ta_tc/media/itc/Kconfig"
source "$APPSDIR/examples/testcase/ta_tc/systemio/utc/Kconfig"
source "$APPSDIR/examples/testcase/ta_tc/systemio/itc/Kconfig"
source "$APPSDIR/examples/testcase/ta_tc/task_manager/utc/Kconfig"
source "$APPSDIR/examples/testcase/ta_tc/task_manager/itc/Kconfig"
source "$APPSDIR/examples/testcase/ta_tc/eventloop/utc/Kconfig"
source "$APPSDIR/examples/testcase/ta_tc/wifi_manager/utc/Kconfig"
source "$APPSDIR/examples/testcase/ta_tc/wifi_manager/itc/Kconfig"
source "$APPSDIR/examples/testcase/ta_tc/security/utc/Kconfig"
source "$EXTERNALDIR/libcxx-test/Kconfig"
endif #EXAMPLES_TESTCASE

config USER_ENTRYPOINT
	string
	default "tc_main" if ENTRY_TESTCASE
```

## apps/examples/testcase/asan_tc/Kconfig
```kconfig
#
# For a description of the syntax of this configuration file,
# see kconfig-language at https://www.kernel.org/doc/Documentation/kbuild/kconfig-language.txt
#

config EXAMPLES_TESTCASE_ASAN
	bool "Address Sanitizer TestCase Example"
	default n
	depends on MM_ASAN_RT && !ASAN_ENABLE
	---help---
		Enable the Address Sanitizer TestCase example
```

## apps/examples/testcase/le_tc/compression/Kconfig
```kconfig
#
# For a description of the syntax of this configuration file,
# see kconfig-language at https://www.kernel.org/doc/Documentation/kbuild/kconfig-language.txt
#

menuconfig EXAMPLES_TESTCASE_COMPRESSION
	bool "Compression TestCase Example"
	default n
	---help---
		Enable the Compression TestCase Example

if EXAMPLES_TESTCASE_COMPRESSION

config TC_LZMA
	bool "LZMA Compression/Decompression testcase"
	default n
	select LIBLZMA

config TC_COMPRESS_READ
	bool "Testcase for Compression APIs"
	default n
	select DRIVERS_KERNEL_TEST
	select LIBLZMA
	select COMPRESSED_BINARY

endif
```

## apps/examples/testcase/le_tc/filesystem/Kconfig
```kconfig
#
# For a description of the syntax of this configuration file,
# see kconfig-language at https://www.kernel.org/doc/Documentation/kbuild/kconfig-language.txt
#

config EXAMPLES_TESTCASE_FILESYSTEM
	bool "FileSystem TestCase Example"
	default n
	depends on !BUILD_PROTECTED
	---help---
		Enable the FileSystem TestCase example

if EXAMPLES_TESTCASE_FILESYSTEM

config TC_FS_PROCFS
	bool "Procfs Testcase"
	default n
	select FS_PROCFS

config TC_FS_MOPS
	bool "FS Mount Point Opertions"
	default n
	---help---
		Enable FS Mount Point Opertions Testcase

if TC_FS_MOPS
config TC_FS_TMPFS_MOPS
	bool "TMPFS Mount Point Opertions"
	default y
	select FS_TMPFS
	---help---
		Enable TMPFS Mount Point Opertions

config TC_FS_ROMFS_MOPS
	bool "ROMFS Mount Point Opertions"
	default y
	select FS_ROMFS
	---help---
		Enable ROMFS Mount Point Opertions

config TC_FS_SMARTFS_MOPS
	bool "SMARTFS Mount Point Opertions"
	default y
	select FS_SMARTFS
	---help---
		Enable SMARTFS Mount Point Opertions
endif

config ITC_FS
	bool "ITC Filesystem"
	default n
	select FS

endif
```
