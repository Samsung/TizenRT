## apps/examples/testcase/le_tc/kernel/Kconfig
```kconfig
#
# For a description of the syntax of this configuration file,
# see kconfig-language at https://www.kernel.org/doc/Documentation/kbuild/kconfig-language.txt
#

menuconfig EXAMPLES_TESTCASE_KERNEL
	bool "Kernel TestCase Example"
	default y
	select KERNEL_TEST_DRV
	---help---
		Enable the Kernel TestCase Example

if EXAMPLES_TESTCASE_KERNEL
config DEBUG_TC_KN
	bool "Kernel Testcase Debug Output"
	default n
	depends on DEBUG

config TC_KN_ALL
	bool "All"
	default y
	select TC_KERNEL_CLOCK
	select TC_KERNEL_ENVIRON
	select TC_KERNEL_ERRNO
	select TC_KERNEL_LIBC_FIXEDMATH if LIBM
	select TC_KERNEL_LIBC_INTTYPES
	select TC_KERNEL_LIBC_LIBGEN
	select TC_KERNEL_LIBC_MATH if LIBM
	select TC_KERNEL_LIBC_MISC
	select TC_KERNEL_LIBC_MQUEUE
	select TC_KERNEL_LIBC_PTHREAD
	select TC_KERNEL_LIBC_QUEUE if !DISABLE_MQUEUE
	select TC_KERNEL_LIBC_SCHED
	select TC_KERNEL_LIBC_SEMAPHORE
	select TC_KERNEL_LIBC_SIGNAL
	select TC_KERNEL_LIBC_STDIO
	select TC_KERNEL_LIBC_STDLIB
	select TC_KERNEL_LIBC_STRING
	select TC_KERNEL_LIBC_SYSLOG
	select TC_KERNEL_LIBC_TIMER
	select TC_KERNEL_LIBC_UNISTD
	select TC_KERNEL_MQUEUE if !DISABLE_MQUEUE
	select TC_KERNEL_PTHREAD
	select TC_KERNEL_ROUNDROBIN if RR_INTERVAL != 0
	select TC_KERNEL_SCHED
	select TC_KERNEL_SEMAPHORE
	select TC_KERNEL_SIGNAL
	select TC_KERNEL_TASK
	select TC_KERNEL_TIMER
	select TC_KERNEL_UMM_HEAP
	select TC_KERNEL_WORK_QUEUE if SCHED_WORKQUEUE || LIB_USRWORK
	select ITC_KERNEL_ENVIRON
	select ITC_KERNEL_LIBC_PTHREAD
	select ITC_KERNEL_LIBC_SEMAPHORE
	select ITC_KERNEL_SEMAPHORE
	select ITC_KERNEL_SCHED
	select ITC_KERNEL_TIMER
	select ITC_KERNEL_PTHREAD

config TC_KERNEL_CLOCK
	bool "Clock"
	default n

config TC_KERNEL_ENVIRON
	bool "Environ"
	default n

config TC_KERNEL_ERRNO
	bool "Errno"
	default n

config TC_KERNEL_GROUP
	bool "Group"
	default n
	select SCHED_HAVE_PARENT
	select SCHED_CHILD_STATUS

config TC_KERNEL_LIBC_FIXEDMATH
	bool "Libc FixedMath"
	default n
	depends on LIBM

config TC_KERNEL_LIBC_INTTYPES
	bool "Libc Inttypes"
	default n

config TC_KERNEL_LIBC_LIBGEN
	bool "Libc Libgen"
	default n

config TC_KERNEL_LIBC_MATH
	bool "Libc Math"
	default n
	depends on LIBM

config TC_KERNEL_LIBC_MISC
	bool "Libc Misc"
	default n
	select DEBUG
	select DEBUG_ERROR
	select DEBUG_VERBOSE

config TC_KERNEL_LIBC_MQUEUE
	bool "Libc Mqueue"
	default n
	depends on !DISABLE_MQUEUE

config TC_KERNEL_LIBC_PTHREAD
	bool "Libc Pthread"
	default n
	select MUTEX_TYPES

config TC_KERNEL_LIBC_QUEUE
	bool "Libc Queue"
	default n

config TC_KERNEL_LIBC_SCHED
	bool "Libc Sched"
	default n

config TC_KERNEL_LIBC_SEMAPHORE
	bool "Libc Semaphore"
	default n

config TC_KERNEL_LIBC_SIGNAL
	bool "Libc Signal"
	default n

config TC_KERNEL_LIBC_STDIO
	bool "Libc Stdio"
	default n

config TC_KERNEL_LIBC_STDLIB
	bool "Libc Stdlib"
	default n

config TC_KERNEL_LIBC_STRING
	bool "Libc String"
	default n

config TC_KERNEL_LIBC_TIMER
	bool "Libc Timer"
	default n

config TC_KERNEL_LIBC_UNISTD
	bool "Libc Unistd"
	default n

config TC_KERNEL_LIBC_SYSLOG
	bool "Libc Syslog"
	default n

config TC_KERNEL_MQUEUE
	bool "Mqueue"
	default n
	depends on !DISABLE_MQUEUE

config TC_KERNEL_PTHREAD
	bool "Pthread"
	default n
	select MUTEX_TYPES

config TC_KERNEL_ROUNDROBIN
	bool "RoundRobin"
	default n
	depends on RR_INTERVAL != 0

config TC_KERNEL_SCHED
	bool "Sched"
	default n
#	select SCHED_HAVE_PARENT

config TC_KERNEL_SEMAPHORE
	bool "Semaphore"
	default n
	select DEBUG

config TC_KERNEL_SIGNAL
	bool "Signal"
	default n

config TC_KERNEL_TASK
	bool "Task"
	default n

config TC_KERNEL_TERMIOS
	bool "Termios"
	default n

config TC_KERNEL_TIMER
	bool "Timer"
	default n

config TC_KERNEL_UMM_HEAP
	bool "Umm Heap"
	default n

config TC_KERNEL_TASH_HEAPINFO
	bool "Heapinfo"
	default n

config TC_KERNEL_TASH_STACKMONITOR
	bool "StackMonitor"
	default n

config TC_KERNEL_WORK_QUEUE
	bool "wqueue"
	default n
	depends on SCHED_WORKQUEUE || LIB_USRWORK

config TC_KERNEL_MEMORY_SAFETY
	bool "Memory Safety"
	default n
	depends on !DISABLE_MQUEUE

config ITC_KERNEL_ENVIRON
	bool "ITC Environ"
	default n

if ITC_KERNEL_ENVIRON
config ITC_ENV_LOOP_SIZE
	int "Iterator Count"
	default 100
endif

config ITC_KERNEL_LIBC_PTHREAD
	bool "ITC libc Pthread"
	default n
if ITC_KERNEL_LIBC_PTHREAD
config ITC_LIBC_PTHREAD_LOOP_SIZE
	int "Iterator Count"
	default 100
endif

config ITC_KERNEL_LIBC_SEMAPHORE
	bool "ITC Libc Semaphore"
	default n

config ITC_KERNEL_SEMAPHORE
	bool "ITC Semaphore"
	default n
	select DEBUG
if ITC_KERNEL_SEMAPHORE
config ITC_KERN_SEM_LOOP_SIZE
	int "Iterator Count"
	default 100
endif

config ITC_KERNEL_SCHED
	bool "ITC Sched"
	default n

config ITC_KERNEL_TIMER
	bool "ITC Timer"
	default n

config ITC_KERNEL_PTHREAD
	bool "ITC Pthread"
	default n
	select MUTEX_TYPES
if ITC_KERNEL_PTHREAD
config ITC_KERN_PTHREAD_LOOP_SIZE
	int "Iterator Count"
	default 100
endif


endif #EXAMPLES_TESTCASE_KERNEL
```

## apps/examples/testcase/le_tc/network/Kconfig
```kconfig
#
# For a description of the syntax of this configuration file,
# see kconfig-language at https://www.kernel.org/doc/Documentation/kbuild/kconfig-language.txt
#

menuconfig EXAMPLES_TESTCASE_NETWORK
	bool "Network TestCase Example"
	default n
	select NET_LWIP_ERROR if NET_LWIP
	---help---
		Enable the Network TestCase Example

if EXAMPLES_TESTCASE_NETWORK

config TC_NET_ALL
	bool "All"
	default n
	select TC_NET_SOCKET
	select TC_NET_SOCKET_SHARE
	select TC_NET_PBUF
	select TC_NET_SETSOCKOPT
	select TC_NET_CONNECT
	select TC_NET_CLOSE
	select TC_NET_BIND
	select TC_NET_LISTEN
	select TC_NET_GETSOCKNAME
	select TC_NET_GETSOCKOPT
	select TC_NET_FCNTL
	select TC_NET_IOCTL
	select TC_NET_ACCEPT
	select TC_NET_SEND
	select TC_NET_RECV
	select TC_NET_GETPEERNAME
	select TC_NET_SENDTO
	select TC_NET_RECVFROM
	select TC_NET_SHUTDOWN
	select TC_NET_DHCPC
	select TC_NET_SELECT
	select TC_NET_INET
	select TC_NET_ETHER
	select TC_NET_NETDB
	select ITC_NET_CLOSE
	select ITC_NET_LISTEN
	select ITC_NET_SETSOCKOPT
	select ITC_NET_SEND
	select ITC_NET_INET
	select ITC_NET_NETDB
	select ITC_NET_CONNECT

config TC_NET_SOCKET
	bool "socket() api"
	depends on NET_LWIP_IGMP
	depends on NET_IPv6
	default n

config TC_NET_SOCKET_SHARE
	bool "socket share test"
	default n
	---help---
		verify that socket is shared among tasks which are in same task group

config TC_NET_PBUF
	bool "pbuf() api "
	default n
	select DRIVERS_OS_API_TEST

config TC_NET_SETSOCKOPT
	bool "setsockopt() api"
	default n

config TC_NET_CONNECT
	bool "connect() api"
	default n

config TC_NET_CLOSE
	bool "close() api"
	default n

config TC_NET_BIND
	bool "bind() api"
	default n

config TC_NET_LISTEN
	bool "listen() api"
	default n

config TC_NET_GETSOCKNAME
	bool "getsockname() api"
	default n

config TC_NET_GETSOCKOPT
	bool "getsockopt() api"
	default n

config TC_NET_FCNTL
	bool "fcntl() api"
	default n

config TC_NET_IOCTL
	bool "ioctl() api"
	default n
	---help---
		tc_net_ioctl_fionread_p requires NET_SO_RCVBUF
		itc_net_setsockopt_p_sndtimo requires NET_SO_SNDTIMEO
		
config TC_NET_ACCEPT
	bool "accept() api"
	default n

config TC_NET_SEND
	bool "send() api"
	default n

config TC_NET_RECV
	bool "recv() api"
	default n

config TC_NET_GETPEERNAME
	bool "getpeername() api"
	default n

config TC_NET_SENDTO
	bool "sendto() api"
	default n

config TC_NET_RECVFROM
	bool "recvfrom() api"
	default n

config TC_NET_SHUTDOWN
	bool "shutdown() api"
	default n

config TC_NET_DHCPC
	bool "dhcpc() api"
	default n

config TC_NET_INET
	bool "inet() api"
	default n

config TC_NET_ETHER
	bool "ether() api"
	default n

config TC_NET_NETDB
	bool "netdb() api"
	default n

config ITC_NET_CLOSE
	bool "ITC close() api"
	default n

config ITC_NET_LISTEN
	bool "ITC listen() api"
	default n

config ITC_NET_SETSOCKOPT
	bool "ITC setsockopt() api"
	default n
	---help---
		itc_net_setsockopt_p_rcvbuf requires NET_SO_RCVBUF

config ITC_NET_SEND
	bool "ITC send() api"
	default n

config ITC_NET_INET
	bool "ITC inet() api"
	default n

config ITC_NET_NETDB
	bool "ITC netdb() api"
	default n

config ITC_NET_CONNECT
	bool "ITC connect() api"
	default n

endif #EXAMPLES_TESTCASE_NETWORK
```

## apps/examples/testcase/le_tc/pm/Kconfig
```kconfig
#
# For a description of the syntax of this configuration file,
# see kconfig-language at https://www.kernel.org/doc/Documentation/kbuild/kconfig-language.txt
#

menuconfig EXAMPLES_TESTCASE_PM
	bool "PM TestCase Example"
	default n
	---help---
		Enable the PM TestCase Example
```

## apps/examples/testcase/le_tc/tcp_tls/Kconfig
```kconfig
#
# For a description of the syntax of this configuration file,
# see kconfig-language at https://www.kernel.org/doc/Documentation/kbuild/kconfig-language.txt
#

config EXAMPLES_TESTCASE_TCP_TLS_STRESS 
	bool "TCP TLS Strss Test Example"
	default n
	select TLS_TCP_STRESS
	depends on STRESS_TOOL
	depends on EXAMPLES_TESTCASE
	depends on NET_SECURITY_TLS
	depends on WIFI_MANAGER
	---help---
		Enable the TCP TLS Stress Test example

if EXAMPLES_TESTCASE_TCP_TLS_STRESS
config EXAMPLES_TESTCASE_TCP_TLS_TRIAL
	int "Number of test trials"
	default 20
	---help---
		Number of stress test trials

comment "Specify your AP which you want to connect to"
config EXAMPLES_TESTCASE_TCP_TLS_SSID
	string "SSID of AP"
	default "NULL"
	---help---
		Select SSID of AP which you want to connect to

config EXAMPLES_TESTCASE_TCP_TLS_PASSPHRASE
	string "Passphrase of AP"
	default "NULL"
	---help---
		Passphrase of AP which you want to connect to

config EXAMPLES_TESTCASE_TCP_TLS_AUTHENTICATION
	int "Authentication type"
	default 0
	---help---
		0 : Open
		1 : WEP Shared
		2 : WPA PSK
		3 : WPA2 PSK
		4 : WPA and WPA2 PSK
		5 : Unknown

config EXAMPLES_TESTCASE_TCP_TLS_CRYPTO
	int "Encryption type"
	default 0
	---help---
		0 : None
		1 : WEP 64 bits
		2 : WEP 128 bits
		3 : AES
		4 : TKIP
		5 : TIKP and AES
		6 : Unknown

endif #EXAMPLES_TESTCASE_TCP_TLS_STRESS
```

## apps/examples/testcase/le_tc/ttrace/Kconfig
```kconfig
#
# For a description of the syntax of this configuration file,
# see kconfig-language at https://www.kernel.org/doc/Documentation/kbuild/kconfig-language.txt
#

config EXAMPLES_TESTCASE_TTRACE
	bool "T-trace TestCase Example"
	default n
	---help---
		Enable the T-trace TestCase example
```

## apps/examples/testcase/ta_tc/arastorage/itc/Kconfig
```kconfig
#
# For a description of the syntax of this configuration file,
# see kconfig-language at https://www.kernel.org/doc/Documentation/kbuild/kconfig-language.txt
#

config EXAMPLES_TESTCASE_ARASTORAGE_ITC
	bool "Arastorage ITC TestCase Example"
	select ARASTORAGE
	default n
	---help---
		Enable the Arastorage TestCase example
```
