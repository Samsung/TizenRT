## apps/examples/tickless_test/Kconfig
```kconfig
#
# For a description of the syntax of this configuration file,
# see kconfig-language at https://www.kernel.org/doc/Documentation/kbuild/kconfig-language.txt
#

config EXAMPLES_TICKLESS_TEST
	bool "Tickless Kernel test application"
	default n
	---help---
		Enable the Tickless Kernel test application

config USER_ENTRYPOINT
	string
	default "tickless_test_main" if ENTRY_TICKLESS_TEST
```

## apps/examples/timer/Kconfig
```kconfig
#
# For a description of the syntax of this configuration file,
# see kconfig-language at https://www.kernel.org/doc/Documentation/kbuild/kconfig-language.txt
#

config EXAMPLES_TIMER
	bool "Timer Example"
	default n
	depends on TIMER
	---help---
		This application is an example program that opens /dev/timer0
		to set the timer and registers the callback which is called at
		the end of the timer.

if EXAMPLES_TIMER
config EXAMPLES_TIMER_FRT_MEASUREMENT
	bool "FRT Measurement"
	default y
	---help---
		If this config is enabled, elapsed time before and after the timer event
		is measured by Free Run Timer.
endif
```

## apps/examples/tls/selftest/Kconfig
```kconfig
#
# For a description of the syntax of this configuration file,
# see kconfig-language at https://www.kernel.org/doc/Documentation/kbuild/kconfig-language.txt
#

config EXAMPLES_TLS_SELFTEST
	bool "TLS test application"
	default n
	depends on NET_SECURITY_TLS

if EXAMPLES_TLS_SELFTEST

config EXAMPLES_TLS_SELFTEST_PROGNAME
	string "Program name"
	default "tls_selftest"
	depends on BUILD_KERNEL

endif # EXAMPLE_TLS_SELFTEST

config USER_ENTRYPOINT
	string
	default "tls_selftest_main" if ENTRY_TLS_SELFTEST
```
