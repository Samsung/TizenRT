## apps/examples/testcase/ta_tc/araui/utc/Kconfig
```kconfig
#
# For a description of the syntax of this configuration file,
# see kconfig-language at https://www.kernel.org/doc/Documentation/kbuild/kconfig-language.txt
#

config EXAMPLES_TESTCASE_ARAUI_UTC
	bool "AraUI UTC TestCase Example"
	default n
	depends on UI
	---help---
		Enable the UI TestCase Example
```

## apps/examples/testcase/ta_tc/audio/itc/Kconfig
```kconfig
#
# For a description of the syntax of this configuration file,
# see kconfig-language at https://www.kernel.org/doc/Documentation/kbuild/kconfig-language.txt
#

config EXAMPLES_TESTCASE_AUDIO_ITC
	bool "Audio ITC TestCase Example"
	default n
	---help---
		Enable the Audio F/W(Tinyalsa) TestCase example
```

## apps/examples/testcase/ta_tc/audio/utc/Kconfig
```kconfig
#
# For a description of the syntax of this configuration file,
# see kconfig-language at https://www.kernel.org/doc/Documentation/kbuild/kconfig-language.txt
#

config EXAMPLES_TESTCASE_AUDIO_UTC
	bool "Audio UTC TestCase Example"
	default n
	---help---
		Enable the Audio F/W(Tinyalsa) TestCase example
```

## apps/examples/testcase/ta_tc/binary_manager/utc/Kconfig
```kconfig
#
# For a description of the syntax of this configuration file,
# see kconfig-language at https://www.kernel.org/doc/Documentation/kbuild/kconfig-language.txt
#

config EXAMPLES_TESTCASE_BINARY_MANAGER_UTC
	bool "Binary Manager UTC TestCase Example"
	default n
	depends on BINMGR_UPDATE
	---help---
		Enable the Binary Manager UTC TestCase
```

## apps/examples/testcase/ta_tc/ble_manager/utc/Kconfig
```kconfig
#
# For a description of the syntax of this configuration file,
# see kconfig-language at https://www.kernel.org/doc/Documentation/kbuild/kconfig-language.txt
#

config EXAMPLES_TESTCASE_BLE_MANAGER_UTC
	bool "BLE Manager UTC TestCase Example"
	select BLE_MANAGER
	default n
	---help---
		Enable the BLE Manager TestCase Example
```

## apps/examples/testcase/ta_tc/device_management/itc/Kconfig
```kconfig
#
# For a description of the syntax of this configuration file,
# see kconfig-language at https://www.kernel.org/doc/Documentation/kbuild/kconfig-language.txt
#

menuconfig EXAMPLES_TESTCASE_DM_ITC
  bool "Device Management ITC TestCase Example"
  default n
  depends on DM
  ---help---
    Enable the Device Management ITC TestCase Example

if EXAMPLES_TESTCASE_DM_ITC

config ITC_DM_SERVER_IPADDR
  string "Server IP address"
  default "192.168.0.105"

config ITC_DM_SERVER_PORT
  string "Server Port"
  default "5683"
  
config ITC_DM_START
  bool "Start API"
  default n

config ITC_DM_CLOSE
  bool "Close API"
  default n

config ITC_DM_GET_SERVER_ADDR
  bool "Get Server Addrress API"
  default n
  
config ITC_DM_GET_SERVER_PORT
  bool "Get Server Port API"
  default n

config ITC_DM_GET_CLIENT_LIFETIME
  bool "Get Client lifetime API"
  default n

config ITC_DM_GET_CLIENT_STATE
  bool "Get Client state API"
  default n

config ITC_DM_DISPLAY_CLIENT_RESOURCE
  bool "Display Client Resource API"
  default n

config ITC_DM_CONN_GET_RSSI
  bool "Get Rssi API"
  default n
  
config ITC_DM_CONN_GET_INTERFACE
  bool "Get Interface API"
  default n
  
config ITC_DM_CONN_GET_ADDRESS
  bool "Get Address API"
  default n
  
config ITC_DM_CONN_GET_CHANNEL
  bool "Get Channel API"
  default n
  
config ITC_DM_CONN_GET_TX_POWER
  bool "Get Tx Power API"
  default n
  
config ITC_DM_CONN_SET_TX_POWER
  bool "Set Tx Power API"
  default n
  
config ITC_DM_CONN_REGI_LINKUP
  bool "Register LinkUp Callback API"
  default n

config ITC_DM_CONN_REGI_LINKDOWN
  bool "Register LinkDown Callback API"
  default n
  
config ITC_DM_CONN_UNREGI_LINKUP
  bool "Unregister LinkUp Callback API"
  default n
  
config ITC_DM_CONN_UNREGI_LINKDOWN
  bool "Unregister LinkDown Callback API"
  default n
  
endif #EXAMPLES_TESTCASE_DM
```

## apps/examples/testcase/ta_tc/eventloop/utc/Kconfig
```kconfig
#
# For a description of the syntax of this configuration file,
# see kconfig-language at https://www.kernel.org/doc/Documentation/kbuild/kconfig-language.txt
#

config EXAMPLES_TESTCASE_EVENTLOOP_UTC
	bool "Eventloop UTC TestCase Example"
	default n
	depends on EVENTLOOP
	---help---
		Enable the Eventloop TestCase
```

## apps/examples/testcase/ta_tc/media/itc/Kconfig
```kconfig
#
# For a description of the syntax of this configuration file,
# see kconfig-language at https://www.kernel.org/doc/Documentation/kbuild/kconfig-language.txt
#

config EXAMPLES_TESTCASE_MEDIA_ITC
	bool "Media ITC TestCase Example"
	default n
	depends on HAVE_CXXINITIALIZE && LIBCXX && MEDIA
	---help---
		Enable the Media F/W TestCase example
```

## apps/examples/testcase/ta_tc/media/utc/Kconfig
```kconfig
#
# For a description of the syntax of this configuration file,
# see kconfig-language at https://www.kernel.org/doc/Documentation/kbuild/kconfig-language.txt
#

config EXAMPLES_TESTCASE_MEDIA_UTC
	bool "Media UTC TestCase Example"
	default n
	depends on HAVE_CXXINITIALIZE && LIBCXX && MEDIA
	---help---
		Enable the Media F/W TestCase example
```

## apps/examples/testcase/ta_tc/messaging/utc/Kconfig
```kconfig
#
# For a description of the syntax of this configuration file,
# see kconfig-language at https://www.kernel.org/doc/Documentation/kbuild/kconfig-language.txt
#

config EXAMPLES_TESTCASE_MESSAGING_UTC
	bool "Messaging UTC TestCase Example"
	default n
	depends on MESSAGING_IPC
	---help---
		Enable the Messaging F/W TestCase
```

## apps/examples/testcase/ta_tc/mqtt/itc/Kconfig
```kconfig
#
# For a description of the syntax of this configuration file,
# see kconfig-language at https://www.kernel.org/doc/Documentation/kbuild/kconfig-language.txt
#

config EXAMPLES_TESTCASE_MQTT_ITC
	bool "MQTT ITC TestCase Example"
	depends on NETUTILS_MQTT
	default n
	---help---
		Enable the MQTT TestCase example

if EXAMPLES_TESTCASE_MQTT_ITC

config ITC_MQTT_BROKER_ADDR
	string "MQTT broker IP address for ITC"
	default "127.0.0.1"
	---help---
		MQTT broker's ip address to connect

config ITC_MQTT_BROKER_PORT
	int "MQTT broker port for ITC"
	default 1883
	---help---
		MQTT broker's port to connect

endif
```

## apps/examples/testcase/ta_tc/preference/utc/Kconfig
```kconfig
#
# For a description of the syntax of this configuration file,
# see kconfig-language at https://www.kernel.org/doc/Documentation/kbuild/kconfig-language.txt
#

config EXAMPLES_TESTCASE_PREFERENCE_UTC
	bool "Preference UTC TestCase Example"
	default n
	depends on PREFERENCE
	---help---
		Enable the Preference TestCase
```

## apps/examples/testcase/ta_tc/security/utc/Kconfig
```kconfig
#
# For a description of the syntax of this configuration file,
# see kconfig-language at https://www.kernel.org/doc/Documentation/kbuild/kconfig-language.txt
#

menuconfig EXAMPLES_TESTCASE_SECURITY_FRAMEWORK_UTC
	bool "Security Framework UTC TestCase Example"
	select SECURITY_API
	default n
	---help---
		Enable Security Framework TestCase Example

if EXAMPLES_TESTCASE_SECURITY_FRAMEWORK_UTC

config EXAMPLES_TESTCASE_SECURITY_FRAMEWORK_UTC_AUTH
	bool "Security Framework Authentication UTC TestCase Example"
	select SECURITY_AUTH
	default n
	---help---
		Enable Security Framework Authentication TestCase Example

config EXAMPLES_TESTCASE_SECURITY_FRAMEWORK_UTC_CRYPTO
	bool "Security Framework Crypto UTC TestCase Example"
	select SECURITY_CRYPTO
	default n
	---help---
		Enable Security Framework Crypto TestCase Example

config EXAMPLES_TESTCASE_SECURITY_FRAMEWORK_UTC_KEYMGR
	bool "Security Framework Key Manager UTC TestCase Example"
	select SECURITY_KEYMGR
	default n
	---help---
		Enable Security Framework Key Manager TestCase Example

config EXAMPLES_TESTCASE_SECURITY_FRAMEWORK_UTC_SS
	bool "Security Framework Secure Storage UTC TestCase Example"
	select SECURITY_SS
	default n
	---help---
		Enable Security Framework Secure Storage TestCase Example

endif
```

## apps/examples/testcase/ta_tc/st_things/stc/Kconfig
```kconfig
#
# For a description of the syntax of this configuration file,
# see kconfig-language at https://www.kernel.org/doc/Documentation/kbuild/kconfig-language.txt
#

config EXAMPLES_TESTCASE_ST_THINGS_STC
	bool "ST_THINGS STC TestCase Example"
        select ST_THINGS 
        default n
        ---help---
                Enable the st_things TestCase example
```

## apps/examples/testcase/ta_tc/systemio/itc/Kconfig
```kconfig
#
# For a description of the syntax of this configuration file,
# see kconfig-language at https://www.kernel.org/doc/Documentation/kbuild/kconfig-language.txt
#

menuconfig EXAMPLES_TESTCASE_SYSTEMIO_ITC
  bool "System IO ITC TestCase Example"
  default n
  ---help---
    Enable the System IO TestCase Example

if EXAMPLES_TESTCASE_SYSTEMIO_ITC
config SYSIO_ITC_UART
	bool "Sysio UART TC"
	default n

if SYSIO_ITC_UART
config SYSIO_ITC_UART_FILE_PATH
	string "Sysio UART virtual test port"
	default "/dev/ttyS1"
endif

config SYSIO_ITC_SPI
	bool "Sysio SPI TC"
	default n

if SYSIO_ITC_SPI
config SYSIO_ITC_SPI_BUS
	int "Sysio SPI test bus"
	default 0

config SYSIO_ITC_SPI_BITS_PER_WORD
	int "Sysio SPI test bits per word"
	default 8

config SYSIO_ITC_SPI_CHIP_SELECT
	int "Sysio SPI test chip select"
	default 0

config SYSIO_ITC_SPI_FREQUENCY
	int "Sysio SPI test frequency"
	default 12000000

config SYSIO_ITC_SPI_MODE
	int "Sysio SPI test mode"
	default 0
endif

config SYSIO_ITC_I2C
	bool "Sysio I2C TC"
	default n

if SYSIO_ITC_I2C
config SYSIO_ITC_I2C_BUS
	int "Sysio I2C test bus"
	default 0
endif

config SYSIO_ITC_PWM
	bool "Sysio PWM TC"
	default n

if SYSIO_ITC_PWM
config SYSIO_ITC_PWM_DEVICE
	int "Sysio PWM test device"
	default 0

config SYSIO_ITC_PWM_CHANNEL
	int "Sysio PWM test channel"
	default 1

config SYSIO_ITC_PWM_PERIOD
	int "Sysio PWM test period"
	default 1000
endif

config SYSIO_ITC_GPIO
	bool "Sysio GPIO TC"
	default n

if SYSIO_ITC_GPIO
config SYSIO_ITC_GPIO1
	int "Sysio 1st GPIO Number to run testcase"
	default 0

config SYSIO_ITC_GPIO2
	int "Sysio 2nd GPIO Number to run testcase"
	default 0
endif

endif
```

## apps/examples/testcase/ta_tc/systemio/utc/Kconfig
```kconfig
#
# For a description of the syntax of this configuration file,
# see kconfig-language at https://www.kernel.org/doc/Documentation/kbuild/kconfig-language.txt
#

menuconfig EXAMPLES_TESTCASE_SYSTEMIO_UTC
	bool "System IO UTC TestCase Example"
	default n
	---help---
		Enable the System IO TestCase Example

if EXAMPLES_TESTCASE_SYSTEMIO_UTC
config SYSIO_UTC_UART
	bool "Sysio UART TC"
	default n

if SYSIO_UTC_UART
config SYSIO_UTC_UART_FILE_PATH
	string "Virtual File path of uart to run testcase"
	default "/dev/ttyS2"
endif

config SYSIO_UTC_SPI
	bool "Sysio SPI TC"
	default n

if SYSIO_UTC_SPI
config SYSIO_UTC_SPI_BUS
	int "Sysio SPI test bus"
	default 0

config SYSIO_UTC_SPI_BITS_PER_WORD
	int "Sysio SPI test bits per word"
	default 8

config SYSIO_UTC_SPI_CHIP_SELECT
	int "Sysio SPI test chip select"
	default 0

config SYSIO_UTC_SPI_FREQUENCY
	int "Sysio SPI test frequency"
	default 12000000

config SYSIO_UTC_SPI_MODE
	int "Sysio SPI test mode"
	default 0

if SPI_EXCHANGE
config SYSIO_UTC_SPI_BUF_LENGTH
	int "Sysio SPI test buffer length"
	default 16
endif
endif

config SYSIO_UTC_I2C
	bool "Sysio I2C TC"
	default n

if SYSIO_UTC_I2C
config SYSIO_UTC_I2C_BUS
	int "Sysio I2C test bus"
	default 0
endif

config SYSIO_UTC_PWM
	bool "Sysio PWM TC"
	default n

if SYSIO_UTC_PWM
config SYSIO_UTC_PWM_DEVICE
	int "Sysio PWM test device"
	default 0

config SYSIO_UTC_PWM_CHANNEL
	int "Sysio PWM test channel"
	default 1

config SYSIO_UTC_PWM_PERIOD
	int "Sysio PWM test period"
	default 1000
endif

config SYSIO_UTC_GPIO
	bool "Sysio GPIO TC"
	default n

if SYSIO_UTC_GPIO
config SYSIO_UTC_GPIO1
	int "1st GPIO Number to run testcase"
	default 0

config SYSIO_UTC_GPIO2
	int "2nd GPIO Number to run testcase"
	default 0
endif

config SYSIO_UTC_ADC
	bool "Sysio ADC TC"
	depends on IOTBUS_ADC
	default n
endif
```

## apps/examples/testcase/ta_tc/task_manager/itc/Kconfig
```kconfig
#
# For a description of the syntax of this configuration file,
# see kconfig-language at https://www.kernel.org/doc/Documentation/kbuild/kconfig-language.txt
#

config EXAMPLES_TESTCASE_TASK_MANAGER_ITC
	bool "Task Manager ITC TestCase Example"
	default n
	depends on TASK_MANAGER
	---help---
		Enable the Task Manager TestCase
```

## apps/examples/testcase/ta_tc/task_manager/utc/Kconfig
```kconfig
#
# For a description of the syntax of this configuration file,
# see kconfig-language at https://www.kernel.org/doc/Documentation/kbuild/kconfig-language.txt
#

config EXAMPLES_TESTCASE_TASK_MANAGER_UTC
	bool "Task Manager UTC TestCase Example"
	default n
	depends on TASK_MANAGER
	---help---
		Enable the Task Manager TestCase
```

## apps/examples/testcase/ta_tc/wifi_manager/itc/Kconfig
```kconfig
#
# For a description of the syntax of this configuration file,
# see kconfig-language at https://www.kernel.org/doc/Documentation/kbuild/kconfig-language.txt
#

config EXAMPLES_TESTCASE_WIFI_MANAGER_ITC
	bool "Wi-Fi Manager ITC TestCase Example"
	select WIFI_MANAGER
	default n
	---help---
		Enable the Wi-Fi Manager TestCase Example

if EXAMPLES_TESTCASE_WIFI_MANAGER_ITC
comment "Specify your AP which you want to connect to"

config EXAMPLES_TESTCASE_WIFI_MANAGER_ITC_SSID
	string "SSID of AP"
	default "NULL"
	---help---
		Select SSID of AP which you want to connect to

config EXAMPLES_TESTCASE_WIFI_MANAGER_ITC_PASSPHRASE
	string "Passphrase of AP"
	default "NULL"
	---help---
		Passphrase of AP which you want to connect to

config EXAMPLES_TESTCASE_WIFI_MANAGER_ITC_AUTHENTICATION
	int "Authentication type"
	default 0
	---help---
		0 : Open
		1 : WEP Shared
		2 : WPA PSK
		3 : WPA2 PSK
		4 : WPA and WPA2 PSK
		5 : Unknown

config EXAMPLES_TESTCASE_WIFI_MANAGER_ITC_CRYPTO
	int "Encryption type"
	default 0
	---help---
		0 : None
		1 : WEP 64 bits
		2 : WEP 128 bits
		3 : AES
		4 : TKIP
		5 : TIKP and AES
		6 : Unknown

comment "Specify SoftAP which is used for easy-setup" 

config EXAMPLES_TESTCASE_WIFI_MANAGER_ITC_SOFTAP_SSID
	string "SSID of SoftAP"
	default "PKES"
	---help---
		Name SSID of SoftAP

config EXAMPLES_TESTCASE_WIFI_MANAGER_ITC_SOFTAP_CHANNEL
	int "Channel of SoftAP"
	default 1
	---help---
		Select the channel number of SoftAP

config EXAMPLES_TESTCASE_WIFI_MANAGER_ITC_SOFTAP_PASSPHRASE
	string "Passphrase of SoftAP"
	default "1111122222"
	---help---
		Passphrase of SoftAP

endif #EXAMPLES_TESTCASE_WIFI_MANAGER_ITC
```

## apps/examples/testcase/ta_tc/wifi_manager/utc/Kconfig
```kconfig
#
# For a description of the syntax of this configuration file,
# see kconfig-language at https://www.kernel.org/doc/Documentation/kbuild/kconfig-language.txt
#

config EXAMPLES_TESTCASE_WIFI_MANAGER_UTC
	bool "Wi-Fi Manager UTC TestCase Example"
	select WIFI_MANAGER
	default n
	---help---
		Enable the Wi-Fi Manager TestCase Example
```

## apps/examples/thingseasysetup/Kconfig
```kconfig
#
# For a description of the syntax of this configuration file,
# see kconfig-language at https://www.kernel.org/doc/Documentation/kbuild/kconfig-language.txt
#

config EXAMPLES_THINGSEASYSETUP
	bool "Things Easysetup example"
	default n
	---help---
		Enable the THINGS Easysetup example

if EXAMPLES_THINGSEASYSETUP

config EXAMPLES_THINGSEASYSETUP_PROGNAME
	string "Program name"
	default "thingseasysetup"
	depends on BUILD_KERNEL
	---help---
		This is the name of the program that will be use when the NSH ELF
		program is installed.

endif

config USER_ENTRYPOINT
	string
	default "thingseasysetup_main" if ENTRY_THINGSEASYSETUP
```

## apps/examples/tick_compensation_test/Kconfig
```kconfig
#
# For a description of the syntax of this configuration file,
# see kconfig-language at https://www.kernel.org/doc/Documentation/kbuild/kconfig-language.txt
#

config EXAMPLES_TICK
	bool "Tick Compensation Test"
	default n
	depends on BUILD_FLAT
	---help---
		This application is testing whether the tick compensation works correctly or not.

config USER_ENTRYPOINT
	string
	default "tick_compensation_test" if ENTRY_TICK
```
