## apps/examples/board_specific_demo/ameba_cmsis_nn_demo/Kconfig
```kconfig
#
# For a description of the syntax of this configuration file,
# see kconfig-language at https://www.kernel.org/doc/Documentation/kbuild/kconfig-language.txt
#

config EXAMPLES_CMSIS_NN
	bool "CMSIS NN example"
	default n
	depends on AMEBAD_CMSIS_NN
	---help---
		Enable the CMSIS NN example

config USER_ENTRYPOINT
	string
	default "cmsis_nn" if ENTRY_CMSIS_NN
```

## apps/examples/board_specific_demo/ameba_mipi_demo/Kconfig
```kconfig
#
# For a description of the syntax of this configuration file,
# see kconfig-language at https://www.kernel.org/doc/Documentation/kbuild/kconfig-language.txt
#

config EXAMPLES_AMEBA_MIPI
	bool "AMEBA_MIPI example"
	default n
	select AMEBASMART_MIPI
	---help---
		Enable AMEBA_MIPI Example

config USER_ENTRYPOINT
	string
	default "ameba_mipi" if ENTRY_AMEBA_MIPI
```

## apps/examples/board_specific_demo/ameba_secure_storage_demo/Kconfig
```kconfig
#
# For a description of the syntax of this configuration file,
# see kconfig-language at https://www.kernel.org/doc/Documentation/kbuild/kconfig-language.txt
#

config EXAMPLES_SSTORAGE
	bool "Secure Storage example"
	default n
	depends on SE_AMEBA
	---help---
		Enable the Secure Storage example

config USER_ENTRYPOINT
	string
	default "sstorage" if ENTRY_SSTORAGE
```

## apps/examples/board_specific_demo/ameba_secure_world_demo/Kconfig
```kconfig
#
# For a description of the syntax of this configuration file,
# see kconfig-language at https://www.kernel.org/doc/Documentation/kbuild/kconfig-language.txt
#

config EXAMPLES_SECURE_WORLD
	bool "Secure World example"
	default n
	depends on ARMV8M_TRUSTZONE && SE_AMEBA
	---help---
		Enable the Secure World example

config USER_ENTRYPOINT
	string
	default "secure_world" if ENTRY_SECURE_WORLD
```

## apps/examples/board_specific_demo/ameba_ss_write_protection_demo/Kconfig
```kconfig
#
# For a description of the syntax of this configuration file,
# see kconfig-language at https://www.kernel.org/doc/Documentation/kbuild/kconfig-language.txt
#

config EXAMPLES_SSTORAGE
	bool "Secure Storage Write Protecion example"
	default n
	depends on SE_AMEBA && BUILD_FLAT && MTD_BYTE_WRITE
	---help---
		Enable the Secure Storage Write Protection example

config USER_ENTRYPOINT
	string
	default "sstorage" if ENTRY_SSTORAGE
```

## apps/examples/board_specific_demo/ameba_wifi_csi_demo/Kconfig
```kconfig
#
# For a description of the syntax of this configuration file,
# see kconfig-language at https://www.kernel.org/doc/Documentation/kbuild/kconfig-language.txt
#

config EXAMPLES_WIFICSI
	bool "WIFI CSI example"
	default n
	---help---
		Enable WIFI CSI Example

config USER_ENTRYPOINT
	string
	default "wificsi" if ENTRY_WIFICSI
```

## apps/examples/board_specific_demo/artik_demo/Kconfig
```kconfig
#
# For a description of the syntax of this configuration file,
# see kconfig-language at https://www.kernel.org/doc/Documentation/kbuild/kconfig-language.txt
#

menuconfig EXAMPLES_ARTIK_DEMO
	bool "Artik API Demo Example"
	depends on DM
	default n
	---help---
		Enable the artik demo example

if EXAMPLES_ARTIK_DEMO

config AP_SSID
	string "wifi ap ssid"
	default "SSID"

config AP_PASS
	string "wifi ap password"
	default "PASSWORD"

config AP_SECURITY
	string "wifi join security"
	default "wpa2_aes"

config ARTIK_CLOUD_BEARER
	string "Artik Cloud User"
	default ""

config ARTIK_CLOUD_DID
	string "Artik Cloud Device id"
	default ""

endif #EXAMPLES_ARTIK_DEMO

config USER_ENTRYPOINT
	string
	default "artik_demo_main" if ENTRY_ARTIK_DEMO
```

## apps/examples/board_specific_demo/cy4390x_demo/Kconfig
```kconfig
#
# For a description of the syntax of this configuration file,
# see kconfig-language at https://www.kernel.org/doc/Documentation/kbuild/kconfig-language.txt
#

config EXAMPLES_CY4390x_DEMO
	bool "cy4390x demo example"
	default n
	depends on ARCH_BOARD_CY4390x
	---help---
		Enable the cy4390x demo example
```

## apps/examples/bundle_test/Kconfig
```kconfig
#
# For a description of the syntax of this configuration file,
# see kconfig-language at https://www.kernel.org/doc/Documentation/kbuild/kconfig-language.txt
#

config EXAMPLES_BUNDLE_TEST
	bool "Bundle Test Example"
	depends on DATA_BUNDLE
	default n
	---help---
		Enable the Bundle Test Example

config USER_ENTRYPOINT
	string
	default "bundle_test_main" if ENTRY_BUNDLE_TEST
```

## apps/examples/camera/Kconfig
```kconfig
#
# For a description of the syntax of this configuration file,
# see kconfig-language at https://www.kernel.org/doc/Documentation/kbuild/kconfig-language.txt
#

config EXAMPLES_CAMERATEST
	bool "Camera example"
	default n
	depends on VIDEO_SOURCE
	---help---
		Enable the camera example

config USER_ENTRYPOINT
	string
	default "camera_main" if ENTRY_CAMERATEST
```

## apps/examples/connect_test/Kconfig
```kconfig
#
# For a description of the syntax of this configuration file,
# see kconfig-language at https://www.kernel.org/doc/Documentation/kbuild/kconfig-language.txt
#

config EXAMPLES_CONNECT_TEST
	bool "Connect Test"
	default n
	depends on WIFI_MANAGER
	depends on NET_LWIP_DHCP
	depends on NET_SECURITY_TLS
	---help---
		 Connect Test program

config USER_ENTRYPOINT
	string
	default "connect_test_main" if ENTRY_CONNECT_TEST
```

## apps/examples/context_switching_performance/Kconfig
```kconfig
#
# For a description of the syntax of this configuration file,
# see kconfig-language at https://www.kernel.org/doc/Documentation/kbuild/kconfig-language.txt
#

config EXAMPLES_CTX_SWITCH_PERFORMANCE
	bool "\"Context Switching Performance\" example"
	default n
	depends on CLOCK_MONOTONIC
	---help---
		Measure the context switching time consumption between two tasks.
		They call sched_yield() 1,000,000 * 2 times, measuring the time through clock_gettime(CLOCK_MONOTONIC, ..).
		This test is meaningful only when there is no irq or other highest priority tasks.

config USER_ENTRYPOINT
	string
	default "ctx_switch_main" if ENTRY_CTX_SWITCH
```

## apps/examples/control_log/Kconfig
```kconfig
#
# For a description of the syntax of this configuration file,
# see kconfig-language at https://www.kernel.org/doc/Documentation/kbuild/kconfig-language.txt
#

config EXAMPLES_CTRLOG
	bool "network logging tool"
	default n
	---help---
		Enable network logging tool

config USER_ENTRYPOINT
	string
	default "ctrlog_main" if ENTRY_CTRLOG
```

## apps/examples/csifw_sample/Kconfig
```kconfig
#
# For a description of the syntax of this configuration file,
# see kconfig-language at https://www.kernel.org/doc/Documentation/kbuild/kconfig-language.txt
#

config EXAMPLES_CSIFW_SAMPLE
	bool "CSIFW Sample Application"
	default n
	depends on CSIFW
	---help---
		CSIFW Sample Application
```

## apps/examples/csifw_test/Kconfig
```kconfig
#
# For a description of the syntax of this configuration file,
# see kconfig-language at https://www.kernel.org/doc/Documentation/kbuild/kconfig-language.txt
#

config EXAMPLES_CSIFW_TEST
	bool "CSIFW Test Application"
	default n
	depends on CSIFW
	---help---
		CSIFW Test Application
```

## apps/examples/curl_test/Kconfig
```kconfig
#
# For a description of the syntax of this configuration file,
# see kconfig-language at https://www.kernel.org/doc/Documentation/kbuild/kconfig-language.txt
#

config EXAMPLES_CURLTEST
	bool "curl test example"
	default n
	select ENABLE_CURL
	---help---
		Enable the curl example

config USER_ENTRYPOINT
	string
	default "curl_main" if ENTRY_CURLTEST
```

## apps/examples/cxxtest/Kconfig
```kconfig
#
# For a description of the syntax of this configuration file,
# see kconfig-language at https://www.kernel.org/doc/Documentation/kbuild/kconfig-language.txt
#

config EXAMPLES_CXXTEST
	bool "C++ test program"
	default n
	depends on HAVE_CXXINITIALIZE
	---help---
		Enable the C++ Test program

config USER_ENTRYPOINT
	string
	default "cxxtest_main" if ENTRY_CXXTEST
```

## apps/examples/cy4390x_demo/Kconfig
```kconfig
#
# For a description of the syntax of this configuration file,
# see kconfig-language at https://www.kernel.org/doc/Documentation/kbuild/kconfig-language.txt
#

config EXAMPLES_CY4390x_DEMO
	bool "cy4390x demo example"
	default n
	---help---
		Enable the cy4390x demo example
```

## apps/examples/dhry/Kconfig
```kconfig
#
# For a description of the syntax of this configuration file,
# see kconfig-language at https://www.kernel.org/doc/Documentation/kbuild/kconfig-language.txt
#

config EXAMPLES_DHRY
	bool "Dhrystone test"
	default n
	---help---
		Enable Dhrystone test
```

## apps/examples/dm_wifi_test/Kconfig
```kconfig
#
# For a description of the syntax of this configuration file,
# see kconfig-language at https://www.kernel.org/doc/Documentation/kbuild/kconfig-language.txt
#

config EXAMPLES_DM_WIFI_TEST
	bool "DM WIFI example"
	depends on DM
	depends on NETUTILS_WIFI
	default n
	---help---
		Enable the WIFI APIs example. This application features a set
		of DM API calls to start WiFi, connect to an Access Point,
		perform DHCP, as well as channel scanning.

config USER_ENTRYPOINT
	string
	default "wifi_test_main" if ENTRY_DM_WIFI_TEST
```

## apps/examples/dnsclient_test/Kconfig
```kconfig
#
# For a description of the syntax of this configuration file,
# see misc/tools/kconfig-language.txt.
#

config EXAMPLES_DNSCLIENT_TEST
	bool "\"DNS Client Test\" example"
	default n
	depends on NET_LWIP_NETDB
	---help---
		Enable the \"DNS Client Test\" example

if EXAMPLES_DNSCLIENT_TEST

config EXAMPLES_DNSCLIENT_TEST_PROGNAME
	string "Program name"
	default "dnsclient"
	depends on BUILD_KERNEL
	---help---
		This is the name of the program that will be use when the NSH ELF
		program is installed.
endif

config USER_ENTRYPOINT
	string
	default "dnsclient_main" if ENTRY_DNSCLIENT_TEST
```

## apps/examples/dtls/client/Kconfig
```kconfig
#
# For a description of the syntax of this configuration file,
# see kconfig-language at https://www.kernel.org/doc/Documentation/kbuild/kconfig-language.txt
#

config EXAMPLES_DTLS_CLIENT
	bool "DTLS client application"
	default n
	depends on NET_SECURITY_TLS

if EXAMPLES_DTLS_CLIENT

config EXAMPLES_DTLS_CLIENT_PROGNAME
	string "Program name"
	default "dtls_client"
	depends on BUILD_KERNEL

endif # EXAMPLE_DTLS_CLIENT

config USER_ENTRYPOINT
	string
	default "dtls_client_main" if ENTRY_DTLS_CLIENT
```

## apps/examples/dtls/server/Kconfig
```kconfig
#
# For a description of the syntax of this configuration file,
# see kconfig-language at https://www.kernel.org/doc/Documentation/kbuild/kconfig-language.txt
#

config EXAMPLES_DTLS_SERVER
	bool "DTLS server application"
	default n
	depends on NET_SECURITY_TLS

if EXAMPLES_DTLS_SERVER

config EXAMPLES_DTLS_SERVER_PROGNAME
	string "Program name"
	default "dtls_server"
	depends on BUILD_KERNEL

endif # EXAMPLE_DTLS_SERVER

config USER_ENTRYPOINT
	string
	default "dtls_server_main" if ENTRY_DTLS_SERVER
```

## apps/examples/easysetup/Kconfig
```kconfig
#
# For a description of the syntax of this configuration file,
# see misc/tools/kconfig-language.txt.
#

config EXAMPLES_EASYSETUP
	bool "Easysetup example"
	depends on NETUTILS_WEBSERVER
	depends on NETUTILS_JSON
	depends on NETUTILS_WIFI
	default n

if EXAMPLES_EASYSETUP

config EXAMPLES_EASYSETUP_PROGNAME
	string "Program name"
	default "easetup example"
	depends on BUILD_KERNEL

endif # EXAMPLES_EASYSETUP
```

## apps/examples/eeprom_test/Kconfig
```kconfig
config EXAMPLES_EEPROM_TEST
	bool "\"EE, TEST\" example in tash"
	default n
	---help---
		Enable the \"EE_TEST\" example in tash
```
