## apps/examples/testcase/ostest/Kconfig
```kconfig
#
# For a description of the syntax of this configuration file,
# see the file kconfig-language.txt in the NuttX tools repository.
#

config TESTING_OSTEST
	bool "OS test example"
	default n
	---help---
		Enable the OS test example

if TESTING_OSTEST

config TESTING_OSTEST_ALL
	bool "All"
	default y
	select TESTING_OSTEST_AIO if FS_AIO
	select TESTING_OSTEST_BARRIER if !DISABLE_PTHREAD
	select TESTING_OSTEST_CANCEL if !DISABLE_PTHREAD
	select TESTING_OSTEST_COND if !DISABLE_PTHREAD
	select TESTING_OSTEST_DEV_NULL if DEV_NULL
	select TESTING_OSTEST_FORK if ARCH_HAVE_FORK
	select TESTING_OSTEST_FPU if ARCH_FPU && SCHED_WAITPID && BUILD_FLAT && !TESTING_OSTEST_FPUTESTDISABLE
	select TESTING_OSTEST_GETOPT
	select TESTING_OSTEST_HRTIMER if HRTIMER && BUILD_FLAT
	select TESTING_OSTEST_MQUEUE if !DISABLE_MQUEUE && !DISABLE_PTHREAD && !DISABLE_SIGNALS
	select TESTING_OSTEST_MULTIUSER if SCHED_USER_IDENTITY && LIBC_PASSWD_FILE
	select TESTING_OSTEST_MUTEX if !DISABLE_PTHREAD
	select TESTING_OSTEST_NSEM if !DISABLE_PTHREAD && FS_NAMED_SEMAPHORES
	select TESTING_OSTEST_NXEVENT if SCHED_EVENTS && BUILD_FLAT
	select TESTING_OSTEST_PERF_GETTIME if ARCH_PERF_EVENTS && !ARCH_PERF_EVENTS_USER_ACCESS && BUILD_FLAT
	select TESTING_OSTEST_POSIXTIMER if !DISABLE_SIGNALS && !DISABLE_POSIX_TIMERS
	select TESTING_OSTEST_PRIOINHERIT if PRIORITY_INHERITANCE && !DISABLE_PTHREAD
	select TESTING_OSTEST_PTHREAD_CLEANUP if !DISABLE_PTHREAD && TLS_NCLEANUP > 0
	select TESTING_OSTEST_PTHREAD_EXIT if !DISABLE_PTHREAD && SCHED_WAITPID
	select TESTING_OSTEST_PTHREAD_RWLOCK if !DISABLE_PTHREAD
	select TESTING_OSTEST_PTHREAD_RWLOCK_CANCEL if !DISABLE_PTHREAD
	select TESTING_OSTEST_RESTART if !BUILD_KERNEL
	select TESTING_OSTEST_RMUTEX if !DISABLE_PTHREAD && PTHREAD_MUTEX_TYPES
	select TESTING_OSTEST_ROBUST if !DISABLE_PTHREAD && !PTHREAD_MUTEX_UNSAFE
	select TESTING_OSTEST_ROUNDROBIN if !DISABLE_PTHREAD && RR_INTERVAL > 0
	select TESTING_OSTEST_SCHED_THREAD_LOCAL if SCHED_THREAD_LOCAL
	select TESTING_OSTEST_SCHEDLOCK if !DISABLE_PTHREAD
	select TESTING_OSTEST_SEM if !DISABLE_PTHREAD
	select TESTING_OSTEST_SEMTIMED if !DISABLE_PTHREAD
	select TESTING_OSTEST_SETJMP if ARCH_SETJMP_H
	select TESTING_OSTEST_SETVBUF if !STDIO_DISABLE_BUFFERING
	select TESTING_OSTEST_SIGEV_THREAD if !DISABLE_POSIX_TIMERS && SIG_EVTHREAD
	select TESTING_OSTEST_SIGHAND if !DISABLE_SIGNALS
	select TESTING_OSTEST_SIGNEST if !DISABLE_SIGNALS
	select TESTING_OSTEST_SIGPROCMASK if !DISABLE_SIGNALS
	select TESTING_OSTEST_SMP_CALL if SMP && BUILD_FLAT
	select TESTING_OSTEST_SPINLOCK if BUILD_FLAT
	select TESTING_OSTEST_SPORADIC if !DISABLE_PTHREAD && SCHED_SPORADIC
	select TESTING_OSTEST_SPORADIC2 if !DISABLE_PTHREAD && SCHED_SPORADIC
	select TESTING_OSTEST_SUSPEND if !DISABLE_SIGNALS && SIG_SIGSTOP_ACTION && SIG_SIGKILL_ACTION && !BUILD_KERNEL
	select TESTING_OSTEST_TIMEDMQUEUE if !DISABLE_MQUEUE && !DISABLE_PTHREAD
	select TESTING_OSTEST_TIMEDWAIT if !DISABLE_PTHREAD
	select TESTING_OSTEST_VFORK if ARCH_HAVE_VFORK && !ARCH_SIM
	select TESTING_OSTEST_WAITPID if SCHED_WAITPID && !BUILD_KERNEL
	select TESTING_OSTEST_WDOG if BUILD_FLAT
	select TESTING_OSTEST_WQUEUE if !DISABLE_PTHREAD && BUILD_FLAT && SCHED_WORKQUEUE

config TESTING_OSTEST_BARRIER
	bool "Barrier"
	default n
	depends on !DISABLE_PTHREAD

config TESTING_OSTEST_CANCEL
	bool "Cancel"
	default n
	depends on !DISABLE_PTHREAD

config TESTING_OSTEST_COND
	bool "Condition variable"
	default n
	depends on !DISABLE_PTHREAD

config TESTING_OSTEST_DEV_NULL
	bool "/dev/null"
	default n
	depends on DEV_NULL

config TESTING_OSTEST_FORK
	bool "Fork"
	default n
	depends on ARCH_HAVE_FORK

config TESTING_OSTEST_FPU
	bool "FPU"
	default n
	depends on ARCH_FPU && SCHED_WAITPID && BUILD_FLAT
	depends on !TESTING_OSTEST_FPUTESTDISABLE

config TESTING_OSTEST_GETOPT
	bool "Getopt"
	default n

config TESTING_OSTEST_GETOPT_LONG
	bool "Getopt long"
	default n

config TESTING_OSTEST_GETOPT_LONG_ONLY
	bool "Getopt long only"
	default n

config TESTING_OSTEST_HRTIMER
	bool "High-resolution timer"
	default n
	depends on HRTIMER && BUILD_FLAT

config TESTING_OSTEST_LIBC_MEMMEM
	bool "Libc memmem"
	default n
	depends on LIBC_MEMMEM

config TESTING_OSTEST_MQUEUE
	bool "Message queue"
	default n
	depends on !DISABLE_MQUEUE && !DISABLE_PTHREAD && !DISABLE_SIGNALS

config TESTING_OSTEST_MUTEX
	bool "Mutex"
	default n
	depends on !DISABLE_PTHREAD

config TESTING_OSTEST_NSEM
	bool "Named semaphore"
	default n
	depends on !DISABLE_PTHREAD && FS_NAMED_SEMAPHORES

config TESTING_OSTEST_NXEVENT
	bool "NX event"
	default n
	depends on SCHED_EVENTS && BUILD_FLAT

config TESTING_OSTEST_PERF_GETTIME
	bool "Performance event time"
	default n
	depends on ARCH_PERF_EVENTS && !ARCH_PERF_EVENTS_USER_ACCESS && BUILD_FLAT

config TESTING_OSTEST_POSIXTIMER
	bool "POSIX timer"
	default n
	depends on !DISABLE_SIGNALS && !DISABLE_POSIX_TIMERS

config TESTING_OSTEST_PRIOINHERIT
	bool "Priority inheritance"
	default n
	depends on PRIORITY_INHERITANCE && !DISABLE_PTHREAD

config TESTING_OSTEST_PTHREAD_CLEANUP
	bool "Pthread cleanup"
	default n
	depends on !DISABLE_PTHREAD && TLS_NCLEANUP > 0

config TESTING_OSTEST_PTHREAD_EXIT
	bool "Pthread exit"
	default n
	depends on !DISABLE_PTHREAD && SCHED_WAITPID

config TESTING_OSTEST_PTHREAD_RWLOCK
	bool "Pthread read-write lock"
	default n
	depends on !DISABLE_PTHREAD

config TESTING_OSTEST_PTHREAD_RWLOCK_CANCEL
	bool "Pthread read-write lock cancellation"
	default n
	depends on !DISABLE_PTHREAD

config TESTING_OSTEST_RESTART
	bool "Task restart"
	default n
	depends on !BUILD_KERNEL

config TESTING_OSTEST_RMUTEX
	bool "Recursive mutex"
	default n
	depends on !DISABLE_PTHREAD && PTHREAD_MUTEX_TYPES

config TESTING_OSTEST_ROBUST
	bool "Robust mutex"
	default n
	depends on !DISABLE_PTHREAD && !PTHREAD_MUTEX_UNSAFE

config TESTING_OSTEST_ROUNDROBIN
	bool "Round-robin scheduler"
	default n
	depends on !DISABLE_PTHREAD && RR_INTERVAL > 0

config TESTING_OSTEST_SCHED_THREAD_LOCAL
	bool "Scheduler thread local"
	default n
	depends on SCHED_THREAD_LOCAL

config TESTING_OSTEST_SCHEDLOCK
	bool "Scheduler lock"
	default n
	depends on !DISABLE_PTHREAD

config TESTING_OSTEST_SEM
	bool "Semaphore"
	default n
	depends on !DISABLE_PTHREAD

config TESTING_OSTEST_SEMTIMED
	bool "Timed semaphore"
	default n
	depends on !DISABLE_PTHREAD

config TESTING_OSTEST_SETJMP
	bool "Setjmp"
	default n
	depends on ARCH_SETJMP_H

config TESTING_OSTEST_SETVBUF
	bool "Setvbuf"
	default n
	depends on !STDIO_DISABLE_BUFFERING

config TESTING_OSTEST_SIGEV_THREAD
	bool "SIGEV_THREAD timer"
	default n
	depends on !DISABLE_POSIX_TIMERS && SIG_EVTHREAD

config TESTING_OSTEST_SIGHAND
	bool "Signal handler"
	default n
	depends on !DISABLE_SIGNALS

config TESTING_OSTEST_SIGNEST
	bool "Nested signal handler"
	default n
	depends on !DISABLE_SIGNALS

config TESTING_OSTEST_SIGPROCMASK
	bool "Signal mask"
	default n
	depends on !DISABLE_SIGNALS

config TESTING_OSTEST_SMP_CALL
	bool "SMP call"
	default n
	depends on SMP && BUILD_FLAT

config TESTING_OSTEST_SPECIFIC
	bool "Pthread-specific data"
	default n
	depends on !DISABLE_PTHREAD && TLS_NELEM > 0

config TESTING_OSTEST_SPINLOCK
	bool "Spinlock"
	default n
	depends on BUILD_FLAT

config TESTING_OSTEST_SPORADIC
	bool "Sporadic scheduler"
	default n
	depends on !DISABLE_PTHREAD && SCHED_SPORADIC

config TESTING_OSTEST_SPORADIC2
	bool "Dual sporadic scheduler"
	default n
	depends on !DISABLE_PTHREAD && SCHED_SPORADIC

config TESTING_OSTEST_SUSPEND
	bool "Signal action"
	default n
	depends on !DISABLE_SIGNALS && SIG_SIGSTOP_ACTION && SIG_SIGKILL_ACTION
	depends on !BUILD_KERNEL

config TESTING_OSTEST_TIMEDMQUEUE
	bool "Timed message queue"
	default n
	depends on !DISABLE_MQUEUE && !DISABLE_PTHREAD

config TESTING_OSTEST_TIMEDMUTEX
	bool "Timed mutex"
	default n
	depends on !DISABLE_PTHREAD && PTHREAD_MUTEX_TIMEDLOCK

config TESTING_OSTEST_TIMEDWAIT
	bool "Timed wait"
	default n
	depends on !DISABLE_PTHREAD

config TESTING_OSTEST_TLS
	bool "Thread local storage"
	default n
	depends on TLS_NELEM && TLS_NELEM > 0

config TESTING_OSTEST_VFORK
	bool "Vfork"
	default n
	depends on ARCH_HAVE_VFORK && !ARCH_SIM

config TESTING_OSTEST_WAITPID
	bool "Waitpid"
	default n
	depends on SCHED_WAITPID && !BUILD_KERNEL

config TESTING_OSTEST_WDOG
	bool "Watchdog"
	default n
	depends on BUILD_FLAT

config TESTING_OSTEST_WQUEUE
	bool "Work queue"
	default n
	depends on !DISABLE_PTHREAD && BUILD_FLAT && SCHED_WORKQUEUE

config TESTING_OSTEST_LOOPS
	int "OS test loop"
	default 1
	---help---
		Used to control the number of executions of the test.  If undefined, the test
		executes one time.  If defined to be zero, the test runs forever.

config TESTING_OSTEST_STACKSIZE
	int "OS test stack size"
	default 8192
	---help---
		Size of the stack used to create the ostest task.  Default is 8192.

config TESTING_OSTEST_NBARRIER_THREADS
	int "Number of barrier threads"
	default 8
	---help---
		Specifies the number of threads to create in the barrier test.  The default
		is 8 but a smaller number may be needed on systems without sufficient memory
		to start so many threads.

config TESTING_OSTEST_AIO
	bool "Asynchronous I/O Tests"
	default n
	depends on FS_AIO
	---help---
		Enables test of asynchronous I/O.  You must have a mounted, writable
		directory in place to use this test.

if TESTING_OSTEST_AIO

config TESTING_OSTEST_AIOPATH
	string "Scratch file path"
	default "/tmp"
	---help---
		This is the location of a directory in a mounted file system that
		the AIO test can write into.

endif

config TESTING_OSTEST_RR_RANGE
	int "Round-robin test - end of search range"
	default 30000
	range 1 32767
	---help---
		During round-robin scheduling test two threads are created. Each of the threads
		searches for prime numbers in the configurable range, doing that configurable
		number of times.

		This value specifies the end of search range and together with number of runs
		allows to configure the length of this test - it should last at least a few
		tens of seconds. Allowed values [1; 32767], default 30000

config TESTING_OSTEST_RR_RUNS
	int "Round-robin test - number of runs"
	default 10
	range 1 32767
	---help---
		During round-robin scheduling test two threads are created. Each of the threads
		searches for prime numbers in the configurable range, doing that configurable
		number of times.

		This value specifies the number of times the thread searches the range for
		prime numbers and together with end of search range allows to configure the
		length of this test - it should last at least a few tens of seconds. Allowed
		values [1; 32767], default 10

if ARCH_FPU && SCHED_WAITPID

config TESTING_OSTEST_FPUTESTDISABLE
	bool "Disable FPU test"
	default n

if !TESTING_OSTEST_FPUTESTDISABLE

config TESTING_OSTEST_FPULOOPS
	int "Number of FPU test loops"
	default 16

config TESTING_OSTEST_FPUMSDELAY
	int "FPU test delay (MSec)"
	default 750

config TESTING_OSTEST_FPUPRIORITY
	int "FPU test thread priority"
	default 100

config TESTING_OSTEST_FPUSTACKSIZE
	int "FPU test thread stack size"
	default 2048

endif # !TESTING_OSTEST_FPUTESTDISABLE
endif # ARCH_FPU && SCHED_WAITPID

config TESTING_OSTEST_WAITRESULT
	bool "Wait and return test result"
	default y
	depends on SCHED_WAITPID

config TESTING_OSTEST_POWEROFF
	bool "Terminate on test completion"
	default n
	depends on BOARDCTL_POWEROFF && TESTING_OSTEST_WAITRESULT

config TESTING_OSTEST_SPINLOCK_THREADS
	int "Number of spinlock test threads"
	default 2
	range 1 32

config TESTING_OSTEST_MULTIUSER
	bool "Multi-user identity and permission tests"
	default n
	depends on SCHED_USER_IDENTITY
	depends on LIBC_PASSWD_FILE
	---help---
		Enable regression tests for UID/GID identity switching and file
		permission enforcement.  Individual sub-tests run only when the
		corresponding kernel options are enabled (for example pseudoFS
		permission checks require FS_PERMISSION and PSEUDOFS_FILE).

		The passwd lookup sub-test creates a temporary passwd file at
		CONFIG_LIBC_PASSWD_FILEPATH (default /tmp/ostest_passwd when this
		option is enabled).

config TEST_LOOP_SCALE
	int "Loop scale of spinlock test (N x 10,000)"
	default 100

endif # TESTING_OSTEST
```

## apps/examples/testcase/ta_tc/mem_leak/Kconfig
```kconfig
#
# For a description of the syntax of this configuration file,
# see kconfig-language at https://www.kernel.org/doc/Documentation/kbuild/kconfig-language.txt
#

config EXAMPLES_TESTCASE_MEM_LEAK
	bool "Memory Leak Checker Test Suite"
	default n
	depends on DEBUG_MM_HEAPINFO
	select HAVE_CXX if EXAMPLES_TESTCASE_MEM_LEAK
	---help---
		Enable the Memory Leak Checker test suite. This application creates
		known memory leak scenarios (reference cycles, IPC shared blocks, etc.)
		to validate the behavior of the memory leak checker tool.

		Includes C++ tests for array cookie interior pointer detection
		(Category E) which require CXX support.

		After running a test, use 'mem_leak' from TASH to verify
		whether the leak was detected.
```

## apps/system/mem_leak_checker/Kconfig
```kconfig
config MEM_LEAK_CHECKER
        bool "Memory Leak Checker (Mark-and-Sweep)"
        default n
        depends on DEBUG_MM_HEAPINFO
        select SAVE_BIN_SECTION_ADDR if APP_BINARY_SEPARATION
        ---help---
                Enable the memory leak checker that uses mark-and-sweep
                from true roots (BSS, DATA, thread stacks) instead of treating
                all heap blocks as roots. This correctly detects reference cycles.

if MEM_LEAK_CHECKER

config MEM_LEAK_CHECKER_HASH_SIZE
        int "Hash table size for leak checker"
        default 1007
        ---help---
                Size of the hash table for block lookup. Preferred to be a prime number.

config MEM_LEAK_CHECKER_MAX_BLOCKS
        int "Max blocks for leak checker"
        default 3000
        ---help---
                Must be larger than the total number of memory allocations.

config MEM_LEAK_CHECKER_WORKLIST_SIZE
        int "Worklist size for leak checker"
        default 3000
        ---help---
                Size of the worklist for transitive marking. Should be >= MAX_BLOCKS.

config MEM_LEAK_CHECKER_DEBUG
        bool "Enable verbose debug logging in leak checker"
        default n
        ---help---
                Enable verbose debug output showing which regions are scanned,
                which pointers are found, and which blocks are marked reachable.
                Useful for diagnosing false positives/negatives.

endif # MEM_LEAK_CHECKER
```

## apps/system/mem_leak_checker_v2/Kconfig
```kconfig
#
# For a description of the syntax of this configuration file,
# see kconfig-language at https://www.kernel.org/doc/Documentation/kbuild/kconfig-language.txt
#

config MEM_LEAK_CHECKER_APP
	bool "Memory Leak Checker V2 (Mark-and-Sweep)"
	default n
	depends on MEM_LEAK_CHECKER
	---help---
		Enable the TASH command for the Memory Leak Checker.
		This registers the 'mem_leak' command which uses mark-and-sweep
		from true roots to detect reference cycles and unreachable memory.
```
