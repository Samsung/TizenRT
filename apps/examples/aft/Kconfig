## os/arch/arm/Kconfig
```kconfig
#
# For a description of the syntax of this configuration file,
# see kconfig-language at https://www.kernel.org/doc/Documentation/kbuild/kconfig-language.txt
#

if ARCH_ARM
comment "ARM Options"

choice
	prompt "ARM Toolchain Selection"
	default ARM_TOOLCHAIN_GNU_EABI

config ARM_TOOLCHAIN_IAR
	bool "IAR ANSI C/C++ toolchain"
	select CYGWIN_WINTOOL if WINDOWS_CYGWIN

config ARM_TOOLCHAIN_BUILDROOT
	bool "Buildroot (Cygwin or Linux)"
	depends on !WINDOWS_NATIVE
	select ARCH_TOOLCHAIN_GCC

config ARM_TOOLCHAIN_BUILDROOT_OABI
	bool "OABI (vs EABI)"
	depends on !WINDOWS_NATIVE
	select ARCH_TOOLCHAIN_GCC
	---help---
		Most of the older buildroot toolchains are OABI

config ARM_TOOLCHAIN_GNU_EABI
	bool "Generic GNU EABI toolchain"
	select ARCH_TOOLCHAIN_GCC
	---help---
		This option should work for any modern GNU toolchain (GCC 4.5 or newer)

config ARM_TOOLCHAIN_GNU_OABI
	bool "Generic GNU OABI toolchain"
	select ARCH_TOOLCHAIN_GCC
	---help---
		This option should work for any GNU toolchain.

config ARM_TOOLCHAIN_CLANG
	bool "LLVM Clang toolchain"
	depends on !LIBM_TOOLCHAIN
	select ARCH_TOOLCHAIN_CLANG

config ARM_TOOLCHAIN_ARMCLANG
	bool "ARM Compiler Clang toolchain"
	select ARCH_TOOLCHAIN_ARMCLANG

config ARM_TOOLCHAIN_GHS
	bool "ARM Compiler Green Hills Software toolchain"
	select ARCH_TOOLCHAIN_GHS

endchoice # ARM Toolchain Selection

choice
	prompt "ARM MCU selection"
	default ARCH_CHIP_STM32

config ARCH_CHIP_MPS
	bool "MPS ARM Series"
	---help---
		MPS platform (MPS2 MPS3)

config ARCH_CHIP_QEMU_ARM
	bool "QEMU virt platform (ARMv7a)"
	select ARCH_HAVE_POWEROFF
	select ARCH_HAVE_RESET
	select ARCH_IDLE_CUSTOM
	---help---
		QEMU virt platform (ARMv7a)

config ARCH_CHIP_LM
	bool "TI/Luminary Stellaris"
	select ARCH_HAVE_MPU
	select ARM_HAVE_MPU_UNIFIED
	---help---
		TI/Luminary Stellaris LMS3 and LM4F architectures (ARM Cortex-M3/4)

config ARCH_CHIP_S5J
	bool "Samsung S5J"
	select ARCH_CORTEXR4
	select ARCH_HAVE_MPU
	select ARCH_HAVE_TICKLESS
	select ARM_HAVE_MPU_UNIFIED
	select ARMV7R_MEMINIT
	---help---
		Samsung IoT SoC architectures (ARM Cortex R)

config ARCH_CHIP_BCM4390X
	bool "Cypress BCM4390X"
	select ARCH_CORTEXR4
	select ARCH_HAVE_MPU
	select ARMV7M_MPU
	select ARCH_HAVE_LOWVECTORS
	select ARCH_LOWVECTORS
	select ARM_UNWIND
	---help---
		Cypress BCM4390x SoC architectures (ARM Cortex-R)
config ARCH_CHIP_IMX6
	bool "NXP/Freescale iMX.6"
	select ARCH_CORTEXA9
	select ARM_THUMB
#	select ARMV7A_HAVE_L2CC_PL310
	select ARM_HAVE_NEON
	select ARCH_HAVE_TRUSTZONE
	select ARCH_HAVE_LOWVECTORS
	select ARCH_HAVE_FETCHADD
	select ARCH_HAVE_SDRAM
	select BOOT_RUNFROMSDRAM
	select ARCH_HAVE_ADDRENV
	select ARCH_NEED_ADDRENV_MAPPING
	---help---
		Freescale iMX.6 architectures (Cortex-A9)

config ARCH_CHIP_STM32
	bool "STMicro STM32"
	select ARCH_HAVE_MPU
	select ARCH_HAVE_I2CRESET
	select ARCH_HAVE_HEAPCHECK if DEBUG
	---help---
		STMicro STM32 architectures (ARM Cortex-M3/4).

config ARCH_CHIP_IMXRT
	bool "NXP/Freescale iMX.RT"
	select ARCH_CORTEXM7
	select ARCH_HAVE_MPU
	select ARCH_HAVE_RAMFUNCS
	select ARCH_HAVE_TICKLESS
	select ARCH_HAVE_I2CRESET
	select ARCH_HAVE_SPI_CS_CONTROL
	select ARM_HAVE_MPU_UNIFIED
	select ARMV7M_HAVE_STACKCHECK
	---help---
		NXP i.MX RT (ARM Cortex-M7) architectures

config ARCH_CHIP_STM32L4
	bool "STMicro STM32L4"
	select ARCH_HAVE_MPU
	select ARCH_HAVE_I2CRESET
	select ARCH_HAVE_HEAPCHECK if DEBUG
	---help---
		STMicro STM32 architectures (ARM Cortex-M3/4).

config ARCH_CHIP_AMEBAD
	bool "Realtek AMEBAD"
	select ARCH_HAVE_MPU
	select ARCH_HAVE_I2CRESET
	select ARCH_HAVE_HEAPCHECK if DEBUG
	---help---
		Realtek AMEBAD architectures (ARM Cortex-M23/33).

config ARCH_CHIP_ARMINO
	bool "Beken ARMINO"
	select ARCH_HAVE_MPU
	select ARCH_HAVE_I2CRESET
	select ARCH_HAVE_TICKSUPPRESS
	select ARCH_HAVE_HEAPCHECK if DEBUG
	---help---
		Beken ARMINO architectures (ARM Cortex-M33).

config ARCH_CHIP_STM32H745
	bool "STMicro STM32H745"
	select ARCH_HAVE_MPU
	select ARCH_HAVE_I2CRESET
	select ARCH_HAVE_HEAPCHECK if DEBUG
	select BOARDCTL_BOARD_HEADER
	---help---
		STMicro STM32 architectures (ARM Cortex-M7/M4 Dual core).

config ARCH_CHIP_AMEBASMART
	bool "Realtek AMEBASMART"
	select ARCH_CORTEXA32
	select ARM_HAVE_NEON
	select ARCH_HAVE_CRC32
	select ARCH_HAVE_TRUSTZONE
	select ARCH_HAVE_LOWVECTORS
	select ARCH_HAVE_FETCHADD
	select ARCH_HAVE_SDRAM
	select BOOT_RUNFROMSDRAM
	select ARCH_HAVE_ADDRENV
	select ARCH_NEED_ADDRENV_MAPPING
	select ARCH_HAVE_HEAPCHECK if DEBUG
	select ARCH_HAVE_DVFS
	select ARCH_HAVE_TICKSUPPRESS
	select ARM_HAVE_WFE_SEV
	select CPU_HOTPLUG if (SMP && PM)
	---help---
		Realtek AMEBASMART architectures (ARM Cortex-A32).

endchoice # ARM MCU selection

config ARCH_ARM7TDMI
	bool
	default n
	select ARCH_DCACHE
	select ARCH_ICACHE
	---help---
		The Arm7TDMI-S is an excellent workhorse processor capable of a wide
		array of applications. Traditionally used in mobile handsets, the
		processor is now broadly in many non-mobile applications.

config ARCH_ARM920T
	bool
	default n
	select ARCH_DCACHE
	select ARCH_ICACHE
	select ARCH_HAVE_MMU
	select ARCH_USE_MMU
	---help---
		The ARM9 processor family is built around the ARM9TDMI processor and
		incorporates the 16-bit Thumb instruction set. The ARM9 Thumb family
		includes the ARM920T and ARM922T cached processor macrocells:

		- Dual 16k caches for applications running Symbian OS, Palm OS,
		  Linux and Windows CE,
		- Dual 8k caches for applications running Symbian OS, Palm OS, Linux
		  and Windows CE Applications

config ARCH_ARM926EJS
	bool
	default n
	select ARCH_DCACHE
	select ARCH_ICACHE
	select ARCH_HAVE_MMU
	select ARCH_USE_MMU
	---help---
		Arm926EJ-S is the entry point processor capable of supporting full
		Operating Systems including Linux, WindowsCE, and Symbian.

		The ARM9E processor family enables single processor solutions for
		microcontroller, DSP and Java applications. The ARM9E family of
		products are DSP-enhanced 32-bit RISC processors, for applications
		requiring a mix of DSP and microcontroller performance. The family
		includes the ARM926EJ-S, ARM946E-S, ARM966E-S, and ARM968E-S
		processor macrocells. They include signal processing extensions to
		enhance 16-bit fixed point performance using a single-cycle 32 x 16
		multiply-accumulate (MAC) unit, and implement the 16-bit Thumb
		instruction set. The ARM926EJ-S processor also includes ARM Jazelle
		technology which enables the direct execution of Java bytecodes in
		hardware.

config ARCH_ARM1136J
	bool
	default n
	select ARCH_DCACHE
	select ARCH_ICACHE
	select ARCH_HAVE_MMU
	select ARCH_USE_MMU
	---help---
		Arm1136J(F)-S is very similar to Arm926EJ-S, but includes an
		extended pipeline, basic SIMD (Single Instruction Multiple Data)
		instructions, and improved frequency and performance.

config ARCH_ARM1156T2
	bool
	default n
	select ARCH_DCACHE
	select ARCH_ICACHE
	select ARCH_HAVE_MMU
	select ARCH_USE_MMU
	---help---
		Arm1156T2(F)-S is the highest-performance processor in the real-time
		Classic Arm family.

config ARCH_ARM1176JZ
	bool
	default n
	select ARCH_DCACHE
	select ARCH_ICACHE
	select ARCH_HAVE_MMU
	select ARCH_USE_MMU
	---help---
		Arm1176JZ(F)-S is the highest-performance single-core processor in
		the Classic Arm family. It also introduced TrustZone technology to
		enable secure execution outside of the reach of malicious code.

config ARCH_ARMV6M
	bool
	default n
	select ARCH_HAVE_CPUINFO

config ARCH_CORTEXM0
	bool
	default n
	select ARM_THUMB
	select ARCH_ARMV6M
	select ARCH_HAVE_IRQPRIO
	select ARCH_HAVE_IRQTRIGGER
	select ARCH_HAVE_RAMVECTORS
	select ARCH_HAVE_RESET
	select ARCH_HAVE_HARDFAULT_DEBUG

config ARCH_ARMV7M
	bool
	default n
	select ARCH_HAVE_CPUINFO
	select ARCH_HAVE_DEBUG
	select ARCH_HAVE_PERF_EVENTS

config ARCH_CORTEXM3
	bool
	default n
	select ARM_THUMB
	select ARCH_ARMV7M
	select ARCH_HAVE_IRQPRIO
	select ARCH_HAVE_IRQTRIGGER
	select ARCH_HAVE_RAMVECTORS
	select ARCH_HAVE_HIPRI_INTERRUPT
	select ARCH_HAVE_RESET
	select ARCH_HAVE_TESTSET
	select ARCH_HAVE_HARDFAULT_DEBUG
	select ARCH_HAVE_MEMFAULT_DEBUG
	select ARCH_HAVE_BUSFAULT_DEBUG
	select ARCH_HAVE_USAGEFAULT_DEBUG

config ARCH_CORTEXM4
	bool
	default n
	select ARM_THUMB
	select ARCH_ARMV7M
	select ARCH_HAVE_IRQPRIO
	select ARCH_HAVE_IRQTRIGGER
	select ARCH_HAVE_RAMVECTORS
	select ARCH_HAVE_HIPRI_INTERRUPT
	select ARCH_HAVE_RESET
	select ARCH_HAVE_TESTSET
	select ARCH_HAVE_HARDFAULT_DEBUG
	select ARCH_HAVE_MEMFAULT_DEBUG
	select ARCH_HAVE_BUSFAULT_DEBUG
	select ARCH_HAVE_USAGEFAULT_DEBUG

config ARCH_CORTEXM7
	bool
	default n
	select ARM_THUMB
	select ARCH_ARMV7M
	select ARCH_HAVE_FPU
	select ARCH_HAVE_IRQPRIO
	select ARCH_HAVE_IRQTRIGGER
	select ARCH_HAVE_RAMVECTORS
	select ARCH_HAVE_HIPRI_INTERRUPT
	select ARCH_HAVE_RESET
	select ARCH_HAVE_TESTSET
	select ARCH_HAVE_HARDFAULT_DEBUG
	select ARCH_HAVE_MEMFAULT_DEBUG
	select ARCH_HAVE_BUSFAULT_DEBUG
	select ARCH_HAVE_USAGEFAULT_DEBUG

config ARCH_ARMV7A
	bool
	default n
	select ARCH_HAVE_CPUINFO
	select ARCH_HAVE_DEBUG
	select ARCH_HAVE_PERF_EVENTS
	select ARM_HAVE_WFE_SEV

config ARCH_CORTEXA5
	bool
	default n
	select ARCH_ARMV7A
	select ARCH_DCACHE
	select ARCH_ICACHE
	select ARCH_HAVE_MMU
	select ARCH_USE_MMU
	select ARCH_HAVE_TESTSET
	select ARM_HAVE_MPCORE

config ARCH_CORTEXA7
	bool
	default n
	select ARCH_ARMV7A
	select ARCH_DCACHE
	select ARCH_ICACHE
	select ARCH_HAVE_MMU
	select ARCH_USE_MMU
	select ARCH_HAVE_TESTSET
	select ARCH_HAVE_FPU
	select ARM_HAVE_MPCORE

config ARCH_CORTEXA8
	bool
	default n
	select ARCH_ARMV7A
	select ARCH_DCACHE
	select ARCH_ICACHE
	select ARCH_HAVE_MMU
	select ARCH_USE_MMU
	select ARCH_HAVE_TESTSET

config ARCH_CORTEXA9
	bool
	default n
	select ARCH_ARMV7A
	select ARCH_DCACHE
	select ARCH_ICACHE
	select ARCH_HAVE_MMU
	select ARCH_USE_MMU
	select ARCH_HAVE_TESTSET
	select ARM_HAVE_MPCORE

config ARCH_ARMV7R
	bool
	default n
	select ARCH_HAVE_CPUINFO
	select ARCH_HAVE_PERF_EVENTS
	select ARCH_HAVE_PERF_EVENTS_USER_ACCESS

config ARCH_CORTEXR4
	bool
	default n
	select ARCH_ARMV7R
	select ARCH_DCACHE
	select ARCH_ICACHE
	select ARCH_HAVE_MPU
	select ARCH_HAVE_TESTSET

config ARCH_CORTEXR5
	bool
	default n
	select ARCH_ARMV7R
	select ARCH_DCACHE
	select ARCH_ICACHE
	select ARCH_HAVE_MPU
	select ARCH_HAVE_TESTSET

config ARCH_CORTEXR7
	bool
	default n
	select ARCH_ARMV7R
	select ARCH_DCACHE
	select ARCH_ICACHE
	select ARCH_HAVE_MPU
	select ARCH_HAVE_TESTSET

config ARCH_CORTEXR52
	bool
	default n
	select ARCH_ARMV8R
	select ARCH_HAVE_MPU
	select ARCH_HAVE_TESTSET

config ARCH_ARMV8M
	bool
	default n
	select ARCH_HAVE_CPUINFO
	select ARCH_HAVE_DEBUG
	select ARCH_HAVE_PERF_EVENTS

config ARCH_CORTEXM23
	bool
	default n
	select ARM_THUMB
	select ARCH_ARMV8M
	select ARCH_HAVE_IRQPRIO
	select ARCH_HAVE_IRQTRIGGER
	select ARCH_HAVE_RAMVECTORS
	select ARCH_HAVE_HIPRI_INTERRUPT
	select ARCH_HAVE_RESET
	select ARCH_HAVE_TESTSET
	select ARCH_HAVE_HARDFAULT_DEBUG

config ARCH_CORTEXM33
	bool
	default n
	select ARM_THUMB
	select ARCH_ARMV8M
	select ARCH_HAVE_IRQPRIO
	select ARCH_HAVE_IRQTRIGGER
	select ARCH_HAVE_RAMVECTORS
	select ARCH_HAVE_HIPRI_INTERRUPT
	select ARCH_HAVE_RESET
	select ARCH_HAVE_TESTSET
	select ARCH_HAVE_HARDFAULT_DEBUG
	select ARCH_HAVE_MEMFAULT_DEBUG
	select ARCH_HAVE_BUSFAULT_DEBUG
	select ARCH_HAVE_USAGEFAULT_DEBUG
	select ARCH_HAVE_SECUREFAULT_DEBUG if ARCH_TRUSTZONE_SECURE

config ARCH_CORTEXM35P
	bool
	default n
	select ARM_THUMB
	select ARCH_ARMV8M
	select ARCH_HAVE_IRQPRIO
	select ARCH_HAVE_IRQTRIGGER
	select ARCH_HAVE_RAMVECTORS
	select ARCH_HAVE_HIPRI_INTERRUPT
	select ARCH_HAVE_RESET
	select ARCH_HAVE_TESTSET
	select ARCH_HAVE_HARDFAULT_DEBUG
	select ARCH_HAVE_MEMFAULT_DEBUG
	select ARCH_HAVE_BUSFAULT_DEBUG
	select ARCH_HAVE_USAGEFAULT_DEBUG
	select ARCH_HAVE_SECUREFAULT_DEBUG if ARCH_TRUSTZONE_SECURE

config ARCH_CORTEXM55
	bool
	default n
	select ARM_THUMB
	select ARCH_ARMV8M
	select ARCH_HAVE_IRQPRIO
	select ARCH_HAVE_IRQTRIGGER
	select ARCH_HAVE_RAMVECTORS
	select ARCH_HAVE_HIPRI_INTERRUPT
	select ARCH_HAVE_RESET
	select ARCH_HAVE_TESTSET
	select ARCH_HAVE_HARDFAULT_DEBUG
	select ARCH_HAVE_MEMFAULT_DEBUG
	select ARCH_HAVE_BUSFAULT_DEBUG
	select ARCH_HAVE_USAGEFAULT_DEBUG
	select ARCH_HAVE_SECUREFAULT_DEBUG if ARCH_TRUSTZONE_SECURE

config ARCH_CORTEXM85
	bool
	default n
	select ARM_THUMB
	select ARCH_ARMV8M
	select ARCH_HAVE_IRQPRIO
	select ARCH_HAVE_IRQTRIGGER
	select ARCH_HAVE_RAMVECTORS
	select ARCH_HAVE_HIPRI_INTERRUPT
	select ARCH_HAVE_RESET
	select ARCH_HAVE_TESTSET
	select ARCH_HAVE_HARDFAULT_DEBUG
	select ARCH_HAVE_MEMFAULT_DEBUG
	select ARCH_HAVE_BUSFAULT_DEBUG
	select ARCH_HAVE_USAGEFAULT_DEBUG
	select ARCH_HAVE_SECUREFAULT_DEBUG if ARCH_TRUSTZONE_SECURE

config ARCH_ARMV8R
	bool
	default n
	select ARCH_HAVE_CPUINFO
	select ARCH_HAVE_PERF_EVENTS
	select ONESHOT
	select ONESHOT_COUNT
	select ALARM_ARCH


config ARCH_FAMILY
	string
	default "arm"		if ARCH_ARM7TDMI || ARCH_ARM920T || ARCH_ARM926EJS || ARCH_ARM1136J || ARCH_ARM1156T2 || ARCH_ARM1176JZ
	default "armv6-m"	if ARCH_ARMV6M
	default "armv7-a"	if ARCH_ARMV7A
	default "armv7-m"	if ARCH_ARMV7M
	default "armv7-r"	if ARCH_ARMV7R
	default "armv8-m"	if ARCH_ARMV8M
	default "armv8-r"	if ARCH_ARMV8R

config ARCH_CHIP
	string
	default "qemu"		if ARCH_CHIP_QEMU_ARM
	default "mps"		if ARCH_CHIP_MPS
	default "s5j"		if ARCH_CHIP_S5J
	default "tiva"      if ARCH_CHIP_LM
	default "bcm4390x"	if ARCH_CHIP_BCM4390X
	default "stm32"		if ARCH_CHIP_STM32
	default "imxrt"		if ARCH_CHIP_IMXRT
	default "stm32l4"	if ARCH_CHIP_STM32L4
	default "amebad"	if ARCH_CHIP_AMEBAD
	default "armino"	if ARCH_CHIP_ARMINO
	default "amebasmart"	if ARCH_CHIP_AMEBASMART
	default "stm32h745"     if ARCH_CHIP_STM32H745
	default "imx6"		if ARCH_CHIP_IMX6

config ARM_THUMB
	bool "Thumb Mode"
	default n

config ARM_HAVE_PSCI
	bool "ARM PSCI (Power State Coordination Interface) Support"
	default n
	---help---
		This Power State Coordination Interface (PSCI) defines
		a standard interface for power management. the PCSI need
		to implement handling firmware at EL2 or EL3. The option
		maybe not applicable for arm core without PCSI firmware
		interface implement

config ARM_HAVE_WFE_SEV
	bool
	default n
	---help---
		Use WFE and SEV instructions for spinlock to reduce power consumption

config ARM_HAVE_DPFPU32
	bool
	select ARCH_HAVE_DPFPU
	default n
	---help---
		FPU implemented in the VFPv[3|4]-D32 format that supports
		32 double-precision floating-point registers.

config ARM_HAVE_NEON
	bool
	default n
	select ARM_HAVE_DPFPU32
	---help---
		Decide whether support NEON instruction

config ARM_HAVE_DSP
	bool
	default n
	---help---
		Decide whether support DSP instruction

config ARM_HAVE_MVE
	bool
	default n
	---help---
		Decide whether support MVE instruction

config ARM_HAVE_PACBTI
	bool
	default n
	---help---
		Decide whether support PACBTI(Pointer Authentication and Branch Target Identification) Extension

config ARM_PSCI
	bool "Enabled PSCI"
	depends on ARM_HAVE_PSCI
	default n
	---help---
		See ARM_HAVE_PSCI for details

config ARM_FPU_ABI_SOFT
	bool "Soft Float ABI"
	default n
	depends on ARCH_HAVE_FPU
	---help---
		Pass float value via integer register (-mfloat-abi=softfp)

config ARM_BUSY_WAIT
	bool "Busy wait when boot"
	default n
	depends on ARCH_HAVE_MULTICPU
	---help---
		On a system with multiple CPU cores, when the system is powered on,
		multiple cores may start running simultaneously. In this case, software
		is required to handle the startup logic for multi-core synchronization.
		One approach is to use global variables.
		however, the global variable region may not have been initialized yet.
		In such scenarios, we can use a busywait flag to
		implement the synchronization strategy.

config ARM_BUSY_WAIT_FLAG_ADDR
	hex "Busy wait flag address"
	depends on ARM_BUSY_WAIT
	---help---
		The busywait address is typically a region that is initialized to 0
		during the boot phase.

config ARM_DPFPU32
	bool "FPU with 32 double-precision register"
	default y
	depends on ARCH_DPFPU && ARM_HAVE_DPFPU32

config ARM_NEON
	bool "Advanced SIMD (NEON) Extension"
	default y
	depends on ARM_HAVE_NEON && ARM_DPFPU32

config ARM_DSP
	bool "Advanced DSP Extension"
	default y
	depends on ARM_HAVE_DSP
	---help---
		Enables DSP Extension

config ARM_PACBTI
	bool "Advanced PACBTI Extension"
	default y
	depends on ARM_HAVE_PACBTI
	---help---
		Enables PACBTI(Pointer Authentication and Branch Target Identification) Extension

config ARM_HAVE_MPU_UNIFIED
	bool
	default n
	---help---
		Automatically selected to indicate that the CPU supports a
		unified MPU for both instruction and data addresses.

config ARM_HAVE_MPCORE
	bool
	default n
	---help---
		Decide whether support MPCore extension

config ARM_MPU
	bool "MPU support"
	default n
	depends on ARCH_HAVE_MPU
	select ARCH_USE_MPU
	---help---
		Build in support for the ARM Cortex-M3/4/7 Memory Protection Unit (MPU).
		Check your chip specifications first; not all Cortex-M3/4/7 chips
		support the MPU.

config ARM_MPU_NREGIONS
	int "Number of MPU regions"
	default 16 if ARCH_CORTEXM7
	default 8 if !ARCH_CORTEXM7
	depends on ARM_MPU
	---help---
		This is the number of protection regions supported by the MPU.

config ARM_MPU_RESET
	bool "MPU Reset before MPU initialization"
	default n
	depends on ARM_MPU
	---help---
		Configures the MPU initialization sequence to disable the MPU
		before configuring it.

		This may be needed in a system with a bootloader that has
		configured the MPU prior to running NuttX. This may be all that is
		needed to allow booting if the previous MPU configuration allow
		the system to execute the MPU initialization code. If not use
		ARM_MPU_EARLY_RESET.

config ARM_MPU_EARLY_RESET
	bool "MPU Early Reset"
	default n
	depends on ARCH_HAVE_MPU
	---help---
		Configures the early system initialization sequence to disable the MPU.

		This may be needed in a system with a bootloader that has
		configured the MPU prior to running NuttX. This is useful if the system
		faults during bbs, or data initialization or before the
		stm32_mpuinitialize can be called.

		Note: This can be used without MPU Support enabled.

config ARM_COREDUMP_REGION
	bool "Add coredump region"
	depends on COREDUMP
	default n
	---help---
		Add coredump region includes nvic and mpu for cortex-M.

config ARCH_HAVE_LOWVECTORS
	bool

config ARCH_LOWVECTORS
	bool "Vectors in low memory"
	default n
	depends on ARCH_HAVE_LOWVECTORS
	---help---
		Support ARM vectors in low memory.

config ARCH_ROMPGTABLE
	bool "ROM page table"
	default n
	depends on ARCH_USE_MMU
	---help---
		Support a fixed memory mapping use a (read-only) page table in
		ROM/FLASH.

config ARCH_HAVE_HARDFAULT_DEBUG
	bool
	default n

config DEBUG_HARDFAULT_ALERT
	bool "Hard-Fault Alert Debug"
	default n
	depends on ARCH_HAVE_HARDFAULT_DEBUG && DEBUG_ALERT
	---help---
		Enables debug alert output to the SYSLOG when a hard fault
		occurs.  This output is sometimes helpful when debugging difficult
		hard fault problems.

config DEBUG_HARDFAULT_INFO
	bool "Hard-Fault Informational Output"
	default n
	depends on ARCH_HAVE_HARDFAULT_DEBUG && DEBUG_INFO
	---help---
		Enables informational alert output to the SYSLOG when a hard fault
		occurs.  This output is sometimes helpful when debugging difficult
		hard fault problems but may be more than you want to see in some
		cases.

config ARCH_HAVE_MEMFAULT_DEBUG
	bool
	default n

config DEBUG_MEMFAULT
	bool "Verbose Mem-Fault Debug"
	default n
	depends on ARCH_HAVE_MEMFAULT_DEBUG && DEBUG_ALERT && ARCH_USE_MPU
	---help---
		Enables verbose debug output when a mem fault occurs.  This verbose
		output is sometimes helpful when debugging difficult mem fault problems,
		but may be more than you typically want to see.

config ARCH_HAVE_BUSFAULT_DEBUG
	bool
	default n

config DEBUG_BUSFAULT
	bool "Verbose Bus-Fault Debug"
	default n
	depends on ARCH_HAVE_BUSFAULT_DEBUG && DEBUG_ALERT
	---help---
		Enables verbose debug output when a bus fault occurs.  This verbose
		output is sometimes helpful when debugging difficult bus fault problems,
		but may be more than you typically want to see.

config ARCH_HAVE_USAGEFAULT_DEBUG
	bool
	default n

config DEBUG_USAGEFAULT
	bool "Verbose Usage-Fault Debug"
	default n
	depends on ARCH_HAVE_USAGEFAULT_DEBUG && DEBUG_ALERT
	---help---
		Enables verbose debug output when a usage fault occurs.  This verbose
		output is sometimes helpful when debugging difficult usage fault problems,
		but may be more than you typically want to see.

config ARCH_HAVE_SECUREFAULT_DEBUG
	bool
	default n

config DEBUG_SECUREFAULT
	bool "Verbose Secure-Fault Debug"
	default n
	depends on ARCH_HAVE_SECUREFAULT_DEBUG && DEBUG_ALERT
	---help---
		Enables verbose debug output when a usage fault is occurs.  This verbose
		output is sometimes helpful when debugging difficult usage fault problems,
		but may be more than you typically want to see.

config ARM_SEMIHOSTING_POWEROFF
	bool "Semihosting POWEROFF support"
	default n
	---help---
		Enable use of semihosting function to poweroff target.

config ARM_SEMIHOSTING_SYSLOG
	bool "Semihosting SYSLOG support"
	select SYSLOG_REGISTER
	---help---
		Enable hooks to support semihosting syslog output.

config ARM_SEMIHOSTING_HOSTFS
	bool "Semihosting HostFS"
	depends on FS_HOSTFS
	---help---
		Mount HostFS through semihosting.

		This doesn't support some directory operations like readdir because
		of the limitations of semihosting mechanism.

if ARM_SEMIHOSTING_HOSTFS

config ARM_SEMIHOSTING_HOSTFS_CACHE_COHERENCE
	bool "Cache coherence in semihosting hostfs"
	depends on ARCH_DCACHE
	---help---
		Flush & Invalidate cache before & after bkpt instruction.

endif # ARM_SEMIHOSTING_HOSTFS

if SCHED_BACKTRACE

choice
	prompt "Choose ARM unwinder"
	default UNWINDER_ARM
	---help---
		This determines which method will be used for unwinding nuttx stack
		traces for debug.

config UNWINDER_FRAME_POINTER
	bool "Frame pointer unwinder"
	select FRAME_POINTER
	---help---
		This option enables the frame pointer unwinder for unwinding
		nuttx stack traces.

config UNWINDER_STACK_POINTER
	bool "Stack pointer unwinder"
	---help---
		This option enables the stack pointer unwinder for unwinding
		nuttx stack traces.

config UNWINDER_ARM
	bool "ARM EHABI stack unwinder"
	select FRAME_POINTER
	---help---
		This option enables stack unwinding support in the nuttx
		using the information automatically generated by the
		compiler. The resulting nuttx image is slightly bigger but
		the performance is not affected. Currently, this feature
		only works with EABI compilers.

endchoice # Choose ARM unwinder

endif

if ARCH_ARMV7A
source "arch/arm/src/armv7-a/Kconfig"
endif
if ARCH_ARMV7M
source "arch/arm/src/armv7-m/Kconfig"
endif
if ARCH_ARMV7R
source "arch/arm/src/armv7-r/Kconfig"
endif
if ARCH_ARMV8M
source "arch/arm/src/armv8-m/Kconfig"
endif
if ARCH_CHIP_QEMU_ARM
source "arch/arm/src/qemu/Kconfig"
endif
if ARCH_CHIP_MPS
source "arch/arm/src/mps/Kconfig"
endif
if ARCH_CHIP_IMX6
source "arch/arm/src/imx6/Kconfig"
endif
if ARCH_CHIP_LM
source arch/arm/src/tiva/Kconfig
endif
if ARCH_CHIP_S5J
source arch/arm/src/s5j/Kconfig
endif
if ARCH_CHIP_BCM4390X
source arch/arm/src/bcm4390x/Kconfig
endif
if ARCH_CHIP_STM32
source arch/arm/src/stm32/Kconfig
endif
if ARCH_CHIP_IMXRT
source arch/arm/src/imxrt/Kconfig
endif
if ARCH_CHIP_STM32L4
source arch/arm/src/stm32l4/Kconfig
endif
if ARCH_CHIP_AMEBAD
source arch/arm/src/amebad/Kconfig
endif
if ARCH_CHIP_AMEBASMART
source arch/arm/src/amebasmart/Kconfig
endif
if ARCH_CHIP_ARMINO
source arch/arm/src/armino/Kconfig
endif
if ARCH_CHIP_STM32H745
source arch/arm/src/stm32h745/Kconfig
endif
endif # ARCH_ARM


#
# TizenRT options that NuttX does not have
#

if ARCH_ARM
config ARCH_CORTEXA32
	bool
	default n
	select ARCH_DCACHE
	select ARCH_ICACHE
	select ARCH_HAVE_IRQPRIO
	select ARCH_HAVE_RESET
	select ARCH_HAVE_MMU
	select ARCH_USE_MMU
	select ARCH_HAVE_TESTSET
	select ARCH_HAVE_THREAD_LOCAL
	select ARCH_ARMV7A_FAMILY
	select ARCH_HAVE_TESTSET

config ARCH_ARMV7M_FAMILY
	bool
	default n

config ARCH_ARMV8M_FAMILY
	bool
	default n

config ARCH_ARMV7R_FAMILY
	bool
	default n

config ARCH_ARMV7A_FAMILY
	bool
	default n

config ARCH_HAVE_CMNVECTOR
	bool

config ARM_CMNVECTOR
	bool "Use common ARM vectors"
	default n
	depends on ARCH_HAVE_CMNVECTOR
	---help---
		Some architectures use their own, built-in vector logic.  Some use only
		the common vector logic.  Some can use either their own built-in vector
		logic or the common vector logic.

config ARMV7M_MPU
	bool "MPU support"
	default n
	depends on ARCH_HAVE_MPU
	depends on ARCH_ARMV7M_FAMILY || ARCH_ARMV7R_FAMILY
	select ARM_MPU
	---help---
		Build in support for the ARM Cortex-M3/4 Memory Protection Unit (MPU).
		Check your chip specifications first; not all Cortex-M3/4 chips support the MPU.

config ARMV7M_MPU_NREGIONS
	int "Number of MPU regions"
	default 16 if ARCH_CORTEXM7
	default 8 if !ARCH_CORTEXM7
	depends on ARMV7M_MPU
	---help---
		This is the number of protection regions supported by the MPU.

config ARMV8M_MPU
	bool "MPU support"
	default n
	depends on ARCH_HAVE_MPU
	depends on ARCH_ARMV8M_FAMILY
	select ARM_MPU
	---help---
		Build in support for the ARM Cortex-M33 Memory Protection Unit (MPU).
		Check your chip specifications first; not all Cortex-M33 chips support the MPU.

config ARMV8M_MPU_NREGIONS
	int "Number of MPU regions"
	default 8
	depends on ARMV8M_MPU
	---help---
		This is the number of protection regions supported by the MPU.

config ARCH_HAVE_TICKSUPPRESS
	bool
	default n

config DEBUG_HARDFAULT
	bool "Verbose Hard-Fault Debug"
	default n
	depends on DEBUG && (ARCH_ARMV7M_FAMILY || ARCH_ARMV8M_FAMILY)
	---help---
		Enables verbose debug output when a hard fault is occurs.  This verbose
		output is sometimes helpful when debugging difficult hard fault problems,
		but may be more than you typcially want to see.

config ARCH_HAVE_DABORTSTACK
	bool
	default n

config ARCH_DABORTSTACK
	int "Dabort Stack Size"
	depends on ARCH_HAVE_DABORTSTACK
	default 0
	---help---
		This architecture supports an data abort stack. If defined, this symbol
		will be the size of the data abort stack in bytes.  If not defined (or
		defined to be zero or less than 512 bytes), the user task stacks
		will be used during data abort handling. Recommended data abort stack
		size is 1K.

choice
	prompt "Stack Protection feature options"
	default SW_STACK_OVERFLOW_DETECTION

config REG_STACK_OVERFLOW_PROTECTION
	bool "REG Stack Overflow Protection"
	depends on ARCH_ARMV8M_FAMILY
	---help---
		Enables stack overflow protection with limit registers.
		It protects each user task's stack overflow outside its max allocated stack memory.

config MPU_STACK_OVERFLOW_PROTECTION
	bool "MPU Stack Overflow Protection"
	depends on BUILD_PROTECTED
	depends on ARM_MPU
	depends on !ARMV8M_MPU
	---help---
		Enables stack overflow protection.
		It protects each task's stack overflow outside its max allocated stack memory.
		This is applicable to user mode tasks created in protected build.

config SW_STACK_OVERFLOW_DETECTION
	bool "Minimal Software based Stack Overflow Detection"
	depends on STACK_COLORATION
	---help---
		If the hardware does not provide means for stack overflow protection, then 
		we can fall back to this option. It checks for stack overflow during each context
		switch and stops execution if any process stack has overflowed.

config STACK_OVERFLOW_PROTECTION_DISABLE
	bool "Stack Overflow Protection Disable"
	---help---
		Disable Stack Overflow Protection.

endchoice
if MPU_STACK_OVERFLOW_PROTECTION
config MPU_STACK_GUARD_SIZE
	int "Stack Guard size configuration range(32-1024)"
	default 32
	range 32 1024
	---help---
		Set size for the stack guard. It must be set with 32 byte aligned values.
		The size can be set in the range of 32 to 1024 bytes.
		Setting large stack guard size will be a wastage of memory.
endif
config SYSTEM_REBOOT_REASON
	bool "Enable System Reboot Reason Interfaces"
	default n
	---help---
		If selected it will allow to use system reboot reason interfaces.
		Supported interfaces are read, write and clear.
		Interfaces can be used through prctl with
		PR_REBOOT_REASON_READ, PR_REBOOT_REASON_WRITE and PR_REBOOT_REASON_CLEAR.

endif
```
