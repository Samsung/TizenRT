## apps/examples/aft/Kconfig
```kconfig
config EXAMPLES_AUDIO_FILE_TRANSFER
	bool "\"Audio File Transfer\" example"
	default n
	---help---
		Enable the "Audio File Transfer!" example.

config INIT_ENTRYPOINT
	string
	default "aft_main" if ENTRY_AUDIO_FILE_TRANSFER
```

## apps/examples/backtrace_test/Kconfig
```kconfig
#
# For a description of the syntax of this configuration file,
# see kconfig-language at https://www.kernel.org/doc/Documentation/kbuild/kconfig-language.txt
#

config EXAMPLES_BACKTRACE_TEST
	bool "Backtrace test application"
	default n
	depends on SCHED_BACKTRACE
	---help---
		Enable the backtrace test application

if EXAMPLES_BACKTRACE_TEST

config EXAMPLES_BACKTRACE_TEST_PRIORITY
	int "Backtrace test task priority"
	default 100

config EXAMPLES_BACKTRACE_TEST_STACKSIZE
	int "Backtrace test stack size"
	default 4096

endif
```

## apps/examples/crashrpt_test/Kconfig
```kconfig
#
# For a description of the syntax of this configuration file,
# see kconfig-language at https://www.kernel.org/doc/Documentation/kbuild/kconfig-language.txt
#

config EXAMPLES_CRASHRPT_TEST
	bool "Crash diagnostic capture example"
	default n
	depends on CRASH_REPORT
	---help---
		Demonstrates /dev/crashrpt.

		Holds 500 nodes of 48 bytes and 50 nodes of 64 bytes, each with a
		message string of up to 255 bytes, and registers a reporter thread
		that serialises all of it to a file when the system is about to
		assert.

		The report is written to a temporary file and renamed only once the
		write has completed and been flushed, so a reader never sees a
		partial report.

if EXAMPLES_CRASHRPT_TEST

config EXAMPLES_CRASHRPT_TEST_DIR
	string "Directory for the report"
	default "/mnt"
	---help---
		Where the temporary and final report files are written.  Must be a
		writable mount point.

config EXAMPLES_CRASHRPT_TEST_PRIORITY
	int "Reporter thread priority"
	default 254
	---help---
		The reporter must outrank every other runnable thread, otherwise it
		is not scheduled before the deadline expires and no report is
		produced.

config EXAMPLES_CRASHRPT_TEST_STACKSIZE
	int "Reporter thread stack size"
	default 8192

endif # EXAMPLES_CRASHRPT_TEST

config USER_ENTRYPOINT
	string
	default "crashrpt_test_main" if ENTRY_CRASHRPT_TEST
```

## apps/examples/health_monitor/Kconfig
```kconfig
# SPDX-License-Identifier: Apache-2.0

config EXAMPLES_HEALTH_MONITOR
	bool "Health monitor validation example"
	default n
	depends on HEALTH_MONITOR && !DISABLE_PTHREAD && !DISABLE_MQUEUE
	---help---
		Enable the health_monitor command for start, kick and stop through a
		worker thread, a periodic run cycle and numbered scenarios. Scenario 1
		tests two-thread ping-pong; scenarios 2..6 deliberately test missing
		kicks, semaphore deadlock, CPU starvation, sched_lock and unexpected
		exit. Scenario 7 uses a 10-second timeout, logs wall-clock and uptime
		changes, kicks after moving time forward/backward, then restores time
		and stops normally. No thread is monitored until a
		command explicitly starts monitoring.
		Scenarios 2..6 and expire deliberately trigger PANIC; reset behavior
		follows the board watchdog and panic configuration.
```

## apps/examples/mem_leak_test/Kconfig
```kconfig
#
# For a description of the syntax of this configuration file,
# see kconfig-language at https://www.kernel.org/doc/Documentation/kbuild/kconfig-language.txt
#

config EXAMPLES_MEM_LEAK_TEST
	bool "Memory Leak Checker Test Suite"
	default n
	depends on DEBUG_MM_HEAPINFO
	---help---
		Enable the Memory Leak Checker test suite. This application creates
		known memory leak scenarios (reference cycles, IPC shared blocks, etc.)
		to validate the behavior of the memory leak checker tool.

		After running a test, use 'mem_leak_checker' from TASH to verify
		whether the leak was detected.

config USER_ENTRYPOINT
	string
	default "mem_leak_test_main" if ENTRY_MEM_LEAK_TEST
```

## apps/examples/mmu_protect_test/Kconfig
```kconfig
#
# For a description of the syntax of this configuration file,
# see kconfig-language at https://www.kernel.org/doc/Documentation/kbuild/kconfig-language.txt
#

config EXAMPLES_MMU_PROTECT_TEST
	bool "MMU page protection UAF detection test"
	default n
	---help---
		Enable the MMU page protection test for use-after-free detection.

		This test exercises the MMU page protection functions added to
		arm_mmu.c (mmu_save_page_pte, mmu_set_page_no_access,
		mmu_set_page_ro, mmu_restore_page_pte).

		Safe mode (default) verifies PTE manipulation without triggering
		any faults.  UAF mode ("mmu_protect_test uaf") creates a real
		use-after-free scenario: a page is protected via MMU, then
		accessed.  The MMU triggers a Data Abort, which is the UAF
		detection.

		Usage from TASH:
		  mmu_protect_test           Run safe-mode tests (no Data Abort)
		  mmu_protect_test save      Test mmu_save_page_pte
		  mmu_protect_test noaccess  Test mmu_set_page_no_access (safe)
		  mmu_protect_test ro         Test mmu_set_page_ro (safe)
		  mmu_protect_test restore    Test mmu_restore_page_pte
		  mmu_protect_test uaf        Trigger a real UAF Data Abort

		NOTE: Requires ARMv7-A with MMU.  The "uaf" subcommand causes
		a fatal Data Abort (system crash/reboot).

config USER_ENTRYPOINT
	string
	default "mmu_protect_test_main" if EXAMPLES_MMU_PROTECT_TEST
```

## apps/examples/mtdtest/Kconfig
```kconfig
config EXAMPLES_MTDTEST
	bool "mtdtest"
	default n
	depends on MTD
	---help---
		Enable mtdtest in TASH.  Erases, writes and verifies
		erase blocks of an FTL-backed MTD block device (default
		/dev/mtdblock7) to exercise the flash erase/program path.
		Writing to the partition that holds the running kernel, the
		OTA kernel slot or the boot parameters is refused unless
		forced.
```

## apps/examples/performance/heap/Kconfig
```kconfig
#
# For a description of the syntax of this configuration file,
# see kconfig-language at https://www.kernel.org/doc/Documentation/kbuild/kconfig-language.txt
#

config EXAMPLES_HEAP_PERFORMANCE_TEST
	bool "Heap performance test"
	default n
	---help---
		Measure the elapsed time while simply repeating memory allocation and release.

config EXAMPLES_HEAP_BENCH_TEST
	bool "Heap bench test"
	default n
	---help---
		Allocate memory blocks of various sizes, free a configurable percentage,
		and optionally invoke the memory leak checker to verify that the
		remaining blocks are detected as leaks.

		Also supports stress test modes (fill, perf, frag) for heap performance
		and fragmentation measurement. All modes work independently of
		CONFIG_MEM_LEAK_CHECKER; the leak checker is only invoked when
		explicitly requested in basic mode (run_checker=1) or fill mode, and
		only if CONFIG_MEM_LEAK_CHECKER is enabled. Perf and frag modes never
		call the leak checker.

config EXAMPLES_HEAP_STRESS_MAX_BLOCKS
	int "Maximum blocks for heap stress test"
	default 3000
	depends on EXAMPLES_HEAP_BENCH_TEST
	---help---
		Maximum number of memory blocks the heap stress test (fill, perf,
		frag modes) will track. This is independent of the memory leak
		checker's CONFIG_MEM_LEAK_CHECKER_MAX_BLOCKS.

config USER_ENTRYPOINT
	string
	default "heaptest_main" if ENTRY_HEAP_PERFORMANCE_TEST
	default "heapbench_main" if ENTRY_HEAP_BENCH_TEST
```

## apps/examples/performance/secure_storage/Kconfig
```kconfig
#
# For a description of the syntax of this configuration file,
# see kconfig-language at https://www.kernel.org/doc/Documentation/kbuild/kconfig-language.txt
#

config EXAMPLES_SS_PERFORMANCE_TEST
	bool "Secure storage performance test"
	default n
	depends on SE
	---help---
		Measure secure storage read, write, erase, and composite operation times.

config USER_ENTRYPOINT
	string
	default "ss_performance_test" if ENTRY_SS_PERFORMANCE_TEST
```

## apps/examples/pthread_cleanup_test/Kconfig
```kconfig
#
# For a description of the syntax of this configuration file,
# see kconfig-language at https://www.kernel.org/doc/Documentation/kbuild/kconfig-language.txt
#

config EXAMPLES_PTHREAD_CLEANUP_TEST
	bool "Pthread cancellation and cleanup tests"
	default n
	depends on !DISABLE_PTHREAD && PTHREAD_CLEANUP
	---help---
		Enable comprehensive tests for pthread cancellation
		and cleanup functionality. Works with both flat and loadable builds.

if EXAMPLES_PTHREAD_CLEANUP_TEST

config EXAMPLES_PTHREAD_CLEANUP_TEST_STACKSIZE
	int "Test thread stack size"
	default 8192
	---help---
		Size of the stack used to create test threads. Default is 8192.
		May need to increase for tests with deep nesting.

config EXAMPLES_PTHREAD_CLEANUP_TEST_LOOPS
	int "Number of test loops"
	default 1
	---help---
		Used to control the number of executions of each test.
		If undefined, each test executes one time.
		If defined to be zero, tests run continuously.

config EXAMPLES_PTHREAD_CLEANUP_TEST_THREAD_COUNT
	int "Number of threads for tests"
	default 10
	range 1 100
	---help---
		Number of threads to create for multi-threaded tests.
		Default is 10. Allowed values [1; 100].

config EXAMPLES_PTHREAD_CLEANUP_TEST_NESTING_DEPTH
	int "Nesting depth for tests"
	default 50
	range 1 500
	---help---
		Maximum nesting depth for cleanup handler tests.
		Default is 50. Allowed values [1; 500].

config EXAMPLES_PTHREAD_CLEANUP_TEST_ITERATIONS
	int "Iterations per test"
	default 1000
	---help---
		Number of iterations for high-frequency tests.
		Default is 1000.

endif # EXAMPLES_PTHREAD_CLEANUP_TEST

config USER_ENTRYPOINT
	string
	default "pthread_cleanup_main" if ENTRY_PTHREAD_CLEANUP_TEST
```

## apps/examples/quicktrack/Kconfig
```kconfig
#
# For a description of the syntax of this configuration file,
# see kconfig-language at https://www.kernel.org/doc/Documentation/kbuild/kconfig-language.txt
#

config EXAMPLES_QUICKTRACK
	bool "WFA QuickTrack DUT agent (TASH quicktrack_test)"
	default n
	depends on QUICK_TRACK
	depends on WIFI_MANAGER
	depends on TASH
	depends on BUILTIN_APPS
	---help---
		Register TASH command "quicktrack_test". It brings up wifi_manager
		if needed and starts the WFA QuickTrack DUT agent (controlappc).
```

## apps/examples/testcase/le_tc/drivers/Kconfig
```kconfig
#
# For a description of the syntax of this configuration file,
# see kconfig-language at https://www.kernel.org/doc/Documentation/kbuild/kconfig-language.txt
#

menuconfig EXAMPLES_TESTCASE_DRIVERS
	bool "Drivers TestCase Example"
	default n
	select DRIVERS_OS_API_TEST
	---help---
		Enable the Drivers TestCase Example

if EXAMPLES_TESTCASE_DRIVERS
config TC_DRV_ALL
	bool "All"
	default n
	select TC_DRIVERS_NULL if DEV_NULL
	select TC_DRIVERS_ZERO if DEV_ZERO
	select TC_DRIVERS_RTC if RTC_DRIVER
	select TC_DRIVERS_PWM if PWM
	select TC_DRIVERS_WATCHDOG if WATCHDOG
	select TC_DRIVERS_LOOP
	select TC_DRIVERS_ADC if ADC
	select TC_DRIVERS_BCH if BCH
	select TC_DRIVERS_I2C if I2C_TRANSFER

config TC_DRIVERS_NULL
	bool "Dev Null"
	default n
	depends on DEV_NULL

config TC_DRIVERS_ZERO
	bool "Dev Zero"
	default n
	depends on DEV_ZERO

config TC_DRIVERS_RTC
	bool "Dev Rtc"
	default n
	depends on RTC_DRIVER

config TC_DRIVERS_PWM
	bool "Dev PWM"
	default n
	depends on PWM

config TC_DRIVERS_WATCHDOG
	bool "Dev Watchdog"
	default n
	depends on WATCHDOG

config TC_DRIVERS_WATCHDOG_SECURITY
	bool "Dev Watchdog Security"
	default y
	depends on WATCHDOG
	---help---
		Security test cases for watchdog driver.
		Tests for WDIOC_CAPTURE vulnerability (finding-198).
		Requires CONFIG_BUILD_PROTECTED for full security validation.

config TC_DRIVERS_LOOP
	bool "Dev Loop"
	default n

config TC_DRIVERS_ADC
	bool "Dev ADC"
	default n
	depends on ADC

config TC_DRIVERS_BCH
        bool "Dev BCH"
        default n
        depends on BCH

config TC_DRIVERS_I2C
        bool "Dev I2C"
        default n
        depends on I2C_TRANSFER

endif #EXAMPLES_TESTCASE_DRIVERS
```

## apps/examples/testcase/le_tc/stress/Kconfig
```kconfig
#
# For a description of the syntax of this configuration file,
# see kconfig-language at https://www.kernel.org/doc/Documentation/kbuild/kconfig-language.txt
#

menuconfig EXAMPLES_TESTCASE_STRESS
	bool "Stress TestCase Example"
	default n
	depends on EXAMPLES_TESTCASE
	---help---
		Enable the Stress TestCase Example

if EXAMPLES_TESTCASE_STRESS
config STRESS_TASK_CREATE_TERM
	bool "Task create and terminate stress"
	default n
	---help---
		Enable task creation and termination stress test
		Infinite Test

config STRESS_SEM_PRIO_INHERIT
	bool "Semaphore priority inheritance stress"
	default n
	depends on PRIORITY_INHERITANCE
	---help---
		Enable semaphore priority inheritance stress test
		Finite Test

config STRESS_MM_SEM_SIGNAL
	bool "MM semaphore signal stress"
	default n
	depends on !DISABLE_MQUEUE && !DISABLE_SIGNALS && !DISABLE_PTHREAD
	---help---
		Enable MM semaphore signal stress test
		Infinite Test
endif #EXAMPLES_TESTCASE_STRESS
```
