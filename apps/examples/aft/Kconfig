## os/Kconfig
```kconfig
#
# For a description of the syntax of this configuration file,
# see kconfig-language at https://www.kernel.org/doc/Documentation/kbuild/kconfig-language.txt
#

mainmenu "TinyAra Configuration"

config APPSDIR
	string
	option env="APPSDIR"

config EXTERNALDIR
	string
	option env="EXTERNALDIR"

config LIBDIR
	string
	option env="LIBDIR"

config BINDIR
	string
	option env="BINDIR"

config LOADABLEDIR
	string
	option env="LOADABLEDIR"

menu "License Setup"
config ALLOW_BSD_COMPONENTS
	bool "Use components that have BSD licenses"
	default n
	---help---
		When this option is enabled the project will allow the use
		of components that have BSD licenses.

		NOTE: Please check that the license for each enabled
		component matches your project license.

		NOTE: If this option is not set the following components
		are not included in the setup menu:
		Crypto
		    AES cypher support
		FS
		    NFS client file system
		    SPIFFS File System
		Wireless
		    Bluetooth LE support

config ALLOW_MIT_COMPONENTS
	bool "Use components that have MIT licenses"
	default n
	---help---
		When this option is enabled the project will allow the use
		of components that have MIT licenses.

		NOTE: Please check that the license for each enabled
		component matches your project license.

config ALLOW_BSDNORDIC_COMPONENTS
	bool "Use components that have 5-Clause Nordic licenses"
	depends on ARCH_CHIP_NRF52 || ARCH_CHIP_NRF53 || ARCH_CHIP_NRF91
	default n
	---help---
		When this option is enabled the project will allow the use
		of components that have 5-Clause Nordic licenses.

		NOTE: Please check that the license for each enabled
		component matches your project license.

config ALLOW_ECLIPSE_COMPONENTS
	bool "Use components that have Eclipse Public Licenses"
	default n
	---help---
		When this option is enabled the project will allow the use
		of components that have EPL licenses.

		NOTE: Please check that the license for each enabled
		component matches your project license.

config ALLOW_ICS_COMPONENTS
	bool "Use components that have ICS license"
	default n
	---help---
		When this option is enabled the project will allow the use
		of components that have ICS licenses.

		NOTE: Please check that the license for each enabled
		component matches your project license.

config ALLOW_CUSTOM_PERMISSIVE_COMPONENTS
	bool "Use components that have custom permissive licenses"
	default n
	---help---
		When this option is enabled the project will allow the use
		of components that have custom permissive licenses which
		are not covered by the standard license options above.

		This includes components with custom permissive licenses
		that allow free use, modification, and distribution but
		may have specific attribution or notice requirements.

		NOTE: Please carefully review the license terms for each
		enabled component to ensure compliance with your project
		requirements.

endmenu # License Setup

menu "Build Setup"

config EXPERIMENTAL
	bool "Show experimental options"
	---help---
		Some features and drivers are considered "experimental" or
		development/work-in-progress status. By default, these options are
		hidden in the Kconfig menus. Enabling "Show experimental options"
		makes these options visible and makes it possible to enable them.

config DEFAULT_SMALL
	bool "Default to smallest size"
	default n
	---help---
		When options are present, the default value for certain options will
		be the one the results in the smallest size (at a loss of features).
		The default is a fuller feature set at a larger size.

		NOTE: This option does not prevent you from overriding the default
		to select another alternative.  Nor does it affect the settings that
		have already been selected in your configuration file.  This applies
		only to new settings that require a default value.

choice
	prompt "Build Host Platform"
	default HOST_LINUX

config HOST_LINUX
	bool "Linux"

config HOST_MACOS
	bool "macOS"

config HOST_WINDOWS
	bool "Windows"

config HOST_OTHER
	bool "Other"

endchoice # Build Host Platform

config TOOLCHAIN_WINDOWS
	bool
	default n
	depends on HOST_WINDOWS
	---help---
		Selected internally if the selected Windows environment is compatible
		with the use of Windows native toolchains.

config CYGWIN_WINTOOL
	bool
	default n
	depends on WINDOWS_CYGWIN
	---help---
		Selected internally if Cygwin environment with the use of Windows
		native toolchains.

choice
	prompt "Windows Build Environment"
	default WINDOWS_CYGWIN
	depends on HOST_WINDOWS

config WINDOWS_NATIVE
	bool "Windows Native"
	select TOOLCHAIN_WINDOWS
	depends on EXPERIMENTAL
	---help---
		Build natively in a CMD.exe environment with Windows style paths
		(like C:\cygwin\home)

		The Windows native build is complete and available, but not often
		used or verified.  As a consequence, it cannot be assured to be
		fully functional at any given time.  Hence, it is marked here as
		EXPERIMENTAL so that the end user will be aware of this state.

config WINDOWS_CYGWIN
	bool "Cygwin"
	select TOOLCHAIN_WINDOWS
	---help---
		Build natively in a Cygwin environment with POSIX style paths (like
		/cygdrive/c/Program Files)

config WINDOWS_MSYS
	bool "MSYS or MSYS2"
	select TOOLCHAIN_WINDOWS
	---help---
		Build natively in a Cygwin environment with POSIX style paths (like
		/cygdrive/c/cygwin/home)

config WINDOWS_OTHER
	bool "Windows POSIX-like environment"
	select TOOLCHAIN_WINDOWS
	---help---
		Build natively in another POSIX-like environment.  Additional
		support may be necessary

endchoice # Windows Build Environment

config WINDOWS_MKLINK
	bool "Use mklink"
	default n
	depends on WINDOWS_NATIVE
	---help---
		Use the mklink command to set up symbolic links when NuttX is
		configured.  Otherwise, configuration directories will be copied to
		establish the configuration.

		If directories are copied, then some confusion can result ("Which
		version of the file did I modify?").  In that case, it is recommended
		that you re-build using 'make clean_context all'.  That will cause the
		configured directories to be recopied on each build.

		NOTE: This option also (1) that you have administrator privileges, (2)
		that you are using Windows 2000 or better, and (3) that you are using
		the NTFS file system.  Select 'n' is that is not the case.

menu "Build Configuration"

config APPS_DIR
	string "Application directory"
	default "../apps" if !WINDOWS_NATIVE
	default "..\apps" if WINDOWS_NATIVE
	---help---
		Identifies the directory that builds the
		application to link with NuttX.  Default: ../apps This symbol must
		be assigned to the path to the application build directory
		*relative* to the NuttX top build directory. If you had an
		application directory and the NuttX directory each in separate
		directory trees like this:

			build
			|-nuttx
			|  |
			|  `- Makefile
			`-application
			|
			`- Makefile

		Then you would set APPS_DIR=../application.

		The application direction must contain Makefile and this make
		file must support the following targets:

		1)libapps$(LIBEXT) (usually libapps.a). libapps.a is a static
		library ( an archive) that contains all of application object
		files.

		2)clean. Do whatever is appropriate to clean the application
		directories for a fresh build.

		3)distclean. Clean everything -- auto-generated files, symbolic
		links etc. -- so that the directory contents are the same as
		the contents in your configuration management system.
		This is only done when you change the NuttX configuration.

		4)depend. Make or update the application build dependencies.

		When this application is invoked it will receive the setting TOPDIR like:

		$(MAKE) -C $(CONFIG_APPS_DIR) TOPDIR="$(TOPDIR)" <target>

		TOPDIR is the full path to the NuttX directory. It can be used, for
		example, to include makefile fragments (e.g., .config or Make.defs)
		or to set up include file paths.

choice
	prompt "Memory organization"
	default BUILD_FLAT

config BUILD_FLAT
	bool "Flat address space"
	---help---
		Build NuttX as one large, executable "blob".  All of the code
		within the blob can interrupt with all of the other code within
		the blob.  There are no special privileges, protections, or
		restraints.

config BUILD_PROTECTED
	bool "NuttX protected build"
	depends on ARCH_USE_MPU
	select LIB_SYSCALL
	select BUILD_2PASS
	---help---
		Builds NuttX and selected applications as two "blobs":  A protected,
		privileged kernel blob and a separate unprivileged, user blob.  This
		requires use of the two pass build with each blob being build on
		each pass.

		NOTE:  This build configuration requires that the platform support
		a memory protection unit (MPU).  Support, however, may not be
		implemented on all platforms.

config BUILD_KERNEL
	bool "NuttX kernel build"
	depends on ARCH_USE_MMU && ARCH_ADDRENV
	select LIB_SYSCALL
	select MODULES
	---help---
		Builds NuttX as a separately compiled kernel.  No applications are
		built.  All user applications must reside in a file system where
		they can be loaded into memory for execution.

		NOTE:  This build configuration requires that the platform support
		a memory management unit (MMU) and address environments.  Support,
		however, may not be implemented on all platforms.

endchoice # Build configuration

config BUILD_PIC
	bool "NuttX PIC build"
	default n
	---help---
		Builds NuttX with position-independent code (PIC).  This will allow
		load NuttX into memory at any address and run it.

config BUILD_2PASS
	bool "Two pass build"
	default n
	---help---
		Enables the two pass build options.

		Two-pass build options.  If the 2 pass build option is selected, then these
		options configure the make system build a extra link object. This link object
		is assumed to be an incremental (relative) link object, but could be a static
		library (archive) (some modification to this Makefile would be required if
		PASS1_TARGET generates an archive). Pass 1 1ncremental (relative) link
		objects should be put into the processor-specific source directory (where other
		link objects will be created).  If the pass1 object is an archive, it could
		go anywhere.

if BUILD_2PASS

config PASS1_TARGET
	string "Pass one target"
	default "all"
	---help---
		The name of the first pass build target.  This
		can be specific build target, a special build target (all, default, etc.)
		or may just be left undefined.

config PASS1_OBJECT
	string "Pass one object"
	default ""
	---help---
		May be used to include an extra, pass1 object
		into the final link.  This would probably be the object generated
		from the PASS1_TARGET.  It may be available at link time
		in the arch/<architecture>/src directory.

config NUTTX_USERSPACE
	hex "Beginning of user-space blob"
	default 0x0
	depends on BUILD_PROTECTED
	---help---
		In the kernel build, the NuttX kernel and the user-space blob are
		built separately linked objects.  NUTTX_USERSPACE provides the
		address where the user-space blob is loaded into memory.  NuttX will
		expect to find and instance of struct userspace_s at this location.

endif # Build 2-pass
endmenu # Build Setup

menu "Binary Output Formats"

config INTELHEX_BINARY
	bool "Intel HEX binary format"
	default n
	---help---
		Create the nuttx.hex in the Intel HEX binary format that is
		used with many different loaders. This option will use the GNU objcopy
		program and should not be selected if you are not using the GNU
		toolchain.

config MOTOROLA_SREC
	bool "Motorola S-Record binary format"
	default n
	---help---
		Create the nuttx.srec in the Motorola S-Record binary format that is
		used with many different loaders. This option will use the GNU objcopy
		program and should not be selected if you are not using the GNU
		toolchain.

config RAW_BINARY
	bool "Raw binary format"
	default n
	---help---
		Create the nuttx.bin in the raw binary format that is used with many
		different loaders using the GNU objcopy program.  This option
		should not be selected if you are not using the GNU toolchain.

menuconfig UBOOT_UIMAGE
	bool "U-Boot uImage"
	select RAW_BINARY
	depends on !WINDOWS_NATIVE
	---help---
		Create the uImage binary used with U-Boot.

if UBOOT_UIMAGE

config UIMAGE_LOAD_ADDRESS
	hex "uImage load address"
	default 0x0

config UIMAGE_ENTRY_POINT
	hex "uImage entry point"
	default 0x0

endif # UBOOT_UIMAGE

endmenu # Binary Output Formats

menu "Customize Header Files"

config ARCH_HAVE_STDINT_H
	bool
	default n
	---help---
		Selected by architecture specific logic if the architecture provides
		a stdint.h header file.

config ARCH_STDINT_H
	bool "stdint.h"
	default n
	depends on ARCH_HAVE_STDINT_H
	---help---
		The stdint.h header file can be found at tinyara/include/stdint.h.
		However, that header includes logic to redirect the inclusion of an
		architecture specific header file like:

			#ifdef CONFIG_ARCH_STDINT_H
			#  include <arch/stdint.h>
			#else
			...
			#endif

		Recall that that include path, include/arch, is a symbolic link and
		will refer to a version of stdint.h at tinyara/arch/<architecture>/include/stdint.h.

config ARCH_HAVE_STDBOOL_H
	bool
	default n
	---help---
		Selected by architecture specific logic if the architecture provides
		a stdbool.h header file.

config ARCH_STDBOOL_H
	bool "stdbool.h"
	default n
	depends on ARCH_HAVE_STDBOOL_H
	---help---
		The stdbool.h header file can be found at tinyara/include/stdbool.h.
		However, that header includes logic to redirect the inclusion of an
		architecture specific header file like:

			#ifdef CONFIG_ARCH_STDBOOL_H
			#  include <arch/stdbool.h>
			#else
			...
			#endif

		Recall that that include path, include/arch, is a symbolic link and
		will refer to a version of stdbool.h at tinyara/arch/<architecture>/include/stdbool.h.

config ARCH_HAVE_MATH_H
	bool
	default n
	---help---
		Selected by architecture specific logic if the architecture provides
		a math.h header file.

config ARCH_MATH_H
	bool "math.h"
	depends on ARCH_HAVE_MATH_H
	default n
	---help---
		There is also a re-directing version of math.h in the source tree.
		However, it resides out-of-the-way at include/tinyara/lib/math.h because it
		conflicts too often with the system math.h. If ARCH_MATH_H=y is
		defined, however, the top-level makefile will copy the redirecting
		math.h header file from include/tinyara/lib/math.h to include/math.h. math.h
		will then include the architecture-specific version of math.h that you
		must provide at tinyara/arch/>architecture</include/math.h.

			#ifdef CONFIG_ARCH_MATH_H
			#  include <arch/math.h>
			#endif

		So for the architectures that define ARCH_MATH_H=y, include/math.h
		will be the redirecting math.h header file; for the architectures
		that don't select ARCH_MATH_H, the redirecting math.h header file
		will stay out-of-the-way in include/tinyara/.

config ARCH_FLOAT_H
	bool "float.h"
	default n
	---help---
		The float.h header file defines the properties of your floating
		point implementation.  It would always be best to use your
		toolchain's float.h header file but if none is available, a default
		float.h header file will provided if this option is selected.  However
		there is no assurance that the settings in this float.h are actually
		correct for your platform!

config DISABLE_FLOAT
	bool "Disable floating point"
	default n
	---help---
		Disable floating point support in the compiler. This will reduce
		code size and increase performance. This option is only available
		on some architectures.

config ARCH_HAVE_STDARG_H
	bool
	default n
	---help---
		Selected by architecture specific logic if the architecture provides
		a math.h header file.

config ARCH_STDARG_H
	bool "stdarg.h"
	depends on ARCH_HAVE_STDARG_H
	default n
	---help---
		There is a redirecting version of stdarg.h in the source tree. It
		resides out-of-the-way at include/tinyara/lib/stdarg.h.  This is
		because you should normally use your toolchain's stdarg.h file. But
		sometimes, your toolchain's stdarg.h file may have other header
		file dependencies and so may not be usable in the NuttX build
		environment. In those cases, you may have to create a architecture-
		specific stdarg.h header file at tinyara/arch/<architecture>/include/stdarg.h

		If ARCH_STDARG_H=y is defined, the top-level makefile will copy the
		re-directing stdarg.h header file from include/tinyara/lib/stdarg.h to
		include/stdarg.h. So for the architectures that cannot use their
		toolchain's stdarg.h file, they can use this alternative by defining
		ARCH_STDARG_H=y and providing. If ARCH_STDARG_H, is not defined, then
		the stdarg.h header file will stay out-of-the-way in include/tinyara/.

config ARCH_HAVE_STDBIT_H
	bool
	default n
	---help---
		Selected by architecture specific logic if the architecture
		provides a stdbit.h header file.

config ARCH_STDBIT_H
	bool "stdbit.h"
	depends on ARCH_HAVE_STDBIT_H
	default n
	---help---
		Redirecting stdbit.h lives at include/tinyara/lib/stdbit.h. When
		this is set, the build copies it to include/stdbit.h and it
		includes arch/stdbit.h if the architecture provides one.

config LIBC_STDBIT_GENERIC
	bool "stdbit.h (generic C23)"
	default n
	---help---
		Use generic C23 stdbit implementation. When set, copy
		include/tinyara/lib/stdbit.h to include/stdbit.h. No arch
		header is used; builtins (e.g. __builtin_clz) must be
		available (see CONFIG_HAVE_BUILTIN_* in compiler.h).

config ARCH_HAVE_SETJMP
	bool
	default n

config ARCH_SETJMP_H
	bool "setjmp.h"
	default n
	depends on ARCH_HAVE_SETJMP
	---help---
		There is a redirecting version of setjmp.h in the source tree. It
		resides out-of-the-way at include/tinyara/lib/setjmp.h.  This is
		because you should normally use your toolchain's setjmp.h file. But
		sometimes, your toolchain's setjmp.h file may have other header
		file dependencies and so may not be usable in the NuttX build
		environment. In those cases, you may have to create a architecture-
		specific setjmp.h header file at tinyara/arch/<architecture>/include/setjmp.h

		If ARCH_SETJMP_H=y is defined, the top-level makefile will copy the
		re-directing setjmp.h header file from include/tinyara/lib/setjmp.h to
		include/setjmp.h. So for the architectures that cannot use their
		toolchain's setjmp.h file, they can use this alternative by defining
		ARCH_SETJMP_H=y and providing. If ARCH_SETJMP_H, is not defined, then
		the setjmp.h header file will stay out-of-the-way in include/tinyara/.

choice
	prompt "debug.h selection"
	default ARCH_NONE_DEBUG_H

config ARCH_NONE_DEBUG_H
	bool "None"
	---help---
		No debug.h under include/arch/ and include/arch/chip.

config ARCH_DEBUG_H
	bool "debug.h"
	---help---
		The debug.h under include/arch contains architecture dependent debugging primitives

config ARCH_CHIP_DEBUG_H
	bool "chip debug.h"
	---help---
		The debug.h under include/arch/chip contains architecture dependent debugging primitives

config ARCH_BOARD_DEBUG_H
	bool "board debug.h"
	---help---
		The debug.h under include/arch/board contains board dependent debugging primitives

endchoice # debug.h selection

endmenu # Customize Header Files


comment "TizenRT Build Options"

config APP_BINARY_SEPARATION
	bool "Application binary separation build"
	depends on BUILD_PROTECTED
	select BINFMT_LOADABLE
	---help---
		Enables application binary separation.
		This config is tightly coupled to CONFIG_BUILD_PROTECTED. When protected
		build is selected, then selecting this config generates separate binary for
		each user space application, apart from a separate kernel binary. Selecting
		config also applies MPU based memory isolation and protection for each app.


config DOCKER_VERSION
	string "Docker Image Version"
	default "1.5.8"
	---help---
		This config indicates docker image version. We have developed distinct
		version of docker images tailored to each toolchain required by different
		chipset's configs. This approach streamlines development by providing
		specific environments that align with the chipset's configs.

		NOTE: C++ exception support requires toolchain version 10.3.1. If you are
		enabling C++ exception then use docker image version 2.0.0.

		Possible Versions: Please check https://hub.docker.com/r/tizenrt/tizenrt

menu "Build Configuration"
config FRAMEWORK_DIR
	string "FRAMEWORK directory"
	default "../framework" if !WINDOWS_NATIVE
	default "..\framework" if WINDOWS_NATIVE

config TOOLS_DIR
	string "tools directory"
	default "../tools" if !WINDOWS_NATIVE
	default "..\tools" if WINDOWS_NATIVE

config BUILD_PARALLEL_JOBS
	int "Number of parallel build jobs (0 = auto-detect)"
	default 0
	range 0 128
	---help---
		Set the number of parallel build jobs.
		0 = Auto-detect using nproc (default)
		1-128 = Use specified number of jobs
		This controls the -j option passed to make.

if APP_BINARY_SEPARATION
config NUM_APPS
	int "Number of application binaries"
	default 2
	---help---
		Indicates the number of user applications to be built. The available RAM might
		constrain the max number of applications. It is the developer's responsibility
		to make sure that the NUM_APPS lies withing the memory constraints.

config APPS_RAM_REGION_SHAREABLE
	bool "RAM region of apps shareable"
	default n
	---help---
		This config indicates if the applications RAM region is to be configured as a
		shareable region in the MPU. If the system has multiple cores which might access
		the external applicaiton RAM region, then this config needs to be set to true.

config SUPPORT_COMMON_BINARY
	bool "Support Common Binary"
	default n
	depends on FS_SMARTFS
	select LIB_HASHMAP
	---help---
		This config indicates whether we support common binary. The common binary will
		contain all the common libraries which will be used by the different loadable
		applications. The common binary will be stored in the file system.

if SUPPORT_COMMON_BINARY
config COMMON_BINARY_VERSION
	string "Common binary version (YYMMDD)"
	default 200204
	---help---
		This config indicates common binary version which has a "YYMMDD" format.
		It is included in common binary header and binary manager uses it to check the latest binary.
		So it should be set to a higher value than versions of old binaries if you want to make the binary the latest version.

config COMMON_BINARY_NAME
	string "Name of common binary file"
	default "common_binary"
	---help---
		Filename of the common binary file.

config COMMON_BIN_STATIC_RAMSIZE
	int "Common Binary static RAM size for data and bss"
	default 524288
	depends on XIP_ELF
	---help---
		Common Binary static RAM size for data and bss

endif # SUPPORT_COMMON_BINARY
if ARCH_USE_MMU
config NUM_L2_PER_APP
	int "Number of L2 page tables per app"
	default 4
	---help---
		Set the number of L2 page tables required per app binary.
		Memory required for this number of L2 page tables will be reserved by the system.
		If the number of L2 page tables required during run time exceeds this value, then 
		the behavior is UNDEFINED. 
endif # ARCH_USE_MMU
endif # APP_BINARY_SEPARATION
config BOARD_BUILD_DATE
	string "Binary Build Date (YYMMDD)"
	default 200204
	---help---
		This config indicates build date which has a "YYMMDD" format.
		It is included in binary header as binary version and binary manager uses it to check the latest binary.
		So it should be set to a higer value than versions of old binaries if you want to make the binary the latest version.

config BINARY_SIGNING
	bool "Enable Binary Signing"
	default n
	depends on ARCH_BOARD_RTL8721CSM || ARCH_BOARD_RTL8730E || ARCH_BOARD_BK7239N
	---help---
		Enable Encryption and Secure boot.
		But this config is set as n and invisible because binary signing is not supported here.

config RESOURCE_BINARY_SIGNING
	bool "Enable Resource Binary Signing"
	default n
	depends on BINARY_SIGNING && RESOURCE_FS
	select USER_SIGN_PREPEND_SIZE
	---help---
		Enable signing for resource binaries.
		This option enables signing for resource binaries used in the system.

endmenu # Build Configuration
menu "Binary Output Formats"
config DOWNLOAD_IMAGE
	bool "Convert RAW binary to download image"
	select RAW_BINARY
	depends on !WINDOWS_NATIVE
	---help---
		Create download image based on RAW binary

endmenu # Binary Output Formats

endmenu # Build Setup


menu "Chip Selection"
source arch/Kconfig
endmenu

menu "Board Selection"
source board/Kconfig
endmenu

menu "SE Selection"
source se/Kconfig
endmenu

menu "Kernel Features"
source kernel/Kconfig
endmenu

menu "Device Drivers"
source drivers/Kconfig
endmenu

menu "Networking Support"
source net/Kconfig
endmenu

menu "Audio Support"
source audio/Kconfig
endmenu

menu "Media Support"
source "$FRAMEWORK_DIR/src/media/Kconfig"
endmenu

menu "File Systems"
source fs/Kconfig
endmenu

menu "Database"
source "$FRAMEWORK_DIR/src/arastorage/Kconfig"
endmenu

menu "AI Framework"
source "$FRAMEWORK_DIR/src/aifw/Kconfig"
endmenu

menu "AraUI Framework"
source "$FRAMEWORK_DIR/src/araui/Kconfig"
endmenu

menu "CSI Framework"
source "$FRAMEWORK_DIR/src/csimanager/Kconfig"
endmenu

menu "Memory Management"
source mm/Kconfig
endmenu

menu "Power Management"
source pm/Kconfig
endmenu

menu "Debug Options"
source Kconfig.debug
endmenu

menu "System Call"
	depends on BUILD_PROTECTED || BUILD_KERNEL
source syscall/Kconfig
endmenu

menu "Built-in Libraries"
source libs/libc/Kconfig
source libs/libm/Kconfig
source libs/libxx/Kconfig
source libs/libdsp/Kconfig
source libs/libbuiltin/Kconfig
endmenu

menu "External Libraries"
source "$EXTERNALDIR/Kconfig"
endmenu

menu "Binary Loader"
source binfmt/Kconfig
endmenu

menu "Compression"
source compression/Kconfig
endmenu

menu "Application Configuration"
source "$APPSDIR/Kconfig"
endmenu

menu "Loadable apps Configuration"
source "$LOADABLEDIR/Kconfig"
endmenu

menu "Runtime Environment"
source Kconfig.runtime
endmenu

menu "Device Management"
source Kconfig.devmng
endmenu

menu "Binary manager"
source kernel/binary_manager/Kconfig
endmenu

menu "Messaging Framework"
source "$FRAMEWORK_DIR/src/messaging/Kconfig"
endmenu

menu "Preference Support"
source "$FRAMEWORK_DIR/src/preference/Kconfig"
endmenu

menu "Things Management"
source Kconfig.things
endmenu

menu "IoTBus Framework"
source "$FRAMEWORK_DIR/src/iotbus/Kconfig"
endmenu

menu "Security Framework"
source "$FRAMEWORK_DIR/src/security/Kconfig"
endmenu
```
