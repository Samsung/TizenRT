## apps/examples/elf/Kconfig
```kconfig
#
# For a description of the syntax of this configuration file,
# see kconfig-language at https://www.kernel.org/doc/Documentation/kbuild/kconfig-language.txt
#

config EXAMPLES_ELF
	bool "ELF Loader Example"
	default n
	select LIBC_EXECFUNCS
	depends on ELF
	---help---
		Enable the ELF Loader Example

if EXAMPLES_ELF

menu "Enable Test Scenarios"
config EXAMPLES_MESSAGING_TEST
	bool "Messaging Framework Test"
	default y
	---help---
		Enable the Messaging Framework Test"

if EXAMPLES_MESSAGING_TEST
config MESSAGING_TEST_REPETITION_NUM
	int
	default 1
	---help---
		Messaging F/W Test repetition number.
		To be updated.

endif

config EXAMPLES_RECOVERY_TEST
	bool "Binary Manager Recovery example"
	default y
	---help---
		Enable the Binary Manager Recovery test

if EXAMPLES_RECOVERY_TEST
config ENABLE_RECOVERY_AGING_TEST
	bool "Recovery Aging test"
	default n
	---help---
		Enable Recovery Aging test. Another Test cannot run at the same time.
endif

endmenu

config EXAMPLES_ELF_FULLYLINKED
	bool "Fully Linked ELF application support"
	default n
	depends on LIB_SYSCALL
	---help---
		Enable Fully Linked ELF application support

config MPU_TEST_KERNEL_CODE_ADDR
	hex "Address in kernel code range"
	default 0x00000000
	---help---
		Test MPU access protection to this kernel code address

config MPU_TEST_APP_ADDR
	hex "Address in differnet application range"
	default 0x00000000
	depends on APP_BINARY_SEPARATION
	---help---
		Test MPU access protection to this application address
endif
```

## apps/examples/err_report_demo/Kconfig
```kconfig
#
# For a description of the syntax of this configuration file,
# see kconfig-language at https://www.kernel.org/doc/Documentation/kbuild/kconfig-language.txt
#

config EXAMPLES_ERR_REPORT
	bool "Error Report Test"
	depends on ERROR_REPORT
	default n
	---help---
		Enable Error Report test

if EXAMPLES_ERR_REPORT

config EXAMPLES_ERR_REPORT_PROGNAME
	string "Program name"
	default "Error Report"
	depends on BUILD_KERNEL
	---help---
		This is the name of the program that will be use when the TASH ELF
		program is installed.

endif

config USER_ENTRYPOINT
	string
	default "error_report_main" if ENTRY_ERR_REPORT
```

## apps/examples/esp32_wifi_demo/Kconfig
```kconfig
#
# For a description of the syntax of this configuration file,
# see kconfig-language at https://www.kernel.org/doc/Documentation/kbuild/kconfig-language.txt
#
menuconfig EXAMPLES_ESP32WIFIDEMO
	bool "ESP32 wifi example"
	depends on ESP32_WIFI_SUPPORT
	default n
	---help---
		esp32 wifi example,it directly call esp wifi driver interface.

if EXAMPLES_ESP32WIFIDEMO

config ESP_WIFI_MODE_STATION
	bool "ESP32 wifi station test"
	default y
	---help---
		enable esp32 wifi station mode example, say N enable softap mode example

config ESP_WIFI_SSID
	string "WiFi SSID"
	default "myssid"
	---help---
		SSID (network name) to connect to or softap network name.

config ESP_WIFI_PASSWORD
	string "WiFi Password"
	default "mypassword"
	---help---
		WiFi password (WPA or WPA2) for the example to use.

if ESP_WIFI_MODE_STATION
config ESP_MAXIMUM_RETRY
	int "Maximum retry"
	default 5
	---help---
		Set the Maximum retry to avoid station reconnecting to the AP unlimited when the AP is really inexistent.
endif

config ESP_MAX_STA_CONN
	int "Maximal STA connections"
	default 4
	---help---
		Max number of the STA connects to AP.
endif
```

## apps/examples/eventloop/Kconfig
```kconfig
config EXAMPLES_EVENTLOOP
	bool "Event loop Example"
	default n
	select EVENTLOOP
	---help---
		Enable the Eventloop Example
```

## apps/examples/fota_sample/Kconfig
```kconfig
#
# For a description of the syntax of this configuration file,
# see kconfig-language at https://www.kernel.org/doc/Documentation/kbuild/kconfig-language.txt
#

config EXAMPLES_FOTA_SAMPLE
	bool "FOTA Sample Application"
	default n
	select SYSTEM_FOTA_HAL
	select FOTA_DRIVER
	---help---
		Enable FOTA Sample Application with FOTA HAL.

config USER_ENTRYPOINT
	string
	default "fota_sample" if ENTRY_FOTA_SAMPLE
```

## apps/examples/fs_helper/Kconfig
```kconfig
#
# For a description of the syntax of this configuration file,
# see kconfig-language at https://www.kernel.org/doc/Documentation/kbuild/kconfig-language.txt
#

config FILESYSTEM_HELPER_ENABLE
    bool "enable filesystem helper application"
    default n
        ---help---
        enable filesystem helper application

if FILESYSTEM_HELPER_ENABLE

config WRITE_REMOVE_TEST
	bool "repeat write & remove test"
	default n
	---help---
		Enable "rw_test" application

config ROMFS_TEST
	bool "romfs test"
	default n
	select FS_ROMFS
	---help---
		Enable "romfs_test" application

config FS_RW_TEST
	bool "fs rw test"
	depends on TASH
	depends on FS_SMARTFS
	default n
	---help---
		Enable "fs_rw_test" application

config RAMFS_TEST
	bool "ramfs test"
	default n
	select RAMMTD
	---help---
		Enable "ramfs_test" application

if RAMFS_TEST

config RAMFS_TEST_RAMFS_NEBLOCKS
	int "nblocks of ramfs test"
        default 32

endif #RAMFS_TEST

config PROCFS_TEST
	bool "procfs test"
	default n
	---help---
		Enable "procfs_test" application

endif #FILESYSTEM_HELPER_ENABLE
```

## apps/examples/fs_test/Kconfig
```kconfig
#
# For a description of the syntax of this configuration file,
# see kconfig-language at https://www.kernel.org/doc/Documentation/kbuild/kconfig-language.txt
#

config FILESYSTEM_TEST
    bool "enable filesystem test application"
    default n
        ---help---
        enable filesystem test application

if FILESYSTEM_TEST

config ROMFS_TEST
	bool "romfs test"
	default n
	select FS_ROMFS
	---help---
		Enable "romfs_test" application

config SMARTFS_TEST
	bool "smartfs test"
	depends on TASH
	depends on FS_SMARTFS
	default n
	---help---
		Enable "fs_rw_test" application

config RAMFS_TEST
	bool "ramfs test"
	default n
	select RAMMTD
	---help---
		Enable "ramfs_test" application

if RAMFS_TEST

config RAMFS_TEST_RAMFS_NEBLOCKS
	int "nblocks of ramfs test"
        default 32

endif #RAMFS_TEST

config PROCFS_TEST
	bool "procfs test"
	default n
	---help---
		Enable "procfs_test" application

endif #FILESYSTEM_TEST
```

## apps/examples/ftpc/Kconfig
```kconfig
#
# For a description of the syntax of this configuration file,
# see kconfig-language at https://www.kernel.org/doc/Documentation/kbuild/kconfig-language.txt
#

config EXAMPLES_FTPC
	bool "FTP client example"
	depends on NETUTILS_FTPC
	default n
	---help---
		Enable the FTP client example

config USER_ENTRYPOINT
	string
	default "ftpc_main" if ENTRY_FTPC
```

## apps/examples/ftpd/Kconfig
```kconfig
#
# For a description of the syntax of this configuration file,
# see kconfig-language at https://www.kernel.org/doc/Documentation/kbuild/kconfig-language.txt
#

config EXAMPLES_FTPD
	bool "FTP server example"
	depends on NETUTILS_FTPD
	default n
	---help---
		Enable the FTP server example

config USER_ENTRYPOINT
	string
	default "ftpd_main" if ENTRY_FTPD
```

## apps/examples/grpc/route_client/Kconfig
```kconfig
#
# For a description of the syntax of this configuration file,
# see kconfig-language at https://www.kernel.org/doc/Documentation/kbuild/kconfig-language.txt
#

config EXAMPLES_ROUTE_CLIENT
	bool "route client example"
	default n
	depends on GRPC
	depends on HAVE_CXXINITIALIZE
	---help---
		Enable the grpc client example

config USER_ENTRYPOINT
	string
	default "route_client_main" if ENTRY_ROUTE_CLIENT
```

## apps/examples/grpc_greeter_client/Kconfig
```kconfig
#
# For a description of the syntax of this configuration file,
# see kconfig-language at https://www.kernel.org/doc/Documentation/kbuild/kconfig-language.txt
#

config EXAMPLES_GREETER_CLIENT
	bool "grpc client example"
	default n
	depends on GRPC
	depends on HAVE_CXXINITIALIZE
	---help---
		Enable the grpc client example

config USER_ENTRYPOINT
	string
	default "greeter_client_main" if ENTRY_GREETER_CLIENT
```

## apps/examples/grpc_route_client/Kconfig
```kconfig
#
# For a description of the syntax of this configuration file,
# see kconfig-language at https://www.kernel.org/doc/Documentation/kbuild/kconfig-language.txt
#

config EXAMPLES_ROUTE_CLIENT
	bool "route client example"
	default n
	depends on GRPC
	---help---
		Enable the grpc client example

if EXAMPLES_ROUTE_CLIENT

config EXAMPLES_ROUTE_CLIENT_CXXINITIALIZE
	bool "C++ Initialization"
	default y
	depends on HAVE_CXX && HAVE_CXXINITIALIZE
	---help---
		By default, if CONFIG_HAVE_CXX and CONFIG_HAVE_CXXINITIALIZE are
		defined, then this example will call the TinyAra function to
		initialize static C++ constructors.  This option may be disabled,
		however, if that static initialization was preformed elsewhere.

endif

config USER_ENTRYPOINT
	string
	default "route_client_main" if ENTRY_ROUTE_CLIENT
```

## apps/examples/hansol/Kconfig
```kconfig
#
# For a description of the syntax of this configuration file,
# see kconfig-language at https://www.kernel.org/doc/Documentation/kbuild/kconfig-language.txt
#

config LHS_APP
	bool "hansolu"
	default n
	---help---
		Enable the \"hansolu\" example

config USER_ENTRYPOINT
	string
	default "hansolu_main" if LHS_APP
```

## apps/examples/heap_performance_test/Kconfig
```kconfig
#
# For a description of the syntax of this configuration file,
# see kconfig-language at https://www.kernel.org/doc/Documentation/kbuild/kconfig-language.txt
#

config EXAMPLES_HEAP_PERFORMANCE_TEST
	bool "Heap performance test"
	default n
	---help---
		Measure the elapsed time while simply repeating memory allocation and release.

config USER_ENTRYPOINT
	string
	default "heaptest_main" if ENTRY_HEAP_PERFORMANCE_TEST
```

## apps/examples/heap_stat_realtime/Kconfig
```kconfig
#
# For a description of the syntax of this configuration file,
# see kconfig-language at https://www.kernel.org/doc/Documentation/kbuild/kconfig-language.txt
#

config EXAMPLES_HEAP_STAT_REALTIME
	bool "Show the stat of heap for realtime support"
	default n
	depends on MM_REALTIME_SUPPORT
	---help---
		Show the stat of heap for realtime support,
		including the number of misses of memory allocation within a constant time.

config USER_ENTRYPOINT
	string
	default "heapstat_main" if ENTRY_HEAP_STAT_REALTIME
```

## apps/examples/heap_test/Kconfig
```kconfig
#
# For a description of the syntax of this configuration file,
# see kconfig-language at https://www.kernel.org/doc/Documentation/kbuild/kconfig-language.txt
#

config EXAMPLES_HEAPTEST
	bool "\"Heap Protection Test\" example"
	default n
	---help---
		Enable the \"Heap Protection Test\" example

if EXAMPLES_HEAPTEST

config EXAMPLES_HEAPTEST_PROGNAME
	string "Program name"
	default "heap_test"
	depends on BUILD_PROTECTED
	---help---
		Heap protection feature test example program

endif

config USER_ENTRYPOINT
	string
	default "heap_test_main" if ENTRY_HEAPTEST
```

## apps/examples/heavy_signal_message_test/Kconfig
```kconfig
#
# For a description of the syntax of this configuration file,
# see kconfig-language at https://www.kernel.org/doc/Documentation/kbuild/kconfig-language.txt
#

config EXAMPLES_HEAVY_SIGNAL_MESSAGE_TEST
	bool "Heavy Signal Message Test Sample"
	default n
	depends on !DISABLE_MQUEUE && !DISABLE_SIGNALS && !DISABLE_PTHREAD
	---help---
		Aging test in case of heavy signal/message scenarios. Check whether 
		signal and message work normally while many context switches occur.

config USER_ENTRYPOINT
	string
	default "heavy_signal_message_test_main" if ENTRY_HEAVY_SIGNAL_MESSAGE_TEST
```

## apps/examples/hello/Kconfig
```kconfig
#
# For a description of the syntax of this configuration file,
# see kconfig-language at https://www.kernel.org/doc/Documentation/kbuild/kconfig-language.txt
#

config EXAMPLES_HELLO
	bool "\"Hello, World!\" example"
	default n
	---help---
		Enable the \"Hello, World!\" example

config USER_ENTRYPOINT
	string
	default "hello_main" if ENTRY_HELLO
```

## apps/examples/hello_tash/Kconfig
```kconfig
#
# For a description of the syntax of this configuration file,
# see kconfig-language at https://www.kernel.org/doc/Documentation/kbuild/kconfig-language.txt
#

config EXAMPLES_HELLO_TASH
	bool "\"Hello, World!\" example in tash"
	default n
	depends on TASH
	---help---
		Enable the \"Hello, World!\" example in tash

if EXAMPLES_HELLO_TASH

config EXAMPLES_HELLO_TASH_PROGNAME
	string "Program name"
	default "hello_tash"
	depends on BUILD_KERNEL
	---help---
		This is the name of the program that will be use when the NSH ELF
		program is installed.

endif

config USER_ENTRYPOINT
	string
	default "hello_tash_main" if ENTRY_HELLO_TASH
```

## apps/examples/hello_tfmicro/Kconfig
```kconfig
#
# For a description of the syntax of this configuration file,
# see kconfig-language at https://www.kernel.org/doc/Documentation/kbuild/kconfig-language.txt
#

config EXAMPLES_HELLO_TFMICRO
	bool "\"Hello, Tensorflow Lite Micro!\" C++ example"
	default n
	depends on HAVE_CXX && EXTERNAL_TFMICRO
	---help---
		Enable the \"Hello, Tensorflow Lite Micro!\" C++ example

config USER_ENTRYPOINT
	string
	default "hello_tfmicro_main" if ENTRY_HELLO_TFMICRO
```

## apps/examples/helloxx/Kconfig
```kconfig
#
# For a description of the syntax of this configuration file,
# see kconfig-language at https://www.kernel.org/doc/Documentation/kbuild/kconfig-language.txt
#

config EXAMPLES_HELLOXX
	bool "\"Hello, World!\" C++ example"
	default n
	depends on HAVE_CXXINITIALIZE
	---help---
		Enable the \"Hello, World!\" C++ example

config USER_ENTRYPOINT
	string
	default "helloxx_main" if ENTRY_HELLOXX
```
