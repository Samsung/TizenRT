## apps/examples/i2schar/Kconfig
```kconfig
#
# For a description of the syntax of this configuration file,
# see kconfig-language at https://www.kernel.org/doc/Documentation/kbuild/kconfig-language.txt
#

config EXAMPLES_I2SCHAR
	bool "I2S character driver test"
	default n
	depends on I2S && AUDIO && AUDIO_DEVICES && AUDIO_I2SCHAR
	---help---
		Enable the I2S character driver test

if EXAMPLES_I2SCHAR

config EXAMPLES_I2SCHAR_DEVPATH
	string "I2S character device path"
	default "/dev/i2schar0"
	---help---
		The default path to the I2S character device. Default: /dev/i2schar0

config EXAMPLES_I2SCHAR_TX
	bool "Use I2S transmitter"
	default y
	---help---
		This should be set if the I2S device supports a transmitter.

if EXAMPLES_I2SCHAR_TX

config EXAMPLES_I2SCHAR_TXBUFFERS
	int "Number of TX buffers"
	default 4
	---help---
		This is the default number of audio buffers to send before the TX
		transfers terminate.  When both TX and RX transfers terminate, the
		task exits (and, if a builtin, the i2schar command returns).
		This number can be changed from the TASH command line.

config EXAMPLES_I2SCHAR_TXSTACKSIZE
	int "Transmitter thread stack size"
	default 1536
	---help---
		This is the stack size to use when starting the transmitter thread.

endif # EXAMPLES_I2SCHAR_TX

config EXAMPLES_I2SCHAR_RX
	bool "Use I2S receiver"
	default y
	---help---
		This should be set if the I2S device supports a receiver.

if EXAMPLES_I2SCHAR_RX

config EXAMPLES_I2SCHAR_RXBUFFERS
	int "Number of RX buffers"
	default 4
	---help---
		This is the default number of audio buffers to receive before the RX
		transfers terminate.  When both TX and RX transfers terminate, the
		task exits (and, if a builtin, the i2schar command returns).
		This number can be changed from the TASH command line.

config EXAMPLES_I2SCHAR_RXSTACKSIZE
	int "Receiver thread stack size"
	default 1536
	---help---
		This is the stack size to use when starting the receiver thread.

endif # EXAMPLES_I2SCHAR_RX

config EXAMPLES_I2SCHAR_BUFSIZE
	int "Audio payload size"
	default 8192
	---help---
		The size of the data payload in one audio buffer in bytes.  Applies
		to both TX and RX audio buffers.

config EXAMPLES_I2SCHAR_DEVINIT
	bool "Architecture-specific device initialization"
	default y
	depends on !BUILD_PROTECTED && !BUILD_KERNEL
	---help---
		Define if architecture-specific I2S device initialize is available.
		If defined, the the platform specific code must provide a function
		i2schar_devinit() that will be called each time that this test
		executes.  Not available in the kernel build mode.

endif
```

## apps/examples/iotbus_test/Kconfig
```kconfig
#
# For a description of the syntax of this configuration file,
# see kconfig-language at https://www.kernel.org/doc/Documentation/kbuild/kconfig-language.txt
#

config EXAMPLES_IOTBUS_TEST
	bool "Iotbus example"
	default n
	---help---
		Enable the Iotbus example example

if EXAMPLES_IOTBUS_TEST
config EXAMPLES_IOTBUS_TEST_RED_LED_GPIO_NUM
	int "GPIO number of RED LED"
	default 45

config EXAMPLES_IOTBUS_TEST_BLUE_LED_GPIO_NUM
	int "GPIO number of BLUE LED"
	default 49

config EXAMPLES_IOTBUS_TEST_LEFT_BUTTON_GPIO_NUM
	int "GPIO number of left button"
	default 42

config EXAMPLES_IOTBUS_TEST_RIGHT_BUTTON_GPIO_NUM
	int "GPIO number of right button"
	default 44
endif

config USER_ENTRYPOINT
	string
	default "iotbus_test_main" if ENTRY_IOTBUS_TEST
```

## apps/examples/iotivity/Kconfig
```kconfig
#
# For a description of the syntax of this configuration file,
# see kconfig-language at https://www.kernel.org/doc/Documentation/kbuild/kconfig-language.txt
#

config EXAMPLES_IOTIVITY
	bool "IOTIVITY demo"
	default n
	depends on ENABLE_IOTIVITY
	---help---
		Enable the IOTIVITY demo

config EXAMPLES_IOTIVITY_CLOUD
	bool "IOTIVITY cloud demo"
	default n
	depends on ENABLE_IOTIVITY_CLOUD
	---help---
		Enable the IOTIVITY cloud demo

config EXAMPLE_IOTIVITY_SECURED
	bool "IOTIVITY demo with security enabled"
	default n
	depends on ENABLE_IOTIVITY_SECURED
	---help---
		Enable the IOTIVITY demo with security

if EXAMPLES_IOTIVTIY

config EXAMPLES_IOTIVITY_PROGNAME
	string "Program name"
	default "iotivity"
	depends on BUILD_KERNEL
	---help---
		This is the name of the program that will be use when the TASH ELF
		program is installed.

config USER_ENTRYPOINT
	string
	default "iotivity_main" if ENTRY_IOTIVITY

endif

if EXAMPLES_IOTIVTIY_CLOUD

config EXAMPLES_IOTIVITY_PROGNAME
	string "Program name"
	default "iotivity_cloud"
	depends on BUILD_KERNEL
	---help---
		This is the name of the program that will be use when the TASH ELF
		program is installed.

config USER_ENTRYPOINT
	string
	default "iotivity_cloud_main" if ENTRY_IOTIVITY_CLOUD

endif

if EXAMPLES_IOTIVTIY_SECURED

config EXAMPLES_IOTIVITY_PROGNAME
	string "Program name"
	default "iotivity_sec"
	depends on BUILD_KERNEL
	---help---
		This is the name of the program that will be use when the TASH ELF
		program is installed.

config USER_ENTRYPOINT
	string
	default "iotivity_sec_main" if ENTRY_IOTIVITY_SECURED

endif

config TB_LOG
	bool "enable / disable iotivity stack logs"
	default n
	depends on ENABLE_IOTIVITY
	---help---
		select to enable all iotivity stack logs (DEBUG / INFO etc.)

config TCP_ADAPTER
	bool "enable / disable TCP_ADAPTER in iotivity stack"
	default n
	depends on ENABLE_IOTIVITY
	---help---
		select to enable TCP_ADAPTER in iotivity stack

config WITH_TCP
	bool "build iotivity stack with TCP enabled"
	default n
	depends on ENABLE_IOTIVITY
	---help---
		required to makeuse of TCP adapter (by libcoap module)

config WITH_DTLS
	bool "enable / disable iotivity secure data transmission"
	default n
	depends on ENABLE_IOTIVITY
	---help---
		select to enable DTLS security mechanism in Iotivity for data in transit

config WITH_SHA256
	bool "enable / disable SHA256 encryption in iotivity"
	default n
	depends on ENABLE_IOTIVITY
	---help---
		select to enable SHA256 mode of security in IoTivity

config WITH_X509
	bool "standard for a public key infrastructure (PKI) to manage digital certificates"
	default n
	depends on ENABLE_IOTIVITY
	---help---
		select to enable X509 standard for PKI in IoTivity
```

## apps/examples/iotivity_apps/Kconfig
```kconfig
#
# For a description of the syntax of this configuration file,
# see kconfig-language at https://www.kernel.org/doc/Documentation/kbuild/kconfig-language.txt
#

config EXAMPLES_IOTIVITY
	bool "Enable building IoTivity Samples"
	default n
	depends on ENABLE_IOTIVITY
	---help---
		Enable building IoTivity Samples
if EXAMPLES_IOTIVITY
choice
	prompt "IoTivity Examples"
	default EXAMPLES_IOTIVITY_CTT_LIGHT

config EXAMPLES_IOTIVITY_SIMPLESERVER
	bool "simpleServer"
	---help---
	"build in simpleServer application"

if ENABLE_IOTIVITY_SECURED
config EXAMPLES_IOTIVITY_SECURESERVER
	bool "secureServer"
	---help---
	"build in secureServer application"
endif

if ENABLE_IOTIVITY_CLOUD
config EXAMPLES_IOTIVITY_CLOUDSERVER
	bool "cloudServer"
	---help---
	"build in cloudServer application"
endif

endchoice
endif #EXAMPLES_IOTIVITY
```
