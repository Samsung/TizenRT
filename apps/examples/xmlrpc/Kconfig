## apps/examples/xmlrpc/Kconfig
```kconfig
#
# For a description of the syntax of this configuration file,
# see kconfig-language at https://www.kernel.org/doc/Documentation/kbuild/kconfig-language.txt
#

config EXAMPLES_XMLRPC
	bool "XML RPC example"
	depends on NETUTILS_XMLRPC
	default n
	---help---
		Enable the XML RPC example

config USER_ENTRYPOINT
	string
	default "xmlrpc_main" if ENTRY_XMLRPC
```

## apps/netutils/dhcpc/Kconfig
```kconfig
#
# For a description of the syntax of this configuration file,
# see kconfig-language at https://www.kernel.org/doc/Documentation/kbuild/kconfig-language.txt
#

config NETUTILS_DHCPC
	bool "DHCP client"
	default n
	# This depend will be added when Network Config implementation is finished
	---help---
		Enable support for the DHCP client.

if NETUTILS_DHCPC

config NETUTILS_DHCPC_CLIENTID
	bool "DHCP Client ID option field"
	default y
	---help---
		Enable Client ID(61) field in DHCP Discover and Request.
		Some DHCP server doesn't send response if this option does not exist.

config NETUTILS_DHCPC_RAND_XID
	bool "DHCP Client random XID"
	default y
	---help---
		Enable random XID(Transaction ID) for DHCP Message.
		It has to have unique random id for each DHCP transaction.

endif
```

## apps/netutils/er-coap/Kconfig
```kconfig
#
# For a description of the syntax of this configuration file,
# see kconfig-language at https://www.kernel.org/doc/Documentation/kbuild/kconfig-language.txt
#

config NETUTILS_ERCOAP
	bool "CoAP Library (er-coap-13)"
	default n
	depends on NET_IPv4
	---help---
		Enable support for er-coap library.

if NETUTILS_ERCOAP
config NETUTILS_ERCOAP_MAX_ATTEMPTS
	int "Maxmium number of failed request attempts"
	default 4
	depends on EXPERIMENTAL
	---help---
		Maximum number of failed request attempts before action

config NETUTILS_ERCOAP_MAX_HEADER_SIZE
	int "CoAP maximum header size"
	default 67
	---help---
		Default value
		= Hdr(4) + CoT(3) + Age(3) + Tag(1) + Etag(8)
			+ Obs(3) + Tok(1) + Token(8) + Blo(4) + Strings(30)

config NETUTILS_ERCOAP_SERVER_PORT
	int "CoAP server port"
	default 5683
	---help---
		Default port number used for server listening
endif
```

## apps/netutils/ftpc/Kconfig
```kconfig
#
# For a description of the syntax of this configuration file,
# see kconfig-language at https://www.kernel.org/doc/Documentation/kbuild/kconfig-language.txt
#

config NETUTILS_FTPC
	bool "FTP client"
	default n
	---help---
		Enable support for the FTP client.

if NETUTILS_FTPC

config DEBUG_FTPC
	bool "Debug FTP client"
	default n
	depends on DEBUG
	---help---
		Enable debug support for the FTP client.  This option simple forces
		CONFIG_DEBUG_NET to be on, but only for the files within this directory.

endif
```

## apps/netutils/ftpd/Kconfig
```kconfig
#
# For a description of the syntax of this configuration file,
# see kconfig-language at https://www.kernel.org/doc/Documentation/kbuild/kconfig-language.txt
#

config NETUTILS_FTPD
	bool "FTP server"
	default n
	---help---
		Enable support for the FTP server.

if NETUTILS_FTPD
endif
```

## apps/netutils/mdns/Kconfig
```kconfig
#
# For a description of the syntax of this configuration file,
# see kconfig-language at https://www.kernel.org/doc/Documentation/kbuild/kconfig-language.txt
#

config NETUTILS_MDNS
	bool "Multicast DNS"
	default n
	---help---
		Enable support for Multicast DNS

if NETUTILS_MDNS

config NETUTILS_MDNS_RESPONDER_SUPPORT
        bool "mDNS Responder"
        default n
	---help---
		Enable mDNS Responder

endif # NETUTILS_MDNS
```

## apps/netutils/ntpclient/Kconfig
```kconfig
#
# For a description of the syntax of this configuration file,
# see kconfig-language at https://www.kernel.org/doc/Documentation/kbuild/kconfig-language.txt
#

config NETUTILS_NTPCLIENT
	bool "NTP client"
	default n
	---help---
		Enable support for the minimal NTP client.

if NETUTILS_NTPCLIENT

config NETUTILS_NTPCLIENT_STACKSIZE
	int "NTP client daemon stack stack size"
	default 2048

config NETUTILS_NTPCLIENT_SERVERPRIO
	int "NTP client daemon priority"
	default 100

config NETUTILS_NTPCLIENT_SIGWAKEUP
	int "NTP client wakeup signal number"
	default 18
	depends on !DISABLE_SIGNALS

config NETUTILS_NTPCLIENT_DEBUG
	bool "NTP client debug message option"
	default n
	---help---
		Enable NTP client debug message

config NETUTILS_NTPCLIENT_SOCK_TIMEOUT
	int "NTP client socket timeout (seconds)"
	default 5

endif # NETUTILS_NTPCLIENT
```

## apps/netutils/webclient/Kconfig
```kconfig
#
# For a description of the syntax of this configuration file,
# see kconfig-language at https://www.kernel.org/doc/Documentation/kbuild/kconfig-language.txt
#

config NETUTILS_WEBCLIENT
	bool "Webclient"
	default n
	depends on NET
	---help---
		Enables the webclient.
		This webclient supports to send request by sync/async mode.
		Sync mode is excuted on same task with caller.
		Async mode is excuted on new task.

if NETUTILS_WEBCLIENT
	config WGET_USERAGENT
	string "User Agent"
	default "TinyARA"
	---help---
		Sets user agent. It apply to request message.

	config NETUTILS_WEBCLIENT_RX_TIMEOUT
	int "Webclient RX socket timeout (seconds)"
	default 5

endif
```

## apps/netutils/webserver/Kconfig
```kconfig
#
# For a description of the syntax of this configuration file,
# see kconfig-language at https://www.kernel.org/doc/Documentation/kbuild/kconfig-language.txt
#

config NETUTILS_WEBSERVER
	bool "TinyAra Webserver"
	default n
	---help---
		Enable TinyAra Webserver.

if NETUTILS_WEBSERVER
config NETUTILS_WEBSERVER_MULTICLIENT
	bool "Support Multi-clients connection"
	default y
	---help---
		Support Multi-clients connection

config NETUTILS_WEBSERVER_LOGD
	bool "Allow HTTP_LOGD definition"
	default n
	---help---
		Allow HTTP_LOGD definition

config NETUTILS_WEBSERVER_LOGE
	bool "Allow HTTP_LOGE definition"
	default n
	---help---
		Allow HTTP_LOGE definition
endif
```

## apps/netutils/websocket/Kconfig
```kconfig
#
# For a description of the syntax of this configuration file,
# see kconfig-language at https://www.kernel.org/doc/Documentation/kbuild/kconfig-language.txt
#

config NETUTILS_WEBSOCKET
	bool "Web socket"
	default n
	depends on NET_SECURITY_TLS
	---help---
		Enable support for the web socket.

if NETUTILS_WEBSOCKET

config NETUTILS_WEBSOCKET_RX_TIMEOUT
	int "Websocket RX socket timeout (seconds)"
	default 5

endif
```

## apps/netutils/wifi/Kconfig
```kconfig
#
# For a description of the syntax of this configuration file,
# see misc/tools/kconfig-language.txt.
#
menuconfig NETUTILS_WIFI
	bool "SLSI Wi-Fi API"
	default n
	select SCSC_WLAN
	select WPA_SUPPLICANT
	---help---
		Enable support for the SLSI WI-Fi Networking API.

if NETUTILS_WIFI
config SLSI_WIFI_DEFAULT_WLAN_COUNTRY_CODE
	string "Country code (2 chars)"
	default "00"
	---help---
		The country code to use for the board when starting the first time.
		The country code is a two char upper-case value, e.g. DK, KR, JP, US.
		Use "00" for multi-country international.

config SLSI_WIFI_DEFAULT_WLAN_TX_POWER
	int "TX power in dBm (12-30)"
	range 12 30
	default 30
	---help---
		The default tx power value in dBm to use for the board when starting the first time.
		The tx power value is in the range 0-30 and is of the type dBm.

config SLSI_WIFI_NO_AUTOCONNECT
	bool "Disable autoconnect feature of wpa_supplicant"
	default n
	---help---
		This prevents wpa_supplicant from performing autoconnection when disconnected
		unexpectedly in STA mode. Enable this options in case that user application wants
		to take control of re-association with an access point.

config SLSI_WIFI_FILESYSTEM_SUPPORT
	bool "Support filesystem"
	default n
	---help---
		The API can utilize the filesystem for configuration files and log files if needed.
		This is the default behavior but can be disabled on systems without filesystems.
		If filesystem support is disabled then functionality like auto-reconnect will not
		work as this uses the config file to store the relevant info across reboots.

if SLSI_WIFI_FILESYSTEM_SUPPORT
config SLSI_WIFI_DIR
	string "Path to where wifi can store the config files (ommit the trailing /)"
	default "/mnt/wifi"
	---help---
		The path where the wifi system can store the config and log files if needed.
		The path must be without the trailing /.

config SLSI_WIFI_LOG_FILE_NAME
	string "Name of the log file to use"
	default "slsiwifi.log"
	---help---
		The name of the file used to store logs from the wifi system.

config SLSI_WIFI_CONFIG_FILE_NAME
	string "name of the configuration file to use when in station/softAP mode"
	default "slsiwifi.conf"
	---help---
		The name of the file used to store information about the wifi system.
endif

menuconfig SLSI_WIFI_P2P_API
	bool "Support P2P (Wi-Fi Direct)"
	default n
	select SLSI_WLAN_P2P
	select WPA_SUPPLICANT_P2P
	---help---
		The API can support P2P (WiFi Direct) functionality.
		This requires that it is enabled in the lower layers as well.

if SLSI_WIFI_P2P_API
config SLSI_WIFI_P2P_POSTFIX
	string "The POSTFIX is used in WiFi Direct as postfix in (DIRECT-xy-POSTFIX-*) ssid"
	default "SLSI"
	---help---
		Possible to use for e.g. branding of device.
		This string will be set as postfix for the WiFi Direct ssid name.
		Example: if string is "SLSI" the WiFi Direct name will be: DIRECT-xy-SLSI-<mydevice>.
		The <mydevice> can optionally be set from API,
		if not set the last part of MAC address is added as <mydevice>.
		Notice that the string will have added "-" to start and end with if needed.

config SLSI_WIFI_P2P_LISTEN_CHANNEL
	int "Channel used for P2P listen (possible values 1/6/11)"
	default 6
	---help---
		The listen channel used for P2P. This setting can have one of the values 1/6/11.

config SLSI_WIFI_P2P_CONFIG_FILE_NAME
	string "name of the configuration file to use when in p2p mode"
	default "slsiwifip2p.conf"
	---help---
		The name of the file used to store information about the wifi system.
endif

endif
```

## apps/netutils/xmlrpc/Kconfig
```kconfig
#
# For a description of the syntax of this configuration file,
# see kconfig-language at https://www.kernel.org/doc/Documentation/kbuild/kconfig-language.txt
#

config NETUTILS_XMLRPC
	bool "XML RPC library"
	default n
	select NETUTILS_NETLIB
	---help---
		Enables the Embeddable Lightweight XML-RPC Server discussed at
		http://www.drdobbs.com/web-development/an-embeddable-lightweight-xml-rpc-server/184405364

if NETUTILS_XMLRPC

config XMLRPC_STRINGSIZE
	int "Maximum string length"
	default 64
	---help---
		Maximum string length for method names and XML RPC string values.

endif
```

## apps/platform/Kconfig
```kconfig
#
# For a description of the syntax of this configuration file,
# see kconfig-language at https://www.kernel.org/doc/Documentation/kbuild/kconfig-language.txt
#

menu "Platform-specific Support"
config PLATFORM_CONFIGDATA
	bool "Platform configuration data"
	default n
	---help---
		Set this option if the platform retention of configuration data.
		This storage mechanism is platform dependent and must be implemented
		in the platform specific directory under apps/platform/.  The
		storage mechanism is not visible to applications so underlying non-
		volatile storage can be used:  A file, EEPROM, hardcoded values in
		FLASH, etc.

source "$APPSDIR/platform/gnu/Kconfig"

endmenu
```

## apps/platform/gnu/Kconfig
```kconfig
#
# For a description of the syntax of this configuration file,
# see kconfig-language at https://www.kernel.org/doc/Documentation/kbuild/kconfig-language.txt
#

config HAVE_CXXINITIALIZE
	bool "Have C++ initialization"
	default n
	depends on HAVE_CXX
	---help---
		The platform-specific logic includes support for initialization
		of static C++ instances for this architecture and for the selected
		toolchain (via up_cxxinitialize()).
```

## apps/shell/Kconfig
```kconfig
#
# For a description of the syntax of this configuration file,
# see kconfig-language at https://www.kernel.org/doc/Documentation/kbuild/kconfig-language.txt
#

menu "Shell"
config TASH
	bool "Enable shell"
	default y
	depends on NFILE_DESCRIPTORS != 0

if TASH
config TASH_MAX_STORE_COMMANDS
	int "Max number of stored TASH commands"
	default 10
	---help---
		The maximum number of stored TASH commands.

config TASH_USLEEP
	bool "Enable 'usleep' command in TASH"
	default n
	depends on !DISABLE_SIGNALS
	---help---
		Enable 'usleep' command in TASH.

config TASH_REBOOT
	bool "Enable 'reboot' command in TASH"
	default n
	depends on BOARDCTL_RESET
	---help---
		Enable 'reboot' command in TASH.

config TASH_COMMAND_INTERFACE
	bool "enable command interface to TASH"
	default n
	---help---
		Enable to use TASH commands APIs

config TASH_CMDTASK_STACKSIZE
	int "TASH task stack size to run command with ASYNC type"
	default 4096 if !SYSTEM_VI
	default 16384 if SYSTEM_VI
	---help---
		The stack size allocated for TASH command task

config TASH_CMDTASK_PRIORITY
	int "TASH task priority to run command with ASYNC type"
	default 100
	---help---
		The priority set for TASH command task

config TASH_SCRIPT
	bool "enable shell script"
	default n
	depends on !DISABLE_ENVIRON
	---help---
		This suppors parsing and executing shell script.
		See "sh" on TASH help command.

config SECURED_TASH
	bool "Enable Secure shell"
	select NET_SECURITY_TLS
	select MBEDTLS_PKCS5_C
	default n

if SECURED_TASH

config TASH_PASSWORD_HASH
	string "PBKDF2 encrypted password (32 Bytes)"
	default "3D9740229177EBE6B11D0371342308881AE1463D1142E9FF932AB180AF4E8BD6"
	---help---
		Enable password to access TASH command line. The password is hashed by PBKDF2 so that
		the length of this config should be 32 bytes (64 characters).
		default : hash value of "tizenrt" (Password : tizenrt)

config TASH_SALT_ENCRYPTED
	string "AES encrypted salt (16 Bytes)"
	default "00112233445566778899AABBCCDDEEFF"
	---help---
		Enable salt value for TASH password encryption. The salt is encrypted by AES128 so that
		the length of this config should be 16 bytes (32 characters).
		default : encrypted value of "00112233445566778899AABBCCDDEEFF"
		Please encrypt this value with AES key and set this value.

config TASH_HASH_ITERATION
	int "Number of PBKDF2 iteration"
	default 777
	---help---
		The number of hash iteration used in PBKDF2.

endif

endif
endmenu
```

## apps/system/Kconfig
```kconfig
#
# For a description of the syntax of this configuration file,
# see kconfig-language at https://www.kernel.org/doc/Documentation/kbuild/kconfig-language.txt
#

menu "System Libraries"
menu "EMACS-like Command Line Editor"
source "$APPSDIR/system/cle/Kconfig"
endmenu

menu "CU Minimal Terminal"
source "$APPSDIR/system/cu/Kconfig"
endmenu

menu "FLASH Erase-all Command"
source "$APPSDIR/system/flash_eraseall/Kconfig"
endmenu

menu "FOTA HAL Application Library"
source "$APPSDIR/system/fota_hal/Kconfig"
endmenu

menu "I2C tool"
source "$APPSDIR/system/i2c/Kconfig"
endmenu

menu "INI File Parser"
source "$APPSDIR/system/inifile/Kconfig"
endmenu

menu "FLASH Program Installation"
source "$APPSDIR/system/install/Kconfig"
endmenu

menu "PHY Tool"
source "$APPSDIR/system/mdio/Kconfig"
endmenu

menu "System netdb Interface"
source "$APPSDIR/system/netdb/Kconfig"
endmenu

menu "Power Off"
source "$APPSDIR/system/poweroff/Kconfig"
endmenu

menu "P-Code Support"
source "$APPSDIR/system/prun/Kconfig"
endmenu

menu "RAM test"
source "$APPSDIR/system/ramtest/Kconfig"
endmenu

menu "RAMTRON"
source "$APPSDIR/system/ramtron/Kconfig"
endmenu

menu "readline()"
source "$APPSDIR/system/readline/Kconfig"
endmenu

menu "Sysinfo"
source "$APPSDIR/system/sysinfo/Kconfig"
endmenu

menu "Utils"
source "$APPSDIR/system/utils/Kconfig"
endmenu

menu "VI Work-Alike Editor"
source "$APPSDIR/system/vi/Kconfig"
endmenu
endmenu
```
