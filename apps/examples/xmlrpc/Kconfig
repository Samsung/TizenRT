## apps/system/adb/Kconfig
```kconfig
#
# For a description of the syntax of this configuration file,
# see kconfig-language at https://www.kernel.org/doc/Documentation/kbuild/kconfig-language.txt
#


config SYSTEM_ADB
	bool "ADB"
	default n
	---help---
		Enable support for the ADB.

if SYSTEM_ADB
config SYSTEM_ADB_DEBUG
	bool "Debug ADB"
	default n
	---help---
		Enable debug for the ADB.

config SYSTEM_ADB_SHELL_STACKSIZE
	int "ADB shell stack size"
	default 2048
	---help---
		ADB shell stack size

config SYSTEM_ADB_SHELL_PRIORITY
	int "ADB shell schedule priority"
	default 100
	---help---
		ADB shell priority

config SYSTEM_ADB_PORT
	int "ADB server port"
	default 5555
	---help---
		ADB server port number

endif
```

## apps/system/binary_update/Kconfig
```kconfig
#
# For a description of the syntax of this configuration file,
# see kconfig-language at https://www.kernel.org/doc/Documentation/kbuild/kconfig-language.txt
#
config BINARY_UPDATE
	bool "Enable Binary Update"
	default n
	depends on BINARY_MANAGER
```

## apps/system/cle/Kconfig
```kconfig
#
# For a description of the syntax of this configuration file,
# see kconfig-language at https://www.kernel.org/doc/Documentation/kbuild/kconfig-language.txt
#

config SYSTEM_CLE
	bool "EMACS-like Command Line Editor"
	default n
	depends on NFILE_STREAMS != 0
	---help---
		Enable support for TinyAra tiny EMACS-like command line editor.

		Omitted features:
			- No keypad cursor control support
			- No word oriented operations.

		Assumptions and Limitations:
			- A VT100 host terminal is assumed.
			- A fixed width character set (like Courier) is assumed

		Memory Usage:  Looks like 1.5-2KB

if SYSTEM_CLE

config SYSTEM_CLE_DEBUGLEVEL
	int "Debug level"
	default 0
	range 0 2
	---help---
		0=Debug off; 1=Print errors on console; 2=Print debug information
		on the console.

		Debug output is generated with syslog.  The editor works on
		/dev/console.  In order to get both a usable display and also
		readable debug output, syslog'ing should sent to some device other
		than /dev/console (which is the default).

endif # SYSTEM_CLE
```

## apps/system/cpucontrol/Kconfig
```kconfig
#
# For a description of the syntax of this configuration file,
# see kconfig-language at https://www.kernel.org/doc/Documentation/kbuild/kconfig-language.txt
#

config SYSTEM_CPUCONTROL
	bool "CPU Control commands"
	default n
	depends on SMP
	---help---
		Enable support for CPU control commands in TASH. This provides commands
		for managing CPU power management and status functionality on multi-core
		systems. Commands include cpu1on, cpu1off, cpustatus.
```

## apps/system/cu/Kconfig
```kconfig
#
# For a description of the syntax of this configuration file,
# see kconfig-language at https://www.kernel.org/doc/Documentation/kbuild/kconfig-language.txt
#

config SYSTEM_CUTERM
	bool "CU serial terminal"
	default n
	---help---
		Enable the CU serial terminal.  This is a minimalistic
		implementation of the 'cu' terminal program (part of Taylor UUCP for
		ages). Using it, you can simply open a serial port and interact with
		it. Using '~.' you can leave the terminal program and drop back to TASH.

		This terminal might come in handy for other people that have e.g. GS
		modems, GPS receivers or other devices with text based serial
		communications attached to their TinyAra systems.

if SYSTEM_CUTERM

config SYSTEM_CUTERM_DEFAULT_DEVICE
	string "Default serial device"
	default "/dev/ttyS0"
	---help---
		Normally, the serial device to be used is provided on the command line.
		If no device is provided then this is the default device that will be\
		used.

config SYSTEM_CUTERM_DEFAULT_BAUD
	int "Default serial baud"
	default 115200
	---help---
		Normally, the BAUD to be used is provided on the command line.  If no
		BAUD is provided then this is the default device that will be used.

config SYSTEM_CUTERM_STACKSIZE
	int "CU terminal stack size"
	default 2048
	---help---
		This is the stack size that will be used when starting the CU terminal.

config SYSTEM_CUTERM_PRIORITY
	int "CU terminal priority"
	default 100
	---help---
		This is the task priority that will be used when starting the CU terminal.

endif # SYSTEM_CUTERM
```

## apps/system/dat/Kconfig
```kconfig
#
# For a description of the syntax of this configuration file,
# see kconfig-language at https://www.kernel.org/doc/Documentation/kbuild/kconfig-language.txt
#

config SYSTEM_DEBUG_ANALYSER_TOOL
	bool "Debug Analyser Tool App"
	default n
	depends on TASH
	depends on DEBUG_SYSTEM
	depends on DRIVERS_OS_API_TEST
	---help---
		This application is an example program that retrieves the module's information
		at application level for various modules such such as applications, tcb, mpu
		using the "dat" command. This config enables the DAT application.
```

## apps/system/flash_eraseall/Kconfig
```kconfig
#
# For a description of the syntax of this configuration file,
# see kconfig-language at https://www.kernel.org/doc/Documentation/kbuild/kconfig-language.txt
#

config SYSTEM_FLASH_ERASEALL
	bool "FLASH eraseall tool"
	default n
	depends on MTD && BUILTIN_APPS && !BUILD_PROTECTED && !BUILD_KERNEL
	---help---
		Enable support for the FLASH eraseall tool.
```

## apps/system/fota_delta_engine/Kconfig
```kconfig
#
# For a description of the syntax of this configuration file,
# see kconfig-language at https://www.kernel.org/doc/Documentation/kbuild/kconfig-language.txt
#

config FOTA_DELTA_ENGINE
	bool "FOTA DELTA ENGINE"
	default n
	select LIBLZMA
	select ZLIB
	---help---
		Enable FOTA DELTA ENGINE

if FOTA_DELTA_ENGINE

config FOTA_DELTA_PACKETS
	bool "Get Delta packet-by-packet"
	default n
	---help---
		Get patch file packet-by-packet. Patch the old file
		block-by-block using delta obtained from each packet

if FOTA_DELTA_PACKETS

config FOTA_DOWNLOAD_PACKET_SIZE
	int "Size of Packets to be downloaded one-by-one"
	default 8192
	---help---
		Set size of packets of delta to be downloaded one-by-one
		for updating old file

endif

config BLOCKSIZE_FOR_FOTA_DELTA
	int "Blocksize for FOTA Delta b/w Uncompressed Binaries"
	default 8192
	range 512 8192
	---help---
		Enter blocksize to use for FOTA delta b/w 2 uncompressed
		binaries. In case of compressed binaries, blocksize used
		is read from their compression header and the value here
		is ignored.

endif
```
