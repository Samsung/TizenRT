## apps/examples/calib_udelay/Kconfig
```kconfig
#
# For a description of the syntax of this configuration file,
# see kconfig-language at https://www.kernel.org/doc/Documentation/kbuild/kconfig-language.txt
#

config EXAMPLES_CALIB_UDELAY
	bool "Calibration tool for udelay"
	default n
	depends on LIBC_FLOATINGPOINT
	---help---
		Calibration tool to determine CONFIG_BOARD_LOOPSPERMSEC for
		up_udelay() / up_mdelay(). Requires CONFIG_LIBM and
		CONFIG_LIBC_FLOATINGPOINT.
```

## apps/examples/net_selftest/Kconfig
```kconfig
#
# For a description of the syntax of this configuration file,
# see kconfig-language at https://www.kernel.org/doc/Documentation/kbuild/kconfig-language.txt
#

config EXAMPLES_NET_SELFTEST
	bool "Socket self test over the loopback and with a host"
	default n
	depends on NET_SOCKET && NET_TCP && NET_UDP && NET_LOOPBACK_INTERFACE
	---help---
		A self test of the socket layer: TCP and UDP over the loopback
		interface, select(), poll(), non-blocking sockets, dup(), close()
		of a socket that another thread is blocked on, and the sockets of
		a task that exits.  It also runs a TCP and UDP echo test with a
		host and a TCP echo server.
```

## os/arch/arm/src/mps/Kconfig
```kconfig
#
# For a description of the syntax of this configuration file,
# see kconfig-language at https://www.kernel.org/doc/Documentation/kbuild/kconfig-language.txt
#

if ARCH_CHIP_MPS

menu "MPS Chip Selection"

choice
	prompt "ARM MPS Configuration"
	default ARCH_CHIP_MPS3_AN547

config ARCH_CHIP_MPS2_AN386
	bool "MPS2 AN386 Processor Cortexm4"
	select ARCH_CORTEXM4
	select ARCH_HAVE_MPU
	select ARM_HAVE_MPU_UNIFIED
	select ARCH_HAVE_FPU
	select ARMV7M_HAVE_STACKCHECK

config ARCH_CHIP_MPS2_AN500
	bool "MPS2 AN500 Processor Cortexm7"
	select ARCH_CORTEXM7
	select ARCH_HAVE_MPU
	select ARM_HAVE_MPU_UNIFIED
	select ARCH_HAVE_FPU
	select ARMV7M_HAVE_STACKCHECK

config ARCH_CHIP_MPS2_AN521
	bool "MPS2 AN521 Processor Cortexm33"
	select ARCH_CORTEXM33
	select ARCH_HAVE_MPU
	select ARM_HAVE_MPU_UNIFIED

config ARCH_CHIP_MPS3_AN524
	bool "MPS3 AN524 Processor Cortexm33"
	select ARCH_CORTEXM33

config ARCH_CHIP_MPS3_AN547
	bool "MPS3 AN547 Processor Cortexm55"
	select ARCH_CORTEXM55
	select ARCH_HAVE_MPU
	select ARCH_HAVE_FPU
	select ARM_HAVE_MVE
	select ARCH_HAVE_TEXT_HEAP
	select ARCH_HAVE_DATA_HEAP

endchoice # ARM MPS Configuration

endmenu # MPS Chip Selection

config MPS_LAN9118
	bool "LAN9118 Ethernet controller of the MPS2 boards"
	default y
	depends on ARCH_CHIP_MPS2_AN500 || ARCH_CHIP_MPS2_AN521
	depends on NET_LWIP && NET_NETMGR && NET_ETHERNET
	depends on SCHED_HPWORK
	---help---
		The Ethernet controller of the MPS2 boards (a LAN9220, compatible
		with the LAN9118 that QEMU models) for lwIP and the network
		manager.  It is registered as the Ethernet interface eth0.

		Run QEMU with a network backend for the controller, for example:
		  -nic user,model=lan9118

endif # ARCH_CHIP_MPS
```

## os/libs/libc/machine/risc-v/Kconfig
```kconfig
#
# For a description of the syntax of this configuration file,
# see kconfig-language at https://www.kernel.org/doc/Documentation/kbuild/kconfig-language.txt
#

config RISCV_STRING_FUNCTION
	bool "Enable optimized RISC-V specific string function"
	default n
	depends on ARCH_TOOLCHAIN_GNU
	select RISCV_MEMCPY
	select RISCV_MEMSET
	select RISCV_STRCMP

config RISCV_MEMCPY
	bool "Enable optimized memcpy() for RISC-V"
	select LIBC_ARCH_MEMCPY
	depends on ARCH_TOOLCHAIN_GNU
	---help---
		Enable optimized RISC-V specific memcpy() library function

config RISCV_MEMSET
	bool "Enable optimized memset() for RISC-V"
	default n
	select LIBC_ARCH_MEMSET
	depends on ARCH_TOOLCHAIN_GNU
	---help---
		Enable optimized RISC-V specific memset() library function

config RISCV_STRCMP
	bool "Enable optimized strcmp() for RISC-V"
	default n
	select LIBC_ARCH_STRCMP
	depends on ARCH_TOOLCHAIN_GNU
	---help---
		Enable optimized RISC-V specific strcmp() library function
```
