## apps/examples/tls_client/Kconfig
```kconfig
#
# For a description of the syntax of this configuration file,
# see kconfig-language at https://www.kernel.org/doc/Documentation/kbuild/kconfig-language.txt
#

config EXAMPLES_TLS_CLIENT
	bool "TLS client application"
	default n
	depends on NET_SECURITY_TLS

if EXAMPLES_TLS_CLIENT

config EXAMPLES_TLS_CLIENT_PROGNAME
	string "Program name"
	default "tls_client"
	depends on BUILD_KERNEL

menu option
config EXAMPLES_TLS_ARTIK_KEY
	bool "use artik cloud key"
	default n
	depends on TLS_WITH_SSS
endmenu

endif # EXAMPLE_TLS_CLIENT

config USER_ENTRYPOINT
	string
	default "tls_client_main" if ENTRY_TLS_CLIENT
```

## apps/examples/tls_selftest/Kconfig
```kconfig
#
# For a description of the syntax of this configuration file,
# see kconfig-language at https://www.kernel.org/doc/Documentation/kbuild/kconfig-language.txt
#

config EXAMPLES_TLS_SELFTEST
	bool "TLS test application"
	default n

if EXAMPLES_TLS_SELFTEST

config EXAMPLES_TLS_SELFTEST_PROGNAME
	string "Program name"
	default "tls_selftest"
	depends on BUILD_KERNEL

endif # EXAMPLE_TLS_SELFTEST

config USER_ENTRYPOINT
	string
	default "tls_selftest_main" if ENTRY_TLS_SELFTEST
```

## apps/examples/tls_server/Kconfig
```kconfig
#
# For a description of the syntax of this configuration file,
# see kconfig-language at https://www.kernel.org/doc/Documentation/kbuild/kconfig-language.txt
#

config EXAMPLES_TLS_SERVER
	bool "TLS server application"
	default n
	depends on NET_SECURITY_TLS

if EXAMPLES_TLS_SERVER

config EXAMPLES_TLS_SERVER_PROGNAME
	string "Program name"
	default "tls_server"
	depends on BUILD_KERNEL

endif # EXAMPLE_TLS_SERVER

config USER_ENTRYPOINT
	string
	default "tls_server_main" if ENTRY_TLS_SERVER
```

## apps/examples/tm/Kconfig
```kconfig
#
# For a description of the syntax of this configuration file,
# see kconfig-language at https://www.kernel.org/doc/Documentation/kbuild/kconfig-language.txt
#

config APP_TM
	bool "\"tm\" Application"
	default n
	---help---
		Enable the \"tm\" Application

config USER_ENTRYPOINT
	string
	default "tm_main" if ENTRY_TM
```

## apps/examples/touch_visual_test/Kconfig
```kconfig
#
# For a description of the syntax of this configuration file,
# see kconfig-language at https://www.kernel.org/doc/Documentation/kbuild/kconfig-language.txt
#

config  EXAMPLES_TOUCH_VISUAL
	bool "Touch Visual Test"
	default n
	depends on TOUCH && TOUCH_POLL
	---help---
		Enable Touch visual test

config USER_ENTRYPOINT
	string
	default "touch_visual_test_main" if ENTRY_EXAMPLES_TOUCH_VISUAL

config TOUCH_HOLD_EVENT_SKIP
	int "Skip touch hold event"
	default 10
	depends on TOUCH && EXAMPLES_TOUCH_VISUAL
	---help---
		Skip continuous touch hold event for visual test. Default is 10 events.
```

## apps/examples/touchscreen/Kconfig
```kconfig
#
# For a description of the syntax of this configuration file,
# see kconfig-language at https://www.kernel.org/doc/Documentation/kbuild/kconfig-language.txt
#

config EXAMPLES_TOUCHSCREEN
	bool "touchscreen example"
	default n
	depends on TOUCH
	---help---
		Enable touchscreen example

config USER_ENTRYPOINT
	string
	default "touchscreen_main" if ENTRY_TOUCHSCREEN
```

## apps/examples/ttrace/Kconfig
```kconfig
#
# For a description of the syntax of this configuration file,
# see kconfig-language at https://www.kernel.org/doc/Documentation/kbuild/kconfig-language.txt
#

config EXAMPLES_TTRACE
	bool "T-trace example"
	default n
	depends on TTRACE
	---help---
		Enable the T-trace example

if EXAMPLES_TTRACE

config EXAMPLES_TTRACE_PROGNAME
	string "Program name"
	default "ttrace"
	depends on BUILD_KERNEL
	---help---
		This is the name of the program that will be use when the ttrace
		program is installed.

endif

config USER_ENTRYPOINT
	string
	default "ttrace_main" if ENTRY_TTRACE
```

## apps/examples/uart_hw_test/Kconfig
```kconfig
#
# For a description of the syntax of this configuration file,
# see kconfig-language at https://www.kernel.org/doc/Documentation/kbuild/kconfig-language.txt
#

config UART_HW_TEST
	bool "UART HW test application"
	default n
	select SYSTEM_IPERF
	---help---
		Enable UART HW test application
```

## apps/examples/uart_loopback/Kconfig
```kconfig
#
# For a description of the syntax of this configuration file,
# see kconfig-language at https://www.kernel.org/doc/Documentation/kbuild/kconfig-language.txt
#

config EXAMPLES_UART_LOOPBACK
	bool "UART loopback test application"
	default n
	---help---
		Enable UART loopback test application

config USER_ENTRYPOINT
	string
	default "uart_loopback_main" if ENTRY_UART_LOOPBACK

if EXAMPLES_UART_LOOPBACK

config EXAMPLES_UART_LOOPBACK_PORT
	int "UART loopback tty port "
	default 2
	---help---
		The EXAMPLES_UART_LOOPBACK_PORT sets test UART ttyS* port
		The default port is ttyS2

endif #EXAMPLES_UART_LOOPBACK
```

## apps/examples/uart_loopback_test/Kconfig
```kconfig
#
# For a description of the syntax of this configuration file,
# see kconfig-language at https://www.kernel.org/doc/Documentation/kbuild/kconfig-language.txt
#

config UART_LOOPBACK_TEST
	bool "UART loopback test application"
	default n
	---help---
		Enable UART loopback test application

if UART_LOOPBACK_TEST

config UART_LOOPBACK_PORT
	int "UART loopback tty port "
	default 2
	---help---
		The CONFIG_UART_LOOPBACK_PORT sets test UART ttyS* port
		The default port is ttyS2

endif #UART_LOOPBACK_TEST
```

## apps/examples/update_test/Kconfig
```kconfig
#
# For a description of the syntax of this configuration file,
# see kconfig-language at https://www.kernel.org/doc/Documentation/kbuild/kconfig-language.txt
#

config EXAMPLES_UPDATE_TEST
	bool "\"Update Test!\" example"
	default n
	---help---
		Enable the \"Update, Test!\" example

config USER_ENTRYPOINT
	string
	default "update_test_main" if ENTRY_UPDATE_TEST
```

## apps/examples/usb_mouse/Kconfig
```kconfig
#
# For a description of the syntax of this configuration file,
# see kconfig-language at https://www.kernel.org/doc/Documentation/kbuild/kconfig-language.txt
#

config EXAMPLES_USB_MOUSE
	bool "USB Host HID example"
	default n
	depends on USBHOST_HIDMOUSE
	---help---
		Enable the USB Host HID example

config USER_ENTRYPOINT
	string
	default "mouse_main" if ENTRY_USB_MOUSE
```

## apps/examples/virtkey/Kconfig
```kconfig
#
# For a description of the syntax of this configuration file,
# see kconfig-language at https://www.kernel.org/doc/Documentation/kbuild/kconfig-language.txt
#

config EXAMPLES_VIRTKEY
	bool "Virtual key example"
	default n
	---help---
		Enable virtual key example

config USER_ENTRYPOINT
	string
	default "virtkey_main" if ENTRY_VIRTKEY
```

## apps/examples/wakaama_client/Kconfig
```kconfig
#
# For a description of the syntax of this configuration file,
# see kconfig-language at https://www.kernel.org/doc/Documentation/kbuild/kconfig-language.txt
#

config EXAMPLES_WAKAAMA_CLIENT
	bool "WAKAAMA_CLIENT"
	default n
	depends on DM

if EXAMPLES_WAKAAMA_CLIENT

config EXAMPLES_WAKAAMA_CLIENT_PROGNAME
	string "Program name"
	default "wakaama_client"
	depends on BUILD_KERNEL

endif

config USER_ENTRYPOINT
	string
	default "wakaamaclient_main" if ENTRY_WAKAAMA_CLIENT
```

## apps/examples/wakerec/Kconfig
```kconfig
#
# For a description of the syntax of this configuration file,
# see kconfig-language at https://www.kernel.org/doc/Documentation/kbuild/kconfig-language.txt
#

config EXAMPLES_WAKEREC
	bool "wakeup, record and playback test code"
	default n
	depends on HAVE_CXX
	---help---
		Enable bixby wakeup test code

config USER_ENTRYPOINT
	string
	default "wakerec_main" if ENTRY_WAKEREC
```

## apps/examples/watchdog/Kconfig
```kconfig
#
# For a description of the syntax of this configuration file,
# see kconfig-language at https://www.kernel.org/doc/Documentation/kbuild/kconfig-language.txt
#

config EXAMPLES_WATCHDOG
	bool "\"Watchdog Timer\" example"
	default n
	depends on WATCHDOG
	---help---
		Enable the watchdog example command.
		The example supports expire, keepalive, status, stop, pause, resume,
		and pause_resume commands. expire optionally prints periodic
		status, keepalive sends WDIOC_KEEPALIVE, and pause_resume runs
		a parameterized pause/resume timing test.

config USER_ENTRYPOINT
	string
	default "watchdog_main" if ENTRY_WATCHDOG
```

## apps/examples/wave_gen/Kconfig
```kconfig
#
# For a description of the syntax of this configuration file,
# see kconfig-language at https://www.kernel.org/doc/Documentation/kbuild/kconfig-language.txt
#

config EXAMPLES_WAVE_GEN
	bool "Wave file generation application"
	default n
	depends on AUDIO
	---help---
```

## apps/examples/webclient/Kconfig
```kconfig
#
# For a description of the syntax of this configuration file,
# see kconfig-language at https://www.kernel.org/doc/Documentation/kbuild/kconfig-language.txt
#

config EXAMPLES_WEBCLIENT
	bool "Webclient example"
	depends on NETUTILS_WEBCLIENT
	default n
	---help---
		Enable the TinyAra Webclient example

config USER_ENTRYPOINT
	string
	default "webclient_main" if ENTRY_WEBCLIENT
```

## apps/examples/webserver/Kconfig
```kconfig
#
# For a description of the syntax of this configuration file,
# see kconfig-language at https://www.kernel.org/doc/Documentation/kbuild/kconfig-language.txt
#

config EXAMPLES_WEBSERVER
	bool "Webserver example"
	depends on NETUTILS_WEBSERVER
	default n
	---help---
		Enable the TinyAra Webserver example

config USER_ENTRYPOINT
	string
	default "webserver_main" if ENTRY_WEBSERVER
```

## apps/examples/webserver_test/Kconfig
```kconfig
#
# For a description of the syntax of this configuration file,
# see kconfig-language at https://www.kernel.org/doc/Documentation/kbuild/kconfig-language.txt
#

config EXAMPLES_WEBSERVER_TEST
	bool "Webserver test"
	depends on NETUTILS_WEBSERVER
	depends on NET_SECURITY_TLS
	default n
	---help---
		Enable the TizenRT Webserver test

config USER_ENTRYPOINT
	string
	default "webserver_test_main" if ENTRY_WEBSERVER_TEST
```

## apps/examples/websocket/Kconfig
```kconfig
#
# For a description of the syntax of this configuration file,
# see kconfig-language at https://www.kernel.org/doc/Documentation/kbuild/kconfig-language.txt
#

config EXAMPLES_WEBSOCKET
	bool "Websocket example"
	depends on NETUTILS_WEBSOCKET
	default n
	---help---
		Enable websocket client/server example

config USER_ENTRYPOINT
	string
	default "websocket_main" if ENTRY_WEBSOCKET
```

## apps/examples/wifi_manager/wm_test/Kconfig
```kconfig
#
# For a description of the syntax of this configuration file,
# see kconfig-language at https://www.kernel.org/doc/Documentation/kbuild/kconfig-language.txt
#

config EXAMPLES_WIFIMANAGER_TEST
	bool "Wi-Fi Manager Sample"
	default n
	depends on WIFI_MANAGER
	depends on NET_LWIP_DHCP
	select STRESS_TOOL
	---help---
		Wi-Fi Manager sample program

config USER_ENTRYPOINT
	string
	default "wm_test_main" if ENTRY_WIFIMANAGER_TEST


if EXAMPLES_WIFIMANAGER_TEST
config WIFIMANAGER_TEST_TRIAL
	int "Number of test trial"
	default 5
	---help---
		Number of test trial

config EXAMPLES_WIFIMANAGER_AP_LIST_ITEMS_COUNT
        int "Number of APs in input file"
        default 10
        ---help---
                Number of APs in input file

endif #if EXAMPLES_WIFIMANAGER_TEST
```

## apps/examples/wifi_manager_sample/Kconfig
```kconfig
#
# For a description of the syntax of this configuration file,
# see kconfig-language at https://www.kernel.org/doc/Documentation/kbuild/kconfig-language.txt
#

config EXAMPLES_WIFIMANAGER_TEST
	bool "Wi-Fi Manager Sample"
	default n
	depends on WIFI_MANAGER
	---help---
		Wi-Fi Manager sample program

config USER_ENTRYPOINT
	string
	default "wm_test_main" if ENTRY_WIFIMANAGER_TEST


if EXAMPLES_WIFIMANAGER_TEST
config EXAMPLES_WIFIMANAGER_STRESS_TOOL
	bool "Enable Sterss Tool for WiFi Manager"
	default n
	depends on STRESS_TOOL

if EXAMPLES_WIFIMANAGER_STRESS_TOOL
config WIFIMANAGER_TEST_TRIAL
	int "Number of test trial"
	default 5
	---help---
		Number of test trial

endif #if EXAMPLES_WIFIMANAGER_STRESS_TOOL
endif #if EXAMPLES_WIFIMANAGER_TEST
```

## apps/examples/wifi_test/Kconfig
```kconfig
#
# For a description of the syntax of this configuration file,
# see kconfig-language at https://www.kernel.org/doc/Documentation/kbuild/kconfig-language.txt
#

config EXAMPLES_WIFI_TEST
	bool "WIFI APIs example"
	default n
	---help---
		Enable the WIFI APIs example. This application features a set
		of DM API calls to start WiFi, connect to an Access Point,
		perform DHCP, as well as channel scanning.

config USER_ENTRYPOINT
	string
	default "wifi_test_main" if ENTRY_WIFI_TEST
```

## apps/examples/workqueue/Kconfig
```kconfig
#
# For a description of the syntax of this configuration file,
# see kconfig-language at https://www.kernel.org/doc/Documentation/kbuild/kconfig-language.txt
#

config EXAMPLES_WORKQUEUE
	bool "work queue example"
	default n
	depends on SCHED_WORKQUEUE || LIB_USRWORK
	---help---
		Enable the work queue example

if EXAMPLES_WORKQUEUE

config EXAMPLES_WORKQUEUE_PROGNAME
	string "Program name"
	default "workqueue"
	depends on BUILD_KERNEL
	---help---
		This is the name of the program

endif

config USER_ENTRYPOINT
	string
	default "workqueue_main" if ENTRY_WORKQUEUE
```
