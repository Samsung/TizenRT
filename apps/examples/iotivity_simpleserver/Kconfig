## apps/examples/iotivity_simpleserver/Kconfig
```kconfig
#
# For a description of the syntax of this configuration file,
# see kconfig-language at https://www.kernel.org/doc/Documentation/kbuild/kconfig-language.txt
#

config EXAMPLES_IOTIVITY
	bool "Enable building IoTivity Samples"
	default n
	depends on ENABLE_IOTIVITY
	---help---
		Enable building IoTivity Samples
```

## apps/examples/iotjs_startup/Kconfig
```kconfig
#
# For a description of the syntax of this configuration file,
# see kconfig-language at https://www.kernel.org/doc/Documentation/kbuild/kconfig-language.txt
#

config EXAMPLES_IOTJS_STARTUP
	bool "IoT.js StartUp example"
	default n
	select ENABLE_IOTJS
	---help---
		Enable the IoT.js StartUp example,
		that run a Javascript on start using IoT.js

if EXAMPLES_IOTJS_STARTUP

config EXAMPLES_IOTJS_STARTUP_PROGNAME
	string "Program name"
	default "iotjs_startup"
	depends on BUILD_KERNEL
	---help---
		This is the name of the program that will be use when the NSH ELF
		program is installed.

config EXAMPLES_IOTJS_STARTUP_JS_FILE
	string "Main javascript file"
	default "/rom/example/index.js"
	---help---
		This is the name of the javascript loaded by IoT.js runtime

config EXAMPLES_IOTJS_EXTRA_MODULE_PATH
	string "Directories used for external modules lookup"
	default "/rom/example/iotjs_modules"
	---help---
		This is the name of the javascript loaded by IoT.js runtime

config EXAMPLES_IOTJS_STARTUP_WIFI
	bool "Connect WiFi"
	select WIFI_MANAGER
	default n
	---help---
		Enable WiFi on start

config EXAMPLES_IOTJS_STARTUP_WIFI_SSID
	string "SSID of AP"
	default "public"
	depends on EXAMPLES_IOTJS_STARTUP_WIFI
	---help---
		Select SSID of AP which you want to connect to

config EXAMPLES_IOTJS_STARTUP_WIFI_PASS
	string "Passphrase of AP"
	default ""
	depends on EXAMPLES_IOTJS_STARTUP_WIFI
	---help---
		Passphrase of AP which you want to connect to

config EXAMPLES_IOTJS_STARTUP_WIFI_AUTH
	int "Authentication type"
	range 0 5
	default 0
	depends on EXAMPLES_IOTJS_STARTUP_WIFI
	---help---
		0 : Open
		1 : WEP Shared
		2 : WPA PSK
		3 : WPA2 PSK
		4 : WPA and WPA2 PSK
		5 : Unknown

config EXAMPLES_IOTJS_STARTUP_WIFI_CRYPTO
	int "Encryption type"
	range 0 5
	default 0
	depends on EXAMPLES_IOTJS_STARTUP_WIFI
	---help---
		0 : None
		1 : WEP 64 bits
		2 : WEP 128 bits
		3 : AES
		4 : TKIP
		5 : TIKP and AES
		6 : Unknown

endif # EXAMPLES_IOTJS_STARTUP

config USER_ENTRYPOINT
	string
	default "iotjs_startup_main" if ENTRY_IOTJS_STARTUP
```

## apps/examples/iperf/Kconfig
```kconfig
#
# For a description of the syntax of this configuration file,
# see kconfig-language at https://www.kernel.org/doc/Documentation/kbuild/kconfig-language.txt
#

config EXAMPLES_IPERF
	bool "iperf App"
	default n
  depends on NET_LWIP && NETUTILS_JSON && LIBC_FLOATINGPOINT
	---help---
		Enable the \"IPERF App\" example

if EXAMPLES_IPERF

config EXAMPLES_IPERF_PROGNAME
	string "Program name"
	default "iperf"
	depends on BUILD_KERNEL
	---help---
		This is the name of the program that will be use when the NSH ELF
		program is installed.

endif

config USER_ENTRYPOINT
	string
	default "iperf_main" if ENTRY_IPERF
```

## apps/examples/iperf2/Kconfig
```kconfig
#
# For a description of the syntax of this configuration file,
# see kconfig-language at https://www.kernel.org/doc/Documentation/kbuild/kconfig-language.txt
#

config EXAMPLES_IPERF2
	bool "iperf2""
	default n
	---help---
		Enable Iperf2

if EXAMPLES_IPERF2

config EXAMPLES_IPERF2_CXXINITIALIZE
	bool "C++ Initialization"
	default y
	depends on HAVE_CXX && HAVE_CXXINITIALIZE
	---help---
		By default, if CONFIG_HAVE_CXX and CONFIG_HAVE_CXXINITIALIZE are
		defined, then this example will call the TinyAra function to
		initialize static C++ constructors.  This option may be disabled,
		however, if that static initialization was preformed elsewhere.

endif

config USER_ENTRYPOINT
	string
	default "iperf2_main" if ENTRY_IPERF2
```

## apps/examples/kernel_update_test/Kconfig
```kconfig
#
# For a description of the syntax of this configuration file,
# see kconfig-language at https://www.kernel.org/doc/Documentation/kbuild/kconfig-language.txt
#

config EXAMPLES_KERNEL_UPDATE
	bool "\" kernel update test\" example"
	default n
	---help---
		Enable the \"kernel update test\" example

config USER_ENTRYPOINT
	string
	default "kernel_update_main" if ENTRY_KERNEL_UPDATE
```

## apps/examples/lcd_test/Kconfig
```kconfig
#
#For a description of the syntax of this configuration file,
#see kconfig-language at https:	//www.kernel.org/doc/Documentation/kbuild/kconfig-language.txt
#

config EXAMPLES_LCD
	bool "LCD example"
	default n
	---help---
		Enable LCD Example

if EXAMPLES_LCD
config EXAMPLE_LCD_FPS_TEST
	int "The Number of Frames Execution"
	default 5000
	---help---
		Enter number of frames to execute to test FPS
endif

config USER_ENTRYPOINT
	string
	default "lcd_test" if ENTRY_LCD
```

## apps/examples/led_test/Kconfig
```kconfig
#
#For a description of the syntax of this configuration file,
#see kconfig-language at https:	//www.kernel.org/doc/Documentation/kbuild/kconfig-language.txt
#

config EXAMPLES_LED
	bool "LED example"
	default n
	---help---
		Enable LED Example

if EXAMPLES_LED
config EXAMPLES_LED_PIN
	int "LED pin number"
	default 52
	---help---
		Defines LED pin number				
endif 

config USER_ENTRYPOINT
	string
	default "led_test" if ENTRY_LED
```

## apps/examples/libcoap_client/Kconfig
```kconfig
#
# For a description of the syntax of this configuration file,
# see kconfig-language at https://www.kernel.org/doc/Documentation/kbuild/kconfig-language.txt
#

config EXAMPLES_LIBCOAP_CLIENT_TEST
	bool "\"libcoap Client Test\" example"
	default n
	depends on NETUTILS_LIBCOAP
	---help---
		Enable the \"libcoap Client Test\" example
```

## apps/examples/libcoap_server/Kconfig
```kconfig
#
# For a description of the syntax of this configuration file,
# see kconfig-language at https://www.kernel.org/doc/Documentation/kbuild/kconfig-language.txt
#

config EXAMPLES_LIBCOAP_SERVER_TEST
	bool "\"libcoap Server Test\" example"
	default n
	depends on NETUTILS_LIBCOAP
	---help---
		Enable the \"libcoap Server Test\" example
```

## apps/examples/libcoap_test/Kconfig
```kconfig
#
# For a description of the syntax of this configuration file,
# see misc/tools/kconfig-language.txt.
#

config EXAMPLES_LIBCOAP_TEST
	bool "\"libcoap Test\" example"
	default n
	depends on NETUTILS_LIBCOAP
	---help---
		Enable the \"libcoap Test\" example
```

## apps/examples/libtuv/Kconfig
```kconfig
config EXAMPLES_LIBTUV
	bool "libtuv Example"
	select LIBTUV
	default n
	---help---
		Enable the libtuv Example
```

## apps/examples/log_dump/Kconfig
```kconfig
#
# For a description of the syntax of this configuration file,
# see kconfig-language at https://www.kernel.org/doc/Documentation/kbuild/kconfig-language.txt
#

config EXAMPLES_LOG_DUMP
	bool "Log dump example"
	default n
	depends on LOG_DUMP
	---help---
		Enable the Log dump example

config USER_ENTRYPOINT
	string
	default "log_dump_main" if ENTRY_LOG_DUMP
```

## apps/examples/lw_aifw_sine_test_app/Kconfig
```kconfig
#
# For a description of the syntax of this configuration file,
# see kconfig-language at https://www.kernel.org/doc/Documentation/kbuild/kconfig-language.txt
#

config EXAMPLES_LWAIFW_SINE_APP_TEST
	bool "LW AIFW Sine Model sample application"
	default n
	depends on LW_AIFW
	---help---
		LW AIFW Sine Model sample application

config USER_ENTRYPOINT
	string
	default "lw_aifw_sine_test_app_main" if ENTRY_LWAIFW_SINE_APP_TEST
```

## apps/examples/lwm2m_test/Kconfig
```kconfig
#
# For a description of the syntax of this configuration file,
# see kconfig-language at https://www.kernel.org/doc/Documentation/kbuild/kconfig-language.txt
#

config EXAMPLES_LWM2M_TEST
	bool "lwm2m test application"
	default n
	depends on !DM
	depends on LWM2M_CLIENT_MODE || LWM2M_SERVER_MODE

if EXAMPLES_LWM2M_TEST

choice
	prompt "lwm2m modes"

config EXAMPLES_LWM2M_CLIENT
	bool "lwm2m client mode"
	depends on LWM2M_CLIENT_MODE

config EXAMPLES_LWM2M_SERVER
	bool "lwm2m server mode"
	depends on LWM2M_SERVER_MODE

endchoice

endif # EXAMPLE_LWM2M_CLIENT

config USER_ENTRYPOINT
	string
	default "lwm2m_client_main" if ENTRY_LWM2M_CLIENT

config USER_ENTRYPOINT
	string
	default "lwm2m_server_main" if ENTRY_LWM2M_SERVER
```

## apps/examples/lwnl_sample/Kconfig
```kconfig
#
# For a description of the syntax of this configuration file,
# see kconfig-language at https://www.kernel.org/doc/Documentation/kbuild/kconfig-language.txt
#

config EXAMPLES_LWNL_SAMPLE
	bool "lwnl example"
	default n
	---help---
		Enable the lwnl example

config USER_ENTRYPOINT
	string
	default "lwnl_sample_main" if ENTRY_LWNL_SAMPLE
```

## apps/examples/mdns_test/Kconfig
```kconfig
#
# For a description of the syntax of this configuration file,
# see kconfig-language at https://www.kernel.org/doc/Documentation/kbuild/kconfig-language.txt
#

config EXAMPLES_MDNS_TEST
	bool "\"Multicast DNS Test\" example"
	default n
	depends on NETUTILS_MDNS
	---help---
		Enable the \"Multicast DNS Test\" example

config USER_ENTRYPOINT
	string
	default "mdns_main" if ENTRY_MDNS_TEST
```

## apps/examples/media_test/Kconfig
```kconfig
#
# For a description of the syntax of this configuration file,
# see kconfig-language at https://www.kernel.org/doc/Documentation/kbuild/kconfig-language.txt
#

config EXAMPLES_MEDIA_TEST
	bool "Media test example"
	depends on DM
	default n
	---help---
		Enable the Media example in tash

config USER_ENTRYPOINT
	string
	default "media_test_main" if ENTRY_MEDIA_TEST
```

## apps/examples/mediaplayer/Kconfig
```kconfig
#
# For a description of the syntax of this configuration file,
# see kconfig-language at https://www.kernel.org/doc/Documentation/kbuild/kconfig-language.txt
#

config EXAMPLES_MEDIAPLAYER
	bool "MediaPlayer example"
	default n
	depends on HAVE_CXX && HAVE_CXXINITIALIZE && MEDIA
	---help---
		Enable the MediaPlayer example

config USER_ENTRYPOINT
	string
	default "mediaplayer_main" if ENTRY_MEDIAPLAYER
```

## apps/examples/mediaplayer_tash/Kconfig
```kconfig
#
# For a description of the syntax of this configuration file,
# see kconfig-language at https://www.kernel.org/doc/Documentation/kbuild/kconfig-language.txt
#

config EXAMPLES_MEDIAPLAYER_TASH
	bool "\"MediaPlayer\" example in tash"
	default n
	depends on TASH
	---help---
		Enable the \"MediaPlayer\" example in tash

if EXAMPLES_MEDIAPLAYER_TASH

config EXAMPLES_MEDIAPLAYER_TASH_PROGNAME
	string "Program name"
	default "mediaplayer_tash"
	depends on BUILD_KERNEL
	---help---
		This is the name of the program that will be use when the NSH ELF
		program is installed.

endif

config USER_ENTRYPOINT
	string
	default "mediaplayer_tash_main" if ENTRY_MEDIAPLAYER_TASH
```

## apps/examples/mediarecorder/Kconfig
```kconfig
#
# For a description of the syntax of this configuration file,
# see kconfig-language at https://www.kernel.org/doc/Documentation/kbuild/kconfig-language.txt
#

config EXAMPLES_MEDIARECORDER
	bool "MediaRecorder example"
	default n
	depends on HAVE_CXX && HAVE_CXXINITIALIZE && MEDIA
	---help---
		Enable the MediaRecorder example

config USER_ENTRYPOINT
	string
	default "mediarecorder_main" if ENTRY_MEDIARECORDER
```

## apps/examples/mediastreamer/Kconfig
```kconfig
#
# For a description of the syntax of this configuration file,
# see kconfig-language at https://www.kernel.org/doc/Documentation/kbuild/kconfig-language.txt
#

config EXAMPLES_MEDIASTREAMER
	bool "MediaStreamer example"
	default n
	depends on HAVE_CXX && HAVE_CXXINITIALIZE && MEDIA && MEDIA_PLAYER && MEDIA_RECORDER
	select WIFI_MANAGER
	---help---
		Enable the MediaStreamer example

if EXAMPLES_MEDIASTREAMER
comment "Specify your AP which you want to connect to"

config EXAMPLES_MEDIASTREAMER_SSID
	string "SSID of AP"
	default "NULL"
	---help---
		Select SSID of AP which you want to connect to

config EXAMPLES_MEDIASTREAMER_PASSPHRASE
	string "Passphrase of AP"
	default "NULL"
	---help---
		Passphrase of AP which you want to connect to

config EXAMPLES_MEDIASTREAMER_AUTHENTICATION
	int "Authentication type"
	default 0
	---help---
		0 : Open
		1 : WEP Shared
		2 : WPA PSK
		3 : WPA2 PSK
		4 : WPA and WPA2 PSK
		5 : Unknown

config EXAMPLES_MEDIASTREAMER_CRYPTO
	int "Encryption type"
	default 0
	---help---
		0 : None
		1 : WEP 64 bits
		2 : WEP 128 bits
		3 : AES
		4 : TKIP
		5 : TIKP and AES
		6 : Unknown

endif # EXAMPLES_MEDIASTREAMER

config USER_ENTRYPOINT
	string
	default "mediastreamer_main" if ENTRY_MEDIASTREAMER
```

## apps/examples/mem_protect/Kconfig
```kconfig
#
# For a description of the syntax of this configuration file,
# see kconfig-language at https://www.kernel.org/doc/Documentation/kbuild/kconfig-language.txt
#

config EXAMPLES_MEM_PROTECT_TEST
	bool "MEM_PROTECT TestCase Example"
	depends on BUILD_PROTECTED
	select DRIVERS_OS_API_TEST
	---help---
		Enable the Memory protection TestCase Example

config USER_ENTRYPOINT
	string
	default "mem_protect_tc_main" if ENTRY_MEM_PROTECT_TEST
```

## apps/examples/memory_fragmentation_test/Kconfig
```kconfig
#
# For a description of the syntax of this configuration file,
# see kconfig-language at https://www.kernel.org/doc/Documentation/kbuild/kconfig-language.txt
#

config EXAMPLES_MEMORY_FRAGMENTATION_TEST
	bool "Example to intentionally fragment the heap memory"
	default n
	---help---
		Intentionally allocate/free small and large memory segments in a mixed-up manner.
		'heapinfo' with the config 'DEBUG_CHECK_FRAGMENTATION' shows how the heap is fragmented.

config USER_ENTRYPOINT
	string
	default "memfrag_main" if ENTRY_MEMORY_FRAGMENTATION_TEST
```

## apps/examples/messaging_sample/Kconfig
```kconfig
#
# For a description of the syntax of this configuration file,
# see kconfig-language at https://www.kernel.org/doc/Documentation/kbuild/kconfig-language.txt
#

config EXAMPLES_MESSAGING_SAMPLE
	bool "Messaging Framework sample"
	default n
	depends on MESSAGING_IPC
	---help---
		Enable the Messaging Framework sample

config USER_ENTRYPOINT
	string
	default "messaging_main" if ENTRY_MESSAGING_SAMPLE
```

## apps/examples/mmwave/Kconfig
```kconfig
#
#For a description of the syntax of this configuration file,
#see kconfig-language at https:	//www.kernel.org/doc/Documentation/kbuild/kconfig-language.txt
#

config EXAMPLES_MMWAVE
	bool "MMWAVE example"
	default n
	---help---
		Enable MMWAVE Example

config USER_ENTRYPOINT
	string
	default "mmwave_test" if ENTRY_MMWAVE
```
