/****************************************************************************
 *
 * Copyright 2017 Samsung Electronics All Rights Reserved.
 *
 * Licensed under the Apache License, Version 2.0 (the "License");
 * you may not use this file except in compliance with the License.
 * You may obtain a copy of the License at
 *
 * http://www.apache.org/licenses/LICENSE-2.0
 *
 * Unless required by applicable law or agreed to in writing,
 * software distributed under the License is distributed on an
 * "AS IS" BASIS, WITHOUT WARRANTIES OR CONDITIONS OF ANY KIND,
 * either express or implied. See the License for the specific
 * language governing permissions and limitations under the License.
 *
 ****************************************************************************/
/****************************************************************************
 * apps/examples/wave_gen/wave_gen_main.c
 *
 *   Copyright (C) 2013 Ken Pettit. All rights reserved.
 *   Author: Ken Pettit <pettitkd@gmail.com>
 *
 * Redistribution and use in source and binary forms, with or without
 * modification, are permitted provided that the following conditions
 * are met:
 *
 * 1. Redistributions of source code must retain the above copyright
 *    notice, this list of conditions and the following disclaimer.
 * 2. Redistributions in binary form must reproduce the above copyright
 *    notice, this list of conditions and the following disclaimer in
 *    the documentation and/or other materials provided with the
 *    distribution.
 * 3. Neither the name NuttX nor the names of its contributors may be
 *    used to endorse or promote products derived from this software
 *    without specific prior written permission.
 *
 * THIS SOFTWARE IS PROVIDED BY THE COPYRIGHT HOLDERS AND CONTRIBUTORS
 * "AS IS" AND ANY EXPRESS OR IMPLIED WARRANTIES, INCLUDING, BUT NOT
 * LIMITED TO, THE IMPLIED WARRANTIES OF MERCHANTABILITY AND FITNESS
 * FOR A PARTICULAR PURPOSE ARE DISCLAIMED. IN NO EVENT SHALL THE
 * COPYRIGHT OWNER OR CONTRIBUTORS BE LIABLE FOR ANY DIRECT, INDIRECT,
 * INCIDENTAL, SPECIAL, EXEMPLARY, OR CONSEQUENTIAL DAMAGES (INCLUDING,
 * BUT NOT LIMITED TO, PROCUREMENT OF SUBSTITUTE GOODS OR SERVICES; LOSS
 * OF USE, DATA, OR PROFITS; OR BUSINESS INTERRUPTION) HOWEVER CAUSED
 * AND ON ANY THEORY OF LIABILITY, WHETHER IN CONTRACT, STRICT
 * LIABILITY, OR TORT (INCLUDING NEGLIGENCE OR OTHERWISE) ARISING IN
 * ANY WAY OUT OF THE USE OF THIS SOFTWARE, EVEN IF ADVISED OF THE
 * POSSIBILITY OF SUCH DAMAGE.
 *
 ****************************************************************************/

/****************************************************************************
 * Included Files
 ****************************************************************************/

#include <tinyara/config.h>
#include <tinyara/audio/audio.h>

#include <sys/types.h>
#include <stdio.h>
#include <stdlib.h>
#include <string.h>
#include <unistd.h>
#include <errno.h>
#include <assert.h>

#include <fcntl.h>
#include <debug.h>

#include <apps/readline.h>

/****************************************************************************
 * Pre-processor Definitions
 ****************************************************************************/
#define SAMPLERATE	48000
#define BPSMPL		2
#define nCH		2
#define nSAMPLES	10240*10

#define BUFFSIZE (nSAMPLES * nCH * BPSMPL)
/****************************************************************************
 * Private Type Declarations
 ****************************************************************************/

/****************************************************************************
 * Private Function Prototypes
 ****************************************************************************/

/****************************************************************************
 * Private Data
 ****************************************************************************/
struct wav_header_s my_wav = {
	.hdr = {
		.chunkid = WAV_HDR_CHUNKID,
		.chunklen = 4 + sizeof(struct wav_formatchunk_s) + sizeof(struct wav_datachunk_s) + BUFFSIZE,
		.format = WAV_HDR_FORMAT,
	},
	.fmt = {
		.chunkid = WAV_FMT_CHUNKID,	/* Contains the letters "fmt " */
		.chunklen = WAV_FMT_CHUNKLEN,	/* Size of the following chunk (16 for PCM) */
		.format = 1,		/* PCM=1 (i.e. Linear quantization) */
		.nchannels = nCH,	/* Mono=1, Stereo=2 */
		.samprate = SAMPLERATE,	/* 8000, 44100, ... */
		.byterate = SAMPLERATE * nCH * BPSMPL,	/* samprate * nchannels * bpsamp / 8 */
		.align = nCH * BPSMPL,	/* nchannels * bpsamp / 8 */
		.bpsamp = BPSMPL * 8,	/* Bits per sample: 8 bits = 8, 16 bits = 16 */
	},
	.data = {
		.chunkid = WAV_DATA_CHUNKID,
		.chunklen = BUFFSIZE,
	},
};

unsigned short int lut_sin[1024];

/****************************************************************************
 * Private Functions
 ****************************************************************************/

/****************************************************************************
 * Public Functions
 ****************************************************************************/

#ifdef CONFIG_BUILD_KERNEL
int main(int argc, FAR char *argv[])
#else
int wave_gen_main(int argc, char *argv[])
#endif
{
	int nwritten;
	int fd;
	int i;
	short int sample[2];
	void *buff;
	int errcode;

	printf("HELLO!!! WAVE_GEN\n");

	fd = open("/mnt/1.wav", O_RDWR | O_CREAT | O_TRUNC);
	if (fd < 0) {
		errcode = errno;
		printf("failed to open file, %d \n", errcode);
		return -1;
	}

	nwritten = write(fd, &my_wav, sizeof(my_wav));
	if (nwritten < 0) {
		errcode = errno;
		printf("Header write failed: %d\n", errcode);
		close(fd);
		return errno;
	} else if (nwritten != sizeof(my_wav)) {
		printf("Header partial write: %d\n", nwritten);
		close(fd);
		return 0;
	}

	printf("Header is written \n");

	buff = malloc(1024);
	if (!buff) {
		printf("Alloc failed!!! \n");
		return -ENOMEM;
	}

	for (i = 0; i < nSAMPLES; i++) {
		sample[0] = (0x8000 - lut_sin[(i & 0x3F) << 4]) / 2;
		sample[1] = -(0x8000 - lut_sin[(i & 0x3F) << 4]) / 2;
		((unsigned int *)buff)[i & 0xFF] = *(unsigned int *)sample;
		if ((i & 0xff) == 0xff) {
			nwritten = write(fd, buff, (i & 0xFF) * 4);
			if (nwritten < 0) {
				goto err1;
			} else if (nwritten != (i & 0xFF) * 4) {
				goto err2;
			}

		}
	}

	if ((i & 0xff) != 0) {
		nwritten = write(fd, buff, (i & 0xFF) * 4);
		if (nwritten < 0) {
			goto err1;
		} else if (nwritten != (i & 0xFF) * 4) {
			goto err2;
		}

	}

	close(fd);
	free(buff);
	printf("File is generated \n");
	return OK;

err1:
	errcode = errno;
	printf("Sample %d write failed: %d\n", errcode, i);
	close(fd);
	free(buff);
	return errcode;

err2:
	printf("Sample %d partial write: %d\n", nwritten, i);
	close(fd);
	free(buff);
	return 0;

}

unsigned short int lut_sin[1024] = {
	0x0, 0x2, 0x5, 0x9, 0xe, 0x14, 0x1c, 0x25,
	0x2f, 0x3b, 0x47, 0x55, 0x64, 0x75, 0x86, 0x99,
	0xad, 0xc3, 0xd9, 0xf1, 0x10a, 0x124, 0x13f, 0x15c,
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	0x20, 0x18, 0x11, 0xb, 0x7, 0x3, 0x1, 0x0,
};
