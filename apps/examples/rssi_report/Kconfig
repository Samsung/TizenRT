## apps/examples/rssi_report/Kconfig
```kconfig
#
# For a description of the syntax of this configuration file,
# see kconfig-language at https://www.kernel.org/doc/Documentation/kbuild/kconfig-language.txt
#

config EXAMPLES_RSSI_REPORT
	bool "Sample App for reporting RSSI to server"
	default n
	---help---
		Enable the network test API's

config USER_ENTRYPOINT
	string
	default "rreport_main" if ENTRY_RSSI_REPORT
```

## apps/examples/rt_ocf_test/Kconfig
```kconfig
#
# For a description of the syntax of this configuration file,
# see kconfig-language at https://www.kernel.org/doc/Documentation/kbuild/kconfig-language.txt
#

config EXAMPLES_RTOCFTEST
	bool "\"RT-OCF sample\" example"
	default y
	depends on ENABLE_RT_OCF
	---help---
		Enable building a RT-OCF sample

if EXAMPLES_RTOCFTEST

config EXAMPLES_RTOCFTEST_PROGNAME
	string "Program name"
	default "rt_ocf_test"
	depends on BUILD_KERNEL
	---help---
		This is the name of the program that will be use when the NSH ELF
		program is installed.

endif

config USER_ENTRYPOINT
	string
	default "rt_ocf_test_main" if ENTRY_RTOCFTEST
```

## apps/examples/rtc/Kconfig
```kconfig
#
# For a description of the syntax of this configuration file,
# see kconfig-language at https://www.kernel.org/doc/Documentation/kbuild/kconfig-language.txt
#

config EXAMPLES_RTC
	bool "RTC Accuracy Test"
	default n
	depends on RTC
	depends on RTC_IOCTL
	---help---
		Enable the RTC Accuracy Test

if EXAMPLES_RTC

config EXAMPLES_RTC_ALARM
	bool "RTC alarm driver example"
	default n
	depends on RTC
	depends on RTC_IOCTL
	depends on RTC_ALARM
	---help---
		Enable the RTC driver alarm test

endif # EXAMPLES_RTC


if EXAMPLES_RTC_ALARM

config EXAMPLES_RTC_ALARM_PROGNAME
	string "Program name"
	default "rtc_alarm"
	---help---
		This is the name of the program that will be used when the NSH ELF
		program is installed.

config EXAMPLES_RTC_ALARM_PRIORITY
	int "Alarm task priority"
	default 100

config EXAMPLES_RTC_ALARM_STACKSIZE
	int "Alarm stack size"
	default 2048

config EXAMPLES_RTC_ALARM_DEVPATH
	string "RTC device path"
	default "/dev/rtc0"

config EXAMPLES_RTC_ALARM_SIGNO
	int "Alarm signal"
	default 1

endif # EXAMPLES_RTC_ALARM

config USER_ENTRYPOINT
	string
	default "rtc_main" if ENTRY_RTC
```

## apps/examples/security_api/Kconfig
```kconfig
#
# For a description of the syntax of this configuration file,
# see misc/tools/kconfig-language.txt.
#

config EXAMPLES_SECURITY_API_TC
	bool "Security API Test case"
	depends on TLS_WITH_SSS && SUPPORT_FULL_SECURITY && (ARCH_BOARD_ARTIK053S || ARCH_BOARD_ARTIK055S)
	default n

if EXAMPLES_SECURITY_API_TC

config EXAMPLES_SECURITY_API_PROGNAME
	string "Program name"
	default "security api selftest"
	depends on BUILD_KERNEL

endif # EXAMPLES_SECURITY_API_TC

config USER_ENTRYPOINT
	string
	default "security_api_tc_main" if ENTRY_SECURITY_API_TC
```

## apps/examples/security_sdk/Kconfig
```kconfig
#
# For a description of the syntax of this configuration file,
# see kconfig-language at https://www.kernel.org/doc/Documentation/kbuild/kconfig-language.txt
#

config EXAMPLES_SECURITY_SDK_TEST
	bool "Security SDK Test"
	depends on TLS_WITH_SSS && SUPPORT_FULL_SECURITY && ARTIK05X_SECURE && ARTIK_SDK
	default n

if EXAMPLES_SECURITY_SDK_TEST

config EXAMPLES_SECURITY_SDK_TEST_PROGNAME
	string "Program name"
	default "security sdk selftest"
	depends on BUILD_KERNEL

endif # EXAMPLES_SECURITY_SDK_TEST
```

## apps/examples/security_test/Kconfig
```kconfig
#
# For a description of the syntax of this configuration file,
# see kconfig-language at https://www.kernel.org/doc/Documentation/kbuild/kconfig-language.txt
#

source "$APPSDIR/examples/security_test/hal/Kconfig"
source "$APPSDIR/examples/security_test/security_api/Kconfig"
source "$APPSDIR/examples/security_test/see_api/Kconfig"
source "$APPSDIR/examples/security_test/mbedtls_self/Kconfig"
```

## apps/examples/security_test/hal/Kconfig
```kconfig
#
# For a description of the syntax of this configuration file,
# see kconfig-language at https://www.kernel.org/doc/Documentation/kbuild/kconfig-language.txt
#
config EXAMPLES_SECURITY_HAL_TEST
	bool "Security HAL Test"
	depends on BUILD_FLAT
	depends on SE
	select STRESS_TOOL
	default n

if EXAMPLES_SECURITY_HAL_TEST

config EXAMPLES_SECURITY_HAL_TEST_PROGNAME
	string "Program name"
	default "Security HAL selftest"
	depends on BUILD_KERNEL

endif # EXAMPLES_SECURITY_HAL_TEST

config USER_ENTRYPOINT
	string
	default "security_hal_test_main" if ENTRY_SECURITY_HAL_TEST
```

## apps/examples/security_test/mbedtls_self/Kconfig
```kconfig
#
# For a description of the syntax of this configuration file,
# see kconfig-language at https://www.kernel.org/doc/Documentation/kbuild/kconfig-language.txt
#
config EXAMPLES_MBEDTLS_SELF_TEST
	bool "Security MbedTLS Self Test"
	depends on NET_SECURITY_TLS
	default n

if EXAMPLES_MBEDTLS_SELF_TEST

config EXAMPLES_MBEDTLS_SELF_TEST_PROGNAME
	string "Program name"
	default "MbedTLS selftest"
	depends on BUILD_KERNEL

endif # EXAMPLES_MBEDTLS_SELF_TEST

config USER_ENTRYPOINT
	string
	default "mbedtls_self_main" if ENTRY_MBEDTLS_SELF_TEST
```

## apps/examples/security_test/seclink/Kconfig
```kconfig
#
# For a description of the syntax of this configuration file,
# see kconfig-language at https://www.kernel.org/doc/Documentation/kbuild/kconfig-language.txt
#
config EXAMPLES_SECLINK_TEST
	bool "Security SECLINK Test"
	depends on SE
	select STRESS_TOOL
	default n

config USER_ENTRYPOINT
	string
	default "sl_test_main" if ENTRY_SECLINK_TEST
```

## apps/examples/security_test/security_api/Kconfig
```kconfig
#
# For a description of the syntax of this configuration file,
# see kconfig-language at https://www.kernel.org/doc/Documentation/kbuild/kconfig-language.txt
#
config EXAMPLES_SECURITY_API_TEST
	bool "Security API Test"
	select STRESS_TOOL
	default n

if EXAMPLES_SECURITY_API_TEST

config EXAMPLES_SECURITY_API_TEST_PROGNAME
	string "Program name"
	default "Security API selftest"
	depends on BUILD_KERNEL

endif # EXAMPLES_SECURITY_API_TEST

config USER_ENTRYPOINT
	string
	default "security_hal_test_main" if ENTRY_SECURITY_API_TEST
```

## apps/examples/security_test/see_api/Kconfig
```kconfig
#
# For a description of the syntax of this configuration file,
# see kconfig-language at https://www.kernel.org/doc/Documentation/kbuild/kconfig-language.txt
#
config EXAMPLES_SECURITY_SEE_TEST
	bool "Security SEE API Test"
	depends on TLS_WITH_HW_ACCEL
	default n

if EXAMPLES_SECURITY_SEE_TEST

config EXAMPLES_SECURITY_SEE_TEST_PROGNAME
	string "Program name"
	default "Security SEE API selftest"
	depends on BUILD_KERNEL

endif # EXAMPLES_SECURITY_SEE_TEST

config USER_ENTRYPOINT
	string
	default "see_test_main" if ENTRY_SECURITY_SEE_TEST
```

## apps/examples/security_test/sltool/Kconfig
```kconfig
#
# For a description of the syntax of this configuration file,
# see kconfig-language at https://www.kernel.org/doc/Documentation/kbuild/kconfig-language.txt
#

config EXAMPLES_SECLINK_TOOL
	bool "seclink tool"
	default n
	---help---
		Enable the seclink tool

config USER_ENTRYPOINT
	string
	default "sltool_main" if ENTRY_SECLINK_TOOL
```

## apps/examples/select_test/Kconfig
```kconfig
#
# For a description of the syntax of this configuration file,
# see kconfig-language at https://www.kernel.org/doc/Documentation/kbuild/kconfig-language.txt
#

config EXAMPLES_SELECT_TEST
	bool "select_test"
	default n
	---help---
		Enable select test

if EXAMPLES_SELECT_TEST

config EXAMPLES_SELECT_TEST_PROGNAME
	string "Program name"
	default "select_test"
	depends on BUILD_KERNEL
	---help---
		This is the name of the program that will be use when the TASH ELF
		program is installed.

endif

config USER_ENTRYPOINT
	string
	default "select_test_main" if ENTRY_SELECT_TEST
```

## apps/examples/sensor_test/Kconfig
```kconfig
#
# For a description of the syntax of this configuration file,
# see kconfig-language at https://www.kernel.org/doc/Documentation/kbuild/kconfig-language.txt
#

config EXAMPLES_SENSOR
	bool "Sensor Test example"
	default n
	---help---
		Enable the Sensor Test example

config USER_ENTRYPOINT
        string
        default "sensor_test" if ENTRY_SENSOR
```

## apps/examples/sensorbd_demo/Kconfig
```kconfig
config EXAMPLES_SENSORBOARD
	bool "Sensor Board Example"
	select ANALOG
	select ADC
	select GPIO
	select SPI
	select SPI_EXCHANGE
	select SERIAL
	select I2C
	select I2C_USERIO
	select PWM
	select I2S
	select S5J_I2S
	select S5J_I2S_RX
	select S5J_I2S_TX_P
	select DMA
	select S5J_DMA
	select AUDIO_DEVICES
	select AUDIO_ALC5658CHAR
	default n
	---help---
		Enable the Sensor Board Example
```

## apps/examples/setjmp/Kconfig
```kconfig
#
# For a description of the syntax of this configuration file,
# see kconfig-language at https://www.kernel.org/doc/Documentation/kbuild/kconfig-language.txt
#

config EXAMPLES_SETJMP_TEST
	bool "setjmp/longjmp test"
	default n
	---help---
        setjmp/longjmp pair of functions facilitate execution context management in plain C.
        You can think of them as exception handling/coroutine facilitating mechanism.

        This option enables test application of this feature. In order to have it
         accessible out of the box, enable BUILTIN_APPS.
```

## apps/examples/simple_file_transfer/Kconfig
```kconfig
#
# For a description of the syntax of this configuration file,
# see kconfig-language at https://www.kernel.org/doc/Documentation/kbuild/kconfig-language.txt
#

config EXAMPLES_SIMPLE_FILE_TRANSFER
	bool "\"Simple File Transfer\" example"
	default n
	---help---
		Enable the \"Simple File Transfer!\" example

config USER_ENTRYPOINT
	string
	default "sft_main" if ENTRY_SIMPLE_FILE_TRANSFER
```

## apps/examples/slsiwifi/Kconfig
```kconfig
#
# For a description of the syntax of this configuration file,
# see kconfig-language at https://www.kernel.org/doc/Documentation/kbuild/kconfig-language.txt
#

config EXAMPLES_SLSIWIFI
	bool "S.LSI WIFI Control application"
	default n
	depends on NETUTILS_WIFI
	---help---
		Enable the Samsung LSI WiFi Control Application

if EXAMPLES_SLSIWIFI

config EXAMPLES_SLSIWIFI_PRIORITY
	int "wifi app task priority"
	default 50

config EXAMPLES_SLSIWIFI_STACKSIZE
	int "wifi app stack size"
	default 2048

endif
```

## apps/examples/smart/Kconfig
```kconfig
#
# For a description of the syntax of this configuration file,
# see kconfig-language at https://www.kernel.org/doc/Documentation/kbuild/kconfig-language.txt
#

config EXAMPLES_SMART
	bool "SMART file system example"
	default n
	---help---
		Enable the SMART file system example

if EXAMPLES_SMART

config EXAMPLES_SMART_ARCHINIT
	bool "Architecture-specific initialization"
	default n
	---help---
		The default is to use the RAM MTD device at drivers/mtd/rammtd.c.
		But an architecture-specific MTD driver can be used instead by
		defining EXAMPLES_SMART_ARCHINIT.  In this case, the
		initialization logic will call smart_archinitialize() to obtain
		the MTD driver instance.

config EXAMPLES_SMART_NEBLOCKS
	int "Number of erase blocks (simulated)"
	default 32
	depends on !EXAMPLES_SMART_ARCHINIT
	---help---
		When EXAMPLES_SMART_ARCHINIT is not defined, this test will use
		the RAM MTD device at drivers/mtd/rammtd.c to simulate FLASH.  In
		this case, this value must be provided to give the nubmer of erase
		blocks in MTD RAM device.

		The size of the allocated RAM drive will be:

			RAMMTD_ERASESIZE * EXAMPLES_SMART_NEBLOCKS

config EXAMPLES_SMART_MAXNAME
	int "Max name size"
	default 32
	range 1 255
	---help---
		Determines the maximum size of names used in the filesystem

config EXAMPLES_SMART_MAXFILE
	int "Max file size"
	default 8192
	---help---
		Determines the maximum size of a file

config EXAMPLES_SMART_MAXIO
	int "Max I/O"
	default 347

config EXAMPLES_SMART_MAXOPEN
	int "Max open files"
	default 512

config EXAMPLES_SMART_MOUNTPT
	string "SMART mountpoint"
	default "/mnt"

config EXAMPLES_SMART_NLOOPS
	int "Number of test loops"
	default 100

config EXAMPLES_SMART_VERBOSE
	bool "Verbose output"
	default n

endif
```

## apps/examples/smartfs/buffer_optimization/Kconfig
```kconfig
#
# For a description of the syntax of this configuration file,
# see kconfig-language at https://www.kernel.org/doc/Documentation/kbuild/kconfig-language.txt
#

config EXAMPLES_SMARTFS_BUF_OPTIMIZATION
	bool "jSmartFs Buffer Optimization Example"
	default n
	depends on TIMER
	---help---
		Enable the jSmartFs Buffer Optimization Example
```

## apps/examples/smartfs/fs_performance/Kconfig
```kconfig
#
# For a description of the syntax of this configuration file,
# see kconfig-language at https://www.kernel.org/doc/Documentation/kbuild/kconfig-language.txt
#

config EXAMPLES_FS_PERFORMANCE
	bool "\"Filesystem Performance Test\" example"
	default n
	depends on TIMER
	---help---
		Enable the \"Filesystem Performance Test\" example

config USER_ENTRYPOINT
	string
	default "fs_performance_main" if ENTRY_FS_PERFORMANCE
```

## apps/examples/smartfs/read_optimization/Kconfig
```kconfig
#
# For a description of the syntax of this configuration file,
# see kconfig-language at https://www.kernel.org/doc/Documentation/kbuild/kconfig-language.txt
#

config EXAMPLES_SMARTFS_READ_OPTIMIZATION
	bool "SmartFs Read Optimization Example"
	default n
	---help---
		Enable the SmartFs Read Optimization Example
```

## apps/examples/smartfs/smart_test/Kconfig
```kconfig
#
# For a description of the syntax of this configuration file,
# see kconfig-language at https://www.kernel.org/doc/Documentation/kbuild/kconfig-language.txt
#

config EXAMPLES_SMART_TEST
	bool "SMART filesystem test tool"
	default n
	---help---
		Performs a file-based test on a SMART (or any) filesystem. Validates
		seek, append and seek-with-write operations.  This test can be built
		only as an TASH command
```

## apps/examples/smartfs/smartfs_powercut/Kconfig
```kconfig
#
# For a description of the syntax of this configuration file,
# see kconfig-language at https://www.kernel.org/doc/Documentation/kbuild/kconfig-language.txt
#

config EXAMPLES_SMARTFS_POWERCUT
	bool "\"jSmartFs Powercut Test\" example"
	default n
	---help---
		Enable the \"jSmartFs Powercut Test\" example

config USER_ENTRYPOINT
	string
	default "smartfs_powercut_main" if ENTRY_SMARTFS_POWERCUT
```
