## apps/Kconfig
```kconfig
#
# For a description of the syntax of this configuration file,
# see kconfig-language at https://www.kernel.org/doc/Documentation/kbuild/kconfig-language.txt
#

menu "Examples"
source "$APPSDIR/examples/Kconfig"
endmenu

menu "Network Utilities"
source "$APPSDIR/netutils/Kconfig"
endmenu

menu "Platform-specific Support"
source "$APPSDIR/platform/Kconfig"
endmenu

menu "Enable Shell"
source "$APPSDIR/shell/Kconfig"
endmenu

menu "System Libraries"
source "$APPSDIR/system/Kconfig"
endmenu
```

## apps/apps_entry/Kconfig
```kconfig
#
# For a description of the syntax of this configuration file,
# see kconfig-language at https://www.kernel.org/doc/Documentation/kbuild/kconfig-language.txt
#

if INIT_ENTRYPOINT
comment "Application entry point list"
choice
	prompt "Application entry point"
config ENTRY_MANUAL
	bool "Set entry point manually"
	---help---
		If you select this, you should add a function name as an application entry point
		at "Entry point function name".

source "$APPSDIR/Kconfig_ENTRY"
endchoice

config USER_ENTRYPOINT
	string "Entry point function name" if ENTRY_MANUAL
	---help---
		The name of the entry point for user applications.
endif # INIT_ENTRYPOINT
```

## apps/builtin/Kconfig
```kconfig
#
# For a description of the syntax of this configuration file,
# see kconfig-language at https://www.kernel.org/doc/Documentation/kbuild/kconfig-language.txt
#
config BUILTIN_APPS
	bool "Support builtin applications"
	default y
	---help---
		If this configuration is enabled (is set to y), enabled applications are registered
		at TASH automatically.
```

## apps/examples/Kconfig
```kconfig
#
# For a description of the syntax of this configuration file,
# see kconfig-language at https://www.kernel.org/doc/Documentation/kbuild/kconfig-language.txt
#

menu "Examples"
if INIT_ENTRYPOINT
choice
	prompt "Application entry point"

config ENTRY_MANUAL
	bool "manual entry"

source "$APPSDIR/examples/artik_demo/Kconfig_ENTRY"
source "$APPSDIR/examples/dnsclient_test/Kconfig_ENTRY"
source "$APPSDIR/examples/dtls_client/Kconfig_ENTRY"
source "$APPSDIR/examples/dtls_server/Kconfig_ENTRY"
source "$APPSDIR/examples/fota_sample/Kconfig_ENTRY"
source "$APPSDIR/examples/hello/Kconfig_ENTRY"
source "$APPSDIR/examples/hello_tash/Kconfig_ENTRY"
source "$APPSDIR/examples/helloxx/Kconfig_ENTRY"
source "$APPSDIR/examples/iperf/Kconfig_ENTRY"
source "$APPSDIR/examples/kernel_sample/Kconfig_ENTRY"
source "$APPSDIR/examples/mdns_test/Kconfig_ENTRY"
source "$APPSDIR/examples/mpu/Kconfig_ENTRY"
source "$APPSDIR/examples/nettest/Kconfig_ENTRY"
source "$APPSDIR/examples/ntpclient_test/Kconfig_ENTRY"
source "$APPSDIR/examples/proc_test/Kconfig_ENTRY"
source "$APPSDIR/examples/select_test/Kconfig_ENTRY"
source "$APPSDIR/examples/sysio_test/Kconfig_ENTRY"
source "$APPSDIR/examples/telnetd/Kconfig_ENTRY"
source "$APPSDIR/examples/testcase/Kconfig_ENTRY"
source "$APPSDIR/examples/tls_client/Kconfig_ENTRY"
source "$APPSDIR/examples/tls_selftest/Kconfig_ENTRY"
source "$APPSDIR/examples/tls_server/Kconfig_ENTRY"
source "$APPSDIR/examples/wakaama_client/Kconfig_ENTRY"
source "$APPSDIR/examples/webclient/Kconfig_ENTRY"
source "$APPSDIR/examples/webserver/Kconfig_ENTRY"
source "$APPSDIR/examples/websocket/Kconfig_ENTRY"
source "$APPSDIR/examples/workqueue/Kconfig_ENTRY"

endchoice

config USER_ENTRYPOINT
	string "Application entry point" if ENTRY_MANUAL
	---help---
		The name of the entry point for user applications.

endif # INIT_ENTRYPOINT

source "$APPSDIR/examples/dnsclient_test/Kconfig"
source "$APPSDIR/examples/dtls_client/Kconfig"
source "$APPSDIR/examples/dtls_server/Kconfig"
source "$APPSDIR/examples/fota_sample/Kconfig"
source "$APPSDIR/examples/hello/Kconfig"
source "$APPSDIR/examples/hello_tash/Kconfig"
source "$APPSDIR/examples/helloxx/Kconfig"
source "$APPSDIR/examples/iperf/Kconfig"
source "$APPSDIR/examples/kernel_sample/Kconfig"
source "$APPSDIR/examples/mdns_test/Kconfig"
source "$APPSDIR/examples/mpu/Kconfig"
source "$APPSDIR/examples/nettest/Kconfig"
source "$APPSDIR/examples/ntpclient_test/Kconfig"
source "$APPSDIR/examples/slsiwifi/Kconfig"
source "$APPSDIR/examples/proc_test/Kconfig"
source "$APPSDIR/examples/select_test/Kconfig"
source "$APPSDIR/examples/sysio_test/Kconfig"
source "$APPSDIR/examples/telnetd/Kconfig"
source "$APPSDIR/examples/testcase/Kconfig"
source "$APPSDIR/examples/tls_client/Kconfig"
source "$APPSDIR/examples/tls_selftest/Kconfig"
source "$APPSDIR/examples/tls_server/Kconfig"
source "$APPSDIR/examples/wakaama_client/Kconfig"
source "$APPSDIR/examples/webclient/Kconfig"
source "$APPSDIR/examples/webserver/Kconfig"
source "$APPSDIR/examples/websocket/Kconfig"
source "$APPSDIR/examples/workqueue/Kconfig"
source "$APPSDIR/examples/artik_demo/Kconfig"
source "$APPSDIR/examples/slsiwifi/Kconfig"
source "$APPSDIR/examples/mqtt_test/Kconfig"
source "$APPSDIR/examples/eeprom_test/Kconfig"
source "$APPSDIR/examples/sensorbd_demo/Kconfig"
endmenu
```

## apps/examples/SoundPlayer/Kconfig
```kconfig
#
# For a description of the syntax of this configuration file,
# see kconfig-language at https://www.kernel.org/doc/Documentation/kbuild/kconfig-language.txt
#

menu "SoundPlayer App"
source "/root/tizenrt/apps/examples/SoundPlayer/controller/Kconfig"
source "/root/tizenrt/apps/examples/SoundPlayer/player/Kconfig"
endmenu
```

## apps/examples/SoundPlayer/controller/Kconfig
```kconfig
#
# For a description of the syntax of this configuration file,
# see kconfig-language at https://www.kernel.org/doc/Documentation/kbuild/kconfig-language.txt
#

config EXAMPLES_PLAYERCONTROLLER
	bool "Media Player Controller"
	default n
	depends on HAVE_CXX
	---help---
		Enable Media Player Controller application

config USER_ENTRYPOINT
	string
	default "playercontroller_main" if ENTRY_PLAYERCONTROLLER
```

## apps/examples/SoundPlayer/player/Kconfig
```kconfig
#
# For a description of the syntax of this configuration file,
# see kconfig-language at https://www.kernel.org/doc/Documentation/kbuild/kconfig-language.txt
#

config EXAMPLES_SOUNDPLAYER
	bool "Sound Player"
	default n
	depends on HAVE_CXX
	select EXAMPLES_PLAYERCONTROLLER
	---help---
		Enable Sound Player application

config USER_ENTRYPOINT
	string
	default "soundplayer_main" if ENTRY_SOUNDPLAYER
```

## apps/examples/adam_test/Kconfig
```kconfig
#
# For a description of the syntax of this configuration file,
# see kconfig-language at https://www.kernel.org/doc/Documentation/kbuild/kconfig-language.txt
#

config EXAMPLES_ADAM
	bool "\"ADAM TEST\" example"
	default n
	---help---
		Enable the \"ADAM TEST\" example

config USER_ENTRYPOINT
	string
	default "adam_main" if ENTRY_HELLO
```

## apps/examples/aifw_test/Kconfig
```kconfig
#
# For a description of the syntax of this configuration file,
# see kconfig-language at https://www.kernel.org/doc/Documentation/kbuild/kconfig-language.txt
#

config EXAMPLES_AIFW_TEST
	bool "AIFW test application"
	default n
	depends on AIFW
	---help---
		AIFW test application

if EXAMPLES_AIFW_TEST
config PRODUCT_AI_MODEL_FILE_SUPPORT
	bool "Support file based AI Model"
	default y
	---help---
		Support file based AI Model
endif

config USER_ENTRYPOINT
	string
	default "aifw_test_main" if ENTRY_AIFW_TEST
```

## apps/examples/alarm/Kconfig
```kconfig
#
# For a description of the syntax of this configuration file,
# see kconfig-language at https://www.kernel.org/doc/Documentation/kbuild/kconfig-language.txt
#

config EXAMPLES_ALARM
	bool "RTC alarm driver example"
	default n
	depends on RTC_DRIVER && RTC_ALARM
	---help---
		Enable the RTC driver alarm test

if EXAMPLES_ALARM

config EXAMPLES_ALARM_PROGNAME
	string "Program name"
	default "alarm"
	depends on BUILD_KERNEL
	---help---
		This is the name of the program that will be use when the TASH ELF
		program is installed.

config EXAMPLES_ALARM_PRIORITY
	int "Alarm task priority"
	default 100

config EXAMPLES_ALARM_STACKSIZE
	int "Alarm stack size"
	default 2048

config EXAMPLES_ALARM_DEVPATH
	string "RTC device path"
	default "/dev/rtc0"

config EXAMPLES_ALARM_SIGNO
	int "Alarm signal"
	default 1

endif # EXAMPLES_ALARM
```

## apps/examples/alc5658char_test/Kconfig
```kconfig
#
# For a description of the syntax of this configuration file,
# see kconfig-language at https://www.kernel.org/doc/Documentation/kbuild/kconfig-language.txt
#

config EXAMPLES_ALC5658CHAR_TEST
	bool "ALC5658 Character Codec reference application"
	default n
	depends on AUDIO_ALC5658CHAR
	---help---
```

## apps/examples/appfw_test/Kconfig
```kconfig
#
# For a description of the syntax of this configuration file,
# see kconfig-language at https://www.kernel.org/doc/Documentation/kbuild/kconfig-language.txt
#

config EXAMPLES_APPFW_TEST
	bool "App Framework Test Example"
	default n
	depends on APP
	---help---
		Enable the App Framework Test Example

config USER_ENTRYPOINT
	string
	default "appfw_test_main" if ENTRY_APPFW_TEST
```

## apps/examples/araui_sample/Kconfig
```kconfig
#
# For a description of the syntax of this configuration file,
# see kconfig-language at https://www.kernel.org/doc/Documentation/kbuild/kconfig-language.txt
#

config EXAMPLES_ARAUI_SAMPLE
	bool "AraUI Sample"
	default n
	depends on UI
	---help---
		Enable the AraUI Sample

config USER_ENTRYPOINT
	string
	default "araui_sample_main" if EXAMPLES_ARAUI_SAMPLE
```

## apps/examples/artik_examples/Kconfig
```kconfig
#
# For a description of the syntax of this configuration file,
# see kconfig-language at https://www.kernel.org/doc/Documentation/kbuild/kconfig-language.txt
#
menuconfig EXAMPLES_ARTIK_SDK
	bool "ARTIK SDK examples"
	default n
	depends on ARTIK_SDK
if EXAMPLES_ARTIK_SDK
	config EXAMPLES_ARTIK_ADC
		bool "ARTIK ADC example"
	config EXAMPLES_ARTIK_CLOUD
		bool "ARTIK Cloud example"
	config EXAMPLES_ARTIK_GPIO
		bool "ARTIK GPIO example"
	config EXAMPLES_ARTIK_HTTP
		bool "ARTIK HTTP example"
	config EXAMPLES_ARTIK_MODULE
		bool "ARTIK Module example"
	config EXAMPLES_ARTIK_PWM
		bool "ARTIK PWM example"
	config EXAMPLES_ARTIK_SECURITY
		bool "ARTIK Security example"
	config EXAMPLES_ARTIK_WEBSOCKET
		bool "ARTIK Websocket example"
	config EXAMPLES_ARTIK_WIFI
		bool "ARTIK WiFi example"
	config EXAMPLES_ARTIK_MQTT
		bool "ARTIK MQTT example"
endif

config USER_ENTRYPOINT
	string
	default "artik_cloud_main" if ENTRY_ARTIK_EXAMPLES && EXAMPLES_ARTIK_CLOUD
	default "artik_http_main" if ENTRY_ARTIK_EXAMPLES && EXAMPLES_ARTIK_HTTP
	default "artik_websocket_main" if ENTRY_ARTIK_EXAMPLES && EXAMPLES_ARTIK_WEBSOCKET
```

## apps/examples/artik_onboarding/Kconfig
```kconfig
config EXAMPLES_ARTIK_ONBOARDING
	bool "ARTIK Onboarding Service"
	depends on ARTIK_SDK
	select NETUTILS_MDNS
	select NETUTILS_MDNS_RESPONDER_SUPPORT
	select NETUTILS_JSON
	select NETUTILS_NTPCLIENT
	select NETDB_DNSCLIENT
	select EXAMPLES_NTPCLIENT_TEST
	default n
	---help---
		Install the ARTIK Onboarding service, which
		allows onboarding the device to Wi-Fi hotspot
		then to ARTIK Cloud.

config USER_ENTRYPOINT
	string
	default "artik_onboarding_main" if ENTRY_ARTIK_ONBOARDING
```

## apps/examples/asan_test/Kconfig
```kconfig
#
# For a description of the syntax of this configuration file,
# see kconfig-language at https://www.kernel.org/doc/Documentation/kbuild/kconfig-language.txt
#

config EXAMPLES_ASAN_TEST
	bool "Address Sanitizer test app"
	default n
	depends on MM_ASAN_RT
	---help---
		Build Address Sanitizer test which causes error report.

if EXAMPLES_ASAN_TEST

config EXAMPLES_ASAN_TEST_PROGNAME
	string "Program name"
	default "asan_test"
	depends on BUILD_KERNEL
	---help---
		This is the name of the program that will be use when the NSH ELF
		program is installed.

endif

config USER_ENTRYPOINT
	string
	default "asan_test_main" if ENTRY_ASAN_TEST
```

## apps/examples/avs_test/Kconfig
```kconfig
#
# For a description of the syntax of this configuration file,
# see kconfig-language at https://www.kernel.org/doc/Documentation/kbuild/kconfig-language.txt
#

config EXAMPLES_AVS_TEST
	bool "AVS Device SDK test example"
	default n
	depends on HAVE_CXXINITIALIZE
	---help---
		Enable the AVS Device SDK test example

if EXAMPLES_AVS_TEST

config EXAMPLES_AVS_TEST_SSID
	string "SSID of AP"
	default "NULL"
	---help---
		Select SSID of AP which you want to connect to

config EXAMPLES_AVS_TEST_PASSPHRASE
	string "Passphrase of AP"
	default "NULL"
	---help---
		Passphrase of AP which you want to connect to

config EXAMPLES_AVS_TEST_AUTHENTICATION
	int "Authentication type"
	default 0
	---help---
		0 : Open
		1 : WEP Shared
		2 : WPA PSK
		3 : WPA2 PSK
		4 : WPA and WPA2 PSK
		5 : Unknown

config EXAMPLES_AVS_TEST_CRYPTO
	int "Encryption type"
	default 0
	---help---
		0 : None
		1 : WEP 64 bits
		2 : WEP 128 bits
		3 : AES
		4 : TKIP
		5 : TIKP and AES
		6 : Unknown

endif # EXAMPLES_AVS_TEST

config USER_ENTRYPOINT
	string
	default "avs_test_main" if ENTRY_AVS_TEST
```

## apps/examples/aws/Kconfig
```kconfig
#
# For a description of the syntax of this configuration file,
# see kconfig-language at https://www.kernel.org/doc/Documentation/kbuild/kconfig-language.txt
#

config EXAMPLES_AWS
	bool "AWS demo application"
	default n
	select AWS_SDK
	select WIFI_MANAGER
	---help---
		Enable AWS IoT Device example application
```

## apps/examples/binary_update/Kconfig
```kconfig
#
# For a description of the syntax of this configuration file,
# see kconfig-language at https://www.kernel.org/doc/Documentation/kbuild/kconfig-language.txt
#

config EXAMPLES_BINARY_UPDATE
	bool "Binary Update example"
	default n
	depends on BINARY_UPDATE
	---help---
		Enable Binary Update example

config USER_ENTRYPOINT
	string
	default "binary_update_main" if ENTRY_BINARY_UPDATE
```

## apps/examples/bixby_app_test/Kconfig
```kconfig
#
# For a description of the syntax of this configuration file,
# see kconfig-language at https://www.kernel.org/doc/Documentation/kbuild/kconfig-language.txt
#

config EXAMPLES_BIXBY_APP_TEST
	bool "\"bixby_app_test\" example"
	default n
	---help---
		Enable the \"bixby_app_test\" example

config USER_ENTRYPOINT
	string
	default "bixby_app_test" if ENTRY_APPCONTROL
```

## apps/examples/ble_perfs/Kconfig
```kconfig
#
# For a description of the syntax of this configuration file,
# see kconfig-language at https://www.kernel.org/doc/Documentation/kbuild/kconfig-language.txt
#

config EXAMPLES_BLE_PERFS
	bool "BLE performance server"
	default n
	depends on BLE_MANAGER
	---help---
		Enable BLE Performance Server
```

## apps/examples/ble_rmc/Kconfig
```kconfig
#
# For a description of the syntax of this configuration file,
# see kconfig-language at https://www.kernel.org/doc/Documentation/kbuild/kconfig-language.txt
#

config EXAMPLES_BLE_RMC
	bool "BLE remote controller example"
	default n
	depends on BLE_MANAGER
	---help---
		Enable BLE remote controller
```

## apps/examples/blink_led_wifi/Kconfig
```kconfig
#
# For a description of the syntax of this configuration file,
# see kconfig-language at https://www.kernel.org/doc/Documentation/kbuild/kconfig-language.txt
#

config EXAMPLES_BLINK_LED_WIFI
	bool "blink_led_wifi example"
	default n
	---help---
		Enable blink_led_wifi example
```

## apps/examples/bluetooth/Kconfig
```kconfig
#
# For a description of the syntax of this configuration file,
# see kconfig-language at https://www.kernel.org/doc/Documentation/kbuild/kconfig-language.txt
#

config EXAMPLES_BT_UNIT_TEST
	bool "Enable bt_unit_test"
	default n
	depends on BLUETOOTH
	---help---
		Enable bt_unit_test

config USER_ENTRYPOINT
	string
	default "bt_unit_test_main" if ENTRY_BT_UNIT_TEST
```

## apps/examples/board_specific_demo/ameba_cmsis_dsp_demo/Kconfig
```kconfig
#
# For a description of the syntax of this configuration file,
# see kconfig-language at https://www.kernel.org/doc/Documentation/kbuild/kconfig-language.txt
#

config EXAMPLES_CMSIS_DSP
	bool "CMSIS DSP example"
	default n
	depends on EXTERNAL_CMSIS_DSP
	---help---
		Enable the CMSIS DSP example

config USER_ENTRYPOINT
	string
	default "cmsis_dsp" if ENTRY_CMSIS_DSP
```
