## apps/system/utils/Kconfig
```kconfig
#
# For a description of the syntax of this configuration file,
# see kconfig-language at https://www.kernel.org/doc/Documentation/kbuild/kconfig-language.txt
#
config SYSTEM_CMDS
	bool "System shell commands"
	default y
	depends on TASH
	---help---
		Register system TASH commands enabled (ps, heapinfo, free, stackmonitor and etc).
		This configuration just registers enabled system commands in TASH, not enables
		system commands. Because they can be used without TASH by function calling.
		Let's enable system commands at each configuration.

config FS_CMDS
	bool "FS shell commands"
	default y
	depends on TASH && (NFILE_DESCRIPTORS != 0)
	---help---
		Disable File System command in TASH.
		Command including ls, cd, cat, mount, and so on.

if FS_CMDS
config FSCMD_BUFFER_LEN
       int "Buffer length of FSCMD"
       default 32
       ---help---
             Buffer length of FS command's I/O operation
             Using this buffer in cat, and so on.
endif

config NET_CMDS
	bool "Network shell commands"
	default y
	depends on TASH && NETUTILS_DHCPC && NETUTILS_NETLIB && NET_LWIP
	---help---
		Disable Network command in TASH.
		Command including ifconfig, ifdown, ifup, and so on.

if NET_CMDS
config NET_PING_CMD
	bool "Network 'ping' command"
	default y
	---help---
		Network ping command

config NET_PING_CMD_ICOUNT
	int "ping command iterations"
	default 5
	depends on NET_PING_CMD
	---help---
		Number of iterations that 'ping' has to be run.

endif #NET_CMDS

config ENABLE_CPULOAD
	bool "cpuload"
	default y
	depends on SCHED_CPULOAD && !FS_PROCFS_EXCLUDE_CPULOAD
	---help---
		Display current cpuload or start/stop CPU load monitor.
		CPU load monitor is a daemon that will periodically assess
		CPU usage by all live tasks and threads in the system.

config ENABLE_CPULOAD_MONITOR
	bool "cpuload monitor"
	default y
	depends on ENABLE_CPULOAD && !CONFIG_DISABLE_PTHREAD && !CONFIG_DISABLE_SIGNALS
	---help---
		The CPU load monitor is a daemon that will periodically assess
		CPU usage by all live tasks and threads in the system.
		It is available if both signal and pthread are supported only, !DISABLE_SIGNALS && !DISABLE_PTHREAD.

config CPULOADMONITOR_PRIORITY
	int "CPU load monitor daemon priority"
	default 100
	depends on ENABLE_CPULOAD_MONITOR
	---help---
		The priority to use the the CPU load monitor daemon.  Default: 100

config CPULOADMONITOR_INTERVAL
	int "CPU load monitor frequency"
	default 5
	depends on ENABLE_CPULOAD_MONITOR
	---help---
		The rate in seconds that the CPU load monitor will wait before dumping
		the next set CPU load usage information.  Default:  5 seconds.

config ENABLE_DATE
	bool "date"
	default y
	---help---
		Display or set time

config ENABLE_DMESG
	bool "dmesg"
	default y
	depends on SYSLOG && RAMLOG_SYSLOG
	---help---
		Print the contents of log message buffer

if !DISABLE_ENVIRON
config ENABLE_ENV_GET
	bool "env get"
	default y
	---help---
		print the current contents of env

config ENABLE_ENV_SET
	bool "env set"
	default y
	---help---
		set a env variable

config ENABLE_ENV_UNSET
	bool "env unset"
	default y
	---help---
		unset a specific env variable
endif #!DISABLE_ENVIRON

config ENABLE_FREE
	bool "free"
	default y
	---help---
		Show information about memory status

config ENABLE_HEAPINFO
	bool "heapinfo"
	default y
	depends on DEBUG_MM_HEAPINFO && FS_PROCFS
	---help---
		Show information about memory status per thread

if ENABLE_HEAPINFO
config HEAPINFO_USER_GROUP
	bool "Enable User defined Group Memory Usage"
	default n

if HEAPINFO_USER_GROUP
config HEAPINFO_USER_GROUP_LIST
	string "Thread Name List for measuring Alloc Size"
	default ""
	---help---
		Task/Thread name is separated with ',' and Group is separated with '/'.
		For example, "abc,def/ghi,jklmn/opqr".
endif
endif

config ENABLE_IRQINFO
	bool "irqinfo"
	default n
	depends on TASH && !FS_PROCFS_EXCLUDE_IRQS
	select DEBUG_IRQ_INFO if DEBUG
	---help---
		List the registered interrupts, it's occurrence counts and corresponding isr.

config ENABLE_KILL
	bool "kill"
	default y
	depends on !BUILD_PROTECTED
	---help---
		Send a signal to processes or process groups.
		When SIGKILL(9) is sent, a task/pthread which received signal will be terminated without any garbage collection.
		Users can register their own handler for SIGKILL to free the allocated memory.
		CONFIG_SIGKILL_HANDLER should be enabled for user's own handler.

config ENABLE_KILLALL
	bool "killall"
	default y
	depends on !BUILD_PROTECTED
	---help---
		Send a signal to all processes running any of the specified commands

config ENABLE_PS
	bool "ps"
	default y
	depends on FS_PROCFS && !FS_PROCFS_EXCLUDE_PROCESS
	---help---
		List of tasks/threads

config ENABLE_STACKMONITOR
	bool "Stack monitor"
	default n
	depends on !FS_PROCFS_EXCLUDE_PROCESS
	select STACK_COLORATION
	---help---
		The stack monitor is a daemon that will periodically assess
		stack usage by all tasks and threads in the system.  This
		feature depends on internal OS features and, hence, is
		not available if the kernel build or protected build is selected.

if ENABLE_STACKMONITOR
config STACKMONITOR_STACKSIZE
	int "Stack monitor daemon stack size"
	default 2048
	---help---
		The stack size of the stack monitor daemon.  Default: 2048 bytes

config STACKMONITOR_PRIORITY
	int "Stack monitor daemon priority"
	default 100
	---help---
		The priority to use the the stack monitor daemon.  Default: 100

config STACKMONITOR_INTERVAL
	int "Stack monitor dump frequency"
	default 5
	---help---
		The rate in seconds that the stack monitor will wait before dumping
		the next set stack usage information.  Default:  2 seconds.

endif #ENABLE_STACKMONITOR

config ENABLE_UPTIME
	bool "uptime"
	default y
	---help---
		print how long the system has been running
```

## apps/system/vi/Kconfig
```kconfig
#
# For a description of the syntax of this configuration file,
# see kconfig-language at https://www.kernel.org/doc/Documentation/kbuild/kconfig-language.txt
#

config SYSTEM_VI
	bool "Tiny VI work-alike text editor"
	default n
	depends on (NFILE_DESCRIPTORS != 0) && (NFILE_STREAMS != 0)
	---help---
		Enable support for TinyAra tiny VI work-alike editor.

		Omitted features:
			- No keypad cursor control support
			- No word oriented operations.

		Assumptions and Limitations:
			- A VT100 host terminal is assumed.  At 115200 BAUD, screen
			  update times with a 24x64 edit region are noticeable but
			  acceptable.
			- A fixed width character set (like Courier) is assumed
			- Files are edited in memory so unless you have a lot of memory
			  to spare, this editor will only be useful for very small files.

		Size: As of 2013-01-30, it appears that the size will vary from
		about 8.5 to 10.5KB, depending upon the efficiency of the
		underlying architecture.

if SYSTEM_VI

config SYSTEM_VI_COLS
	int "Display width (columns)"
	default 64
	---help---
		The editor does not have the capability to query the display for
		its width or height.  This setting provides the default width of
		the display in columns.  The actually width can be overridden using
		command line options.

		The default column width for a VT100 terminal is 80 characters.  The
		default for this setting is smaller, 64, so that a smaller in-memory
		buffer is used.  You might have a better experience wth a column
		width of 80 (if the terminal width is not controllable from your
		terminal application).

config SYSTEM_VI_ROWS
	int "Display height (rows)"
	default 16
	---help---
		The editor does not have the capability to query the display for
		its width or height.  This setting provides the default height of
		the display in rows.  The actually width can be overridden using
		command line options.

		The default height for a VT100 terminal is 64 rows.  The default
		for this setting is smaller, 16, so that a smaller in-memory
		buffer is used.  You might have a better experience wth a height
		of 64 rows (if the terminal height is not controllable from your
		terminal application).

config SYSTEM_VI_DEBUGLEVEL
	int "Debug level"
	default 0
	range 0 2
	---help---
		0=Debug off; 1=Print errors on console; 2=Print debug information
		on the console.

		Debug output is generated with syslog.  The editor works on
		/dev/console.  In order to get both a usable display and also
		readable debug output, syslog'ing should sent to some device other
		than /dev/console (which is the default).

if TZSH_BUILTIN_APPS

config SYSTEM_VI_STACKSIZE
	int "Builtin task stack size"
	default 2048
	---help---
		Size of the task to configure when started VI from TZSH

config SYSTEM_VI_PRIORITY
	int "Builtin task priority"
	default 100
	---help---
		Priority of the task to configure when started VI from TZSH

endif # TZSH_BUILTIN_APPS
endif # SYSTEM_VI
```

## build/configs/Kconfig
```kconfig
#
# For a description of the syntax of this configuration file,
# see kconfig-language at https://www.kernel.org/doc/Documentation/kbuild/kconfig-language.txt
#

choice
	prompt "Select target board"
	default ARCH_BOARD_SIDK_S5JT200
	---help---
		Select the board hosting the architecture.  You must first select the
		exact MCU part number, then the boards supporting that part will
		be available for selection.  Use ARCH_BOARD_CUSTOM to create a new
		board configuration.

config ARCH_BOARD_SIDK_S5JT200
        bool "Samsung S5JT200 sidk board"
        depends on ARCH_CHIP_S5JT200
        select ARCH_HAVE_BUTTONS
        select ARCH_HAVE_IRQBUTTONS
        ---help---
                Samsung S5JT200 IoT wifi MCU
endchoice

config ARCH_BOARD
	string
	default "sidk_s5jt200"       if ARCH_BOARD_SIDK_S5JT200

comment "Common Board Options"

config ARCH_HAVE_LEDS
	bool

config ARCH_LEDS
	bool "Board LED support"
	default y
	depends on ARCH_HAVE_LEDS
	---help---
		Use board LEDs to show TinyAra execution status state. Unique to boards that have LEDs

config ARCH_HAVE_BUTTONS
	bool

config ARCH_BUTTONS
	bool "Board button support"
	default n
	depends on ARCH_HAVE_BUTTONS
	---help---
		"Support interfaces to use buttons provided by the board."

config ARCH_HAVE_IRQBUTTONS
	bool

config ARCH_IRQBUTTONS
	bool "Button interrupt support"
	default n
	depends on ARCH_BUTTONS && ARCH_HAVE_IRQBUTTONS
	---help---
		"Support interrupts on button presses and releases."

config BOARD_CRASHDUMP
	bool "Enable Board level logging of crash dumps"
	default n
	---help---
		If selected up_asseert will call out to board_crashdump, in the case
		of an assertion failure, prior to calling exit. Or in the
		case of a hardfault prior to looping indefinitely. board_crashdump
		then has a chance to save the state of the machine.

		The purpose of board_crashdump is to save as much information as it can
		about the cause of the fault and then most likely reset the system.

		N.B. There is limited system resources that can be used, who knows
		what memory is trashed? So all we can expect to do is save the
		"machine state" in a place where on the next reset can write it
		to more sophisticated storage in a sane operating environment.

config BOARD_COREDUMP_FLASH
	bool "Enable crashlog dump to flash"
	default n
	---help---
		If selected it will dump the assert log information to flash.

config BOARD_FOTA_SUPPORT
	bool "Enable board support for FOTA"
	default n
	select FOTA_DRIVER
	---help---
		If selected the board provides support for FOTA.

config BOARD_RAMDUMP_FLASH
	bool "Enable ramdump to flash"
	default n
	---help---
		If selected it will dump the RAM contents to flash.

config BOARD_RAMDUMP_UART
	bool "Enable ramdump via UART"
	default n
	---help---
		If selected it will send the RAM dump via UART.


comment "Board-Specific Options"

if ARCH_BOARD_SIDK_S5JT200
source "$CONFIGSDIR/sidk_s5jt200/Kconfig"
endif
```
