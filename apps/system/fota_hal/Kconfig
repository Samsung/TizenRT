## apps/system/fota_hal/Kconfig
```kconfig
#
# For a description of the syntax of this configuration file,
# see kconfig-language at https://www.kernel.org/doc/Documentation/kbuild/kconfig-language.txt
#

config SYSTEM_FOTA_HAL
	bool "FOTA HAL Application Library"
	default n
	select FOTA_DRIVER
	select LIB_BOARDCTL
	select BOARDCTL_RESET
	---help---
		Enable FOTA HAL Application Library

if SYSTEM_FOTA_HAL
config SYSTEM_FOTA_DEVNAME
	string "Device name of OTA partition"
	default "/dev/fota"
	---help---
		Specifies the device name of the partition for OTA like "/dev/fota"

config SYSTEM_FOTA_SET_SPECIFIC
	bool "Set binary and partition type"
	default n
	---help---
		Specifies binary and partition type. If they are set automatically,
		let's disable this.
endif
```

## apps/system/getfile_tool/Kconfig
```kconfig
#
# For a description of the syntax of this configuration file,
# see kconfig-language at https://www.kernel.org/doc/Documentation/kbuild/kconfig-language.txt
#

config SYSTEM_ENABLE_GETFILE
	bool "getfile via UART"
	default n
	---help---
		Enable getfile support via UART
```

## apps/system/i2c/Kconfig
```kconfig
#
# For a description of the syntax of this configuration file,
# see kconfig-language at https://www.kernel.org/doc/Documentation/kbuild/kconfig-language.txt
#


config SYSTEM_I2CTOOL
	bool "I2C tool"
	default n
	depends on I2C
	---help---
		Enable support for the I2C tool.

if SYSTEM_I2CTOOL

config I2CTOOL_MINBUS
	int "Minimum bus number"
	default 0
	depends on SYSTEM_I2CTOOL
	---help---
		Smallest bus index supported by the hardware (default 0).

config I2CTOOL_MAXBUS
	int "Maximum bus number"
	depends on SYSTEM_I2CTOOL
	default 3
	---help---
		Largest bus index supported by the hardware (default 3)

config I2CTOOL_MINADDR
	hex "Minimum I2C address"
	depends on SYSTEM_I2CTOOL
	default 0x03
	---help---
		Minium 7-bit device address (default: 0x03)

config I2CTOOL_MAXADDR
	hex "Maximum I2C address"
	depends on SYSTEM_I2CTOOL
	default 0x77
	---help---
		Largest 7-bit device address (default: 0x77)

config I2CTOOL_MAXREGADDR
	hex "Maximum I2C register address"
	default 0xff
	depends on SYSTEM_I2CTOOL
	---help---
		Largest I2C register address (default: 0xff)

config I2CTOOL_DEFFREQ
	int "Default I2C frequency"
	default 400000
	depends on SYSTEM_I2CTOOL
	---help---
		Default I2C frequency (default: 400000)

endif
```

## apps/system/inifile/Kconfig
```kconfig
#
# For a description of the syntax of this configuration file,
# see kconfig-language at https://www.kernel.org/doc/Documentation/kbuild/kconfig-language.txt
#

config SYSTEM_INIFILE
	bool "INI file parser"
	default n
	---help---
		Enable support for a simple INI file parser.

if SYSTEM_INIFILE

config SYSTEM_INIFILE_MAXLINE
	int "Max line length"
	default 256
	---help---
		The largest line that the parser can expect to see in an INI file.

config SYSTEM_INIFILE_DEBUGLEVEL
	int "Debug level"
	default 0
	range 0 2
	---help---
		0=Debug off; 1=Print errors on console; 2=Print debug information
		on the console.

endif # SYSTEM_INIFILE
```

## apps/system/init/Kconfig
```kconfig
#
# For a description of the syntax of this configuration file,
# see kconfig-language at https://www.kernel.org/doc/Documentation/kbuild/kconfig-language.txt
#


config SYSTEM_PREAPP_INIT
	bool "Preapp Init"
	default y
	---help---
		Enable Preapp Init.

if SYSTEM_PREAPP_INIT 

config SYSTEM_PREAPP_STACKSIZE
	int "pre-app thread stack size"
	default 2048
	---help---
		The size of the stack to allocate for the pre-application thread
		that is started as soon as the OS completes its initialization.

endif
```

## apps/system/install/Kconfig
```kconfig
#
# For a description of the syntax of this configuration file,
# see kconfig-language at https://www.kernel.org/doc/Documentation/kbuild/kconfig-language.txt
#

config SYSTEM_INSTALL
	bool "FLASH installation tool"
	default n
	---help---
		Enable support for the FLASH installation tool.
```

## apps/system/iperf/Kconfig
```kconfig
#
# For a description of the syntax of this configuration file,
# see kconfig-language at https://www.kernel.org/doc/Documentation/kbuild/kconfig-language.txt
#

config SYSTEM_IPERF
	bool "iperf App"
	default n
  	depends on NET_LWIP && NETUTILS_JSON && LIBC_FLOATINGPOINT
	depends on NET_LWIP_NETDB
	---help---
		Enable the \"IPERF App\" example

config IPERF_PRIORITY
	int "iperf Priority"
	default 100
	depends on SYSTEM_IPERF
	---help---
		Priority of iperf app

config IPERF_STACKSIZE
	int "iperf Stack Size"
	default 4096
	depends on SYSTEM_IPERF
	---help---
		Stack size of iperf app

if SYSTEM_IPERF
config SYSTEM_IPERF_PROGNAME
	string "Program name"
	default "iperf"
	depends on BUILD_KERNEL
	---help---
		This is the name of the program that will be use when the TASH ELF
		program is installed.
endif
```

## apps/system/lcd_tune/Kconfig
```kconfig
#
# For a description of the syntax of this configuration file,
# see kconfig-language at https://www.kernel.org/doc/Documentation/kbuild/kconfig-language.txt
#

config LCD_TUNE
	bool "LCD tuning"
	default n
	depends on LCD
	---help---
		Enable lcd tunning
```

## apps/system/mdio/Kconfig
```kconfig
#
# For a description of the syntax of this configuration file,
# see kconfig-language at https://www.kernel.org/doc/Documentation/kbuild/kconfig-language.txt
#

config SYSTEM_MDIO
	bool "MDIO tool"
	default n
	depends on NETDEV_PHY_IOCTL
	---help---
		Enable the MDIO tool
```

## apps/system/netdb/Kconfig
```kconfig
#
# For a description of the syntax of this configuration file,
# see kconfig-language at https://www.kernel.org/doc/Documentation/kbuild/kconfig-language.txt
#

config SYSTEM_NETDB
	bool "netdb interface"
	default n
	depends on NET_LWIP_NETDB

if SYSTEM_NETDB

config SYSTEM_NETDB_STACKSIZE
	int "netdb task stack size"
	default 2048

config SYSTEM_NETDB_PRIORITY
	int "netdb task priority"
	default 100

endif
```

## apps/system/pm_metrics/Kconfig
```kconfig
#
# For a description of the syntax of this configuration file,
# see kconfig-language at https://www.kernel.org/doc/Documentation/kbuild/kconfig-language.txt
#

config SYSTEM_PM_METRICS
	bool "PM Metrics Tool"
	default y
	depends on PM_METRICS && PM_TICKSUPPRESS
	---help---
		Monitor PM suspend and sleep to display PM Metrics.
```

## apps/system/poweroff/Kconfig
```kconfig
#
# For a description of the syntax of this configuration file,
# see kconfig-language at https://www.kernel.org/doc/Documentation/kbuild/kconfig-language.txt
#

config SYSTEM_POWEROFF
	bool "Power-Off command"
	default n
	depends on BOARDCTL_POWEROFF
	---help---
		Enable support for the TASH poweroff command.  NOTE: This option
		provides the TASH power-off command only.  It requires board-specific
		support to actually implement the power-off.
```

## apps/system/prun/Kconfig
```kconfig
#
# For a description of the syntax of this configuration file,
# see kconfig-language at https://www.kernel.org/doc/Documentation/kbuild/kconfig-language.txt
#

config SYSTEM_PRUN
	bool "Pascal P-Code interpreter"
	default n
	depends on INTERPRETERS_PCODE
	---help---
		Build the Pascal P-Code interpreter / Virtual machine.  This selection
		just builds a library of P-Code-related functions as described in
		include/apps/prun.h.  This selection is also necessary to enable other
		P-Code related features.

if SYSTEM_PRUN

config SYSTEM_PEXEC
	bool "Pascal P-Code command"
	default n
	---help---
		Generates an NSH built-in task that may be used to execute P-Code
		files from the NSH command line.  For example:

		nsh> pexec /bin/hello.pex
		Hello, World!

if SYSTEM_PEXEC

config SYSTEM_PEXEC_STACKSIZE
	int "P-code interpreter stack size"
	default 2048
	---help---
		This is the stack size that will be used when starting P-code interpreter.

config SYSTEM_PEXEC_PRIORITY
	int "P-code interpreter priority"
	default 100
	---help---
		This is the task_priority that will be used when starting P-code interpreter.

config SYSTEM_PEXEC_VARSTACKSIZE
	int "P-code variable stack size (default)"
	default 1024
	---help---
		This default size of the P-Code variable storage area to be allocated by the
		P-Code runtime.

config SYSTEM_PEXEC_STRSTACKSIZE
	int "P-code string stack size (default)"
	default 128
	---help---
		This default size of the P-Code string stack area to be allocated by the
		P-Code runtime.

endif
endif
```

## apps/system/ramtest/Kconfig
```kconfig
#
# For a description of the syntax of this configuration file,
# see kconfig-language at https://www.kernel.org/doc/Documentation/kbuild/kconfig-language.txt
#

config SYSTEM_RAMTEST
	bool "RAM Test"
	default n
	---help---
		Enable a simple RAM test.

if SYSTEM_RAMTEST

config SYSTEM_RAMTEST_PRIORITY
	int "RAM test task priority"
	default 100

config SYSTEM_RAMTEST_STACKSIZE
	int "RAM test stack size"
	default 1024

endif
```

## apps/system/ramtron/Kconfig
```kconfig
#
# For a description of the syntax of this configuration file,
# see kconfig-language at https://www.kernel.org/doc/Documentation/kbuild/kconfig-language.txt
#

config SYSTEM_RAMTRON
	bool "RAMTRON command"
	default n
	---help---
		Enable support for the NSH RAMTRON command.

if SYSTEM_RAMTRON
endif
```

## apps/system/sekey_test/Kconfig
```kconfig
#
# For a description of the syntax of this configuration file,
# see kconfig-language at https://www.kernel.org/doc/Documentation/kbuild/kconfig-language.txt
#

config SYSTEM_SEKEY_TEST
	bool "Secure Key Tester"
	default n
	depends on SECURITY_LINK
	---help---
		Enable the SE Key & Cert Test

if SYSTEM_SEKEY_TEST

config ECDSA_KEY_SLOT
	string "ECDSA Key slot list"
	default "0"
	---help---
		Comma separated list of ecdsa keys.

config CERT_SLOT
	string "Certificate slot list"
	default "1,2,3"
	---help---
		Comma separated list of certificates (PEM, DER).

endif
```

## apps/system/sysdbg/Kconfig
```kconfig
#
# For a description of the syntax of this configuration file,
# see kconfig-language at https://www.kernel.org/doc/Documentation/kbuild/kconfig-language.txt
#
config DEBUG_SYSTEM_APP
	bool "Enable system debug application with tash inerface"
	default n
	depends on TASH
	depends on DEBUG_SYSTEM
```

## apps/system/sysinfo/Kconfig
```kconfig
#
# For a description of the syntax of this configuration file,
# see kconfig-language at https://www.kernel.org/doc/Documentation/kbuild/kconfig-language.txt
#

config SYSTEM_INFORMATION
	bool "System Information"
	default y
	---help---
		print System Information like version, time and etc
```

## apps/system/tzsh/Kconfig
```kconfig
config SYSTEM_TZSH
	tristate "TizenRT Shell (TZSH) example"
	default n
	select TZSH_LIBRARY
	select SYSTEM_READLINE
	---help---
		Enable the TizenShell (TZSH) example

if SYSTEM_TZSH

config SYSTEM_TZSH_PRIORITY
	int "TizenRT Shell thread priority"
	default 100

config SYSTEM_TZSH_STACKSIZE
	int "TizenRT Shell stack size"
	default 2048

config SYSTEM_TZSH_SYMTAB
	bool "Register symbol table"
	default n
	depends on LIBC_EXECFUNCS && LIB_BOARDCTL && !EXECFUNCS_HAVE_SYMTAB
	select BOARDCTL_APP_SYMTAB
	---help---
		Enable logic to automatically register an application symbol table
		as part of TZSH initialization.  If enabled, then application logic
		must provide the following:

			const struct symtab_s g_exports[];
			const int g_nexports;

		Where g_exports is the name of the exported application symbol table
		and g_nexports holds the number of entries in the application symbol
		table.

		This is done very early in the TZSH initialization sequence.

		Why might you want to do this?  There is really only one reason:  You
		would like to have the symbol tables in place early so that programs
		started by TZSH, perhaps via an initialization script, will have all
		of the necessary symbols in place.  Otherwise, you probably do *not*
		want this option!

if SYSTEM_TZSH_SYMTAB

config SYSTEM_TZSH_SYMTAB_ARRAYNAME
	string "Symbol table used by exec[l|v]"
	default "g_exports"
	---help---
		The exec[l|v] and posix_spawn() functions needs to have (1) a
		symbol table that provides the list of symbols exported by the base
		code, and (2) the number of symbols in that table.  This selection
		provides the name of that symbol table.

config SYSTEM_TZSH_SYMTAB_COUNTNAME
	string "Variable holding the number of symbols"
	default "g_nexports"
	---help---
		The exec[l|v] and posix_spawn() functions needs to have (1) a
		symbol table that provides the list of symbols exported by the base
		code, and (2) the number of symbols in that table.  This selection
		provides the name of 'int' variable that holds the number of symbol
		in the table.

endif # SYSTEM_TZSH_SYMTAB

config SYSTEM_TZSH_PROGNAME
	string "Program name"
	default "tzsh"
	depends on BUILD_LOADABLE
	---help---
		This is the name of the program that will be use when the TZSH ELF
		program is installed.

config SYSTEM_TZSH_CXXINITIALIZE
	bool "C++ Initialization"
	default n
	depends on HAVE_CXX && HAVE_CXXINITIALIZE
	---help---
		If HAVE_CXX and HAVE_CXXINITIALIZE are slected, then this TZSH
		example can be configured to initialize C++ constructors when it
		is started.  TZSH does not use C++ and, by default, assumes that
		constructors are initialized elsewhere.  However, you can force
		TZSH to initialize constructors by setting this option.

endif
```
