## os/arch/arm/src/s5j/Kconfig
```kconfig
#
# For a description of the syntax of this configuration file,
# see kconfig-language at https://www.kernel.org/doc/Documentation/kbuild/kconfig-language.txt
#

comment "S5J Configuration Options"

choice
	prompt "S5J Chip Selection"
	default ARCH_CHIP_S5JT200
	depends on ARCH_CHIP_S5J

config ARCH_CHIP_S5JT200
	bool "S5JT200"
	select ARCH_CORTEXR4
	select ARMV7A_HAVE_GICv2
	select ARMV7R_ICACHE
	select ARMV7R_DCACHE
	select S5J_S5JT200
	select ARCH_HAVE_RESET

endchoice

config S5J_S5JT200
	bool
	default n
	select S5J_HAVE_ADC
	select S5J_HAVE_DMA
	select S5J_HAVE_I2C
	select S5J_HAVE_I2S
	select S5J_HAVE_MCT
	select S5J_HAVE_PWM0
	select S5J_HAVE_PWM1
	select S5J_HAVE_PWM2
	select S5J_HAVE_PWM3
	select S5J_HAVE_PWM4
	select S5J_HAVE_PWM5
	select S5J_HAVE_RTC
	select S5J_HAVE_SFLASH
	select S5J_HAVE_SPI
	select S5J_HAVE_SSS
	select S5J_HAVE_UART0
	select S5J_HAVE_UART1
	select S5J_HAVE_UART2
	select S5J_HAVE_UART3
	select S5J_HAVE_UART4
	select S5J_HAVE_WATCHDOG

menu "S5J Peripheral Support"

# These "hidden" settings determine peripheral options that are available for
# the selection MCU.

config S5J_HAVE_ADC
	bool
	default n

config S5J_HAVE_DMA
	bool
	default n

config S5J_HAVE_I2C
	bool
	default n

config S5J_HAVE_I2S
	bool
	default n

config S5J_HAVE_MCT
	bool
	default n

config S5J_HAVE_PWM0
	bool
	default n

config S5J_HAVE_PWM1
	bool
	default n

config S5J_HAVE_PWM2
	bool
	default n

config S5J_HAVE_PWM3
	bool
	default n

config S5J_HAVE_PWM4
	bool
	default n

config S5J_HAVE_PWM5
	bool
	default n

config S5J_HAVE_RTC
	bool
	default n

config S5J_HAVE_SFLASH
	bool
	default n

config S5J_HAVE_SPI
	bool
	default n

config S5J_HAVE_SSS
	bool
	default n

config S5J_HAVE_UART0
	bool
	default n

config S5J_HAVE_UART1
	bool
	default n

config S5J_HAVE_UART2
	bool
	default n

config S5J_HAVE_UART3
	bool
	default n

config S5J_HAVE_UART4
	bool
	default n

config S5J_HAVE_WATCHDOG
	bool
	default n

config S5J_ADC
	bool "ADC"
	default n
	depends on S5J_HAVE_ADC
	select ANALOG
	select ADC
	select SCHED_WORKQUEUE
	select SCHED_LPWORK
	---help---
		S5J has 12-bits ADC with 4 channels. Say Y here, if you want
		to use it.

config S5J_DMA
	bool "DMA"
	default n
	depends on S5J_HAVE_DMA
	select ARCH_DMA

config S5J_I2C
	bool "I2C"
	default n
	depends on S5J_HAVE_I2C

config S5J_I2S
	bool "I2S"
	default n
	depends on S5J_HAVE_I2S
	select I2S
	select AUDIO
	select S5J_DMA

config S5J_I2S_RX
	bool "S5J I2S RX support"
	default n
	depends on S5J_I2S

config S5J_I2S_TX_P
	bool "S5J I2S TX Prime support"
	default n
	depends on S5J_I2S

config S5J_I2S_TX_S
	bool "S5J I2S TX Secondary support"
	default n
	depends on S5J_I2S

config S5J_I2S_MAXINFLIGHT
	int "I2S queue size"
	default 16
	depends on S5J_I2S
	---help---
		This is the total number of transfers, both RX and TX, that can be
		enqueue before the caller is required to wait.  This setting
		determines the number certain queue data structures that will be
		pre-allocated.

config S5J_MCT
	bool
	default n

config S5J_TIMER0
	bool "TIMER0"
	default n
	depends on S5J_HAVE_MCT
	select S5J_MCT

config S5J_TIMER1
	bool "TIMER1"
	default n
	depends on S5J_HAVE_MCT
	select S5J_MCT

config S5J_TIMER2
	bool "TIMER2"
	default n
	depends on S5J_HAVE_MCT
	select S5J_MCT

config S5J_TIMER3
	bool "TIMER3"
	default n
	depends on S5J_HAVE_MCT
	select S5J_MCT

config S5J_UART_FLOWCONTROL
	bool
	default n

config S5J_UART0
	bool "UART0"
	default n
	depends on S5J_HAVE_UART0
	select ARCH_HAVE_UART0
	select ARCH_HAVE_SERIAL_TERMIOS

config S5J_UART1
	bool "UART1"
	default n
	depends on S5J_HAVE_UART1
	select ARCH_HAVE_UART1
	select ARCH_HAVE_SERIAL_TERMIOS

config S5J_UART2
	bool "UART2"
	default n
	depends on S5J_HAVE_UART2
	select ARCH_HAVE_UART2
	select ARCH_HAVE_SERIAL_TERMIOS

config S5J_UART2_FLOWCONTROL
	bool "UART2 Flow Control"
	default n
	depends on S5J_UART2
	depends on !S5J_UART1
	select S5J_UART_FLOWCONTROL

config S5J_UART3
	bool "UART3"
	default n
	depends on S5J_HAVE_UART3
	select ARCH_HAVE_UART3
	select ARCH_HAVE_SERIAL_TERMIOS

config S5J_UART3_FLOWCONTROL
	bool "UART3 Flow Control"
	default n
	depends on S5J_UART3
	depends on !S5J_PWM0
	depends on !S5J_PWM1
	select S5J_UART_FLOWCONTROL

config S5J_UART4
	bool "UART4 (Debug UART)"
	default y
	depends on S5J_HAVE_UART4
	select ARCH_HAVE_UART4
	select ARCH_HAVE_SERIAL_TERMIOS

config S5J_PWM
	bool
	default n

config S5J_PWM0
	bool "PWM0"
	depends on S5J_HAVE_PWM0
	select S5J_PWM
	default n

config S5J_PWM1
	bool "PWM1"
	depends on S5J_HAVE_PWM1
	select S5J_PWM
	default n

config S5J_PWM2
	bool "PWM2"
	depends on S5J_HAVE_PWM2
	select S5J_PWM
	default n

config S5J_PWM3
	bool "PWM3"
	depends on S5J_HAVE_PWM3
	select S5J_PWM
	default n

config S5J_PWM4
	bool "PWM4"
	depends on S5J_HAVE_PWM4
	select S5J_PWM
	default n

config S5J_PWM5
	bool "PWM5"
	depends on S5J_HAVE_PWM5
	select S5J_PWM
	default n

config S5J_SSS
	bool "SSS"
	depends on S5J_HAVE_SSS
	default y

config S5J_SPI
	bool "SPI"
	depends on S5J_HAVE_SPI
	default y

config S5J_WATCHDOG
	bool "Watchdog"
	depends on S5J_HAVE_WATCHDOG
	default n

config S5J_WATCHDOG_DEBUG
	bool "S5J Watchdog debug"
	default n
	depends on S5J_WATCHDOG

config S5J_WATCHDOG_INT
	bool "S5J Watchdog interrupt enable"
	default n
	depends on S5J_WATCHDOG

config S5J_WATCHDOG_RESET
	bool "S5J Watchdog reset enable"
	default n
	depends on S5J_WATCHDOG

config S5J_WDT_DEFTIMEOUT
	int "S5J Watchdog Timeout(in msec)"
	default 7000
	depends on S5J_WATCHDOG

config S5J_SFLASH
	bool "SFLASH"
	default y
	depends on S5J_HAVE_SFLASH

config S5J_SENSOR_PPD42NS
	bool "PPD42NS Dust Sensor"
	default n

endmenu
```

## os/arch/arm/src/sidk_s5jt200/Kconfig
```kconfig
#
# For a description of the syntax of this configuration file,
# see kconfig-language at https://www.kernel.org/doc/Documentation/kbuild/kconfig-language.txt
#

if ARCH_BOARD_SIDK_S5JT200

config SIDK_S5JT200_TLC59116
	bool "Support TLC59116 IC"
	default n
	depends on S5J_I2C
	---help---
		SIDK S5JT200 evaluation board has TLC59116 IC attached to
		its I2C bus. It can generate PWM signals to control RGB LEDs.

config SIDK_S5JT200_S8300
	bool "Support S8300 IC"
	default n
	depends on S5J_PWM
	---help---
		SIDK S5JT200 evaluation board has S8300 linear LED driver IC
		which is driven by PWMs from S5J chipset.

config SIDK_S5JT200_M93C66WMN6T
	bool "Support M93C66WMN6T EEPROM"
	default n
	depends on SPI_BITBANG
	depends on SPI_BITBANG_VARWIDTH
	---help---
		SIDK S5JT200 evaluation board has an SPI MicroWire serial
		access EEPROM attached to GPIO pins.

config SIDK_S5JT200_PWM_CHNUM
	int "Number of PWM channel"
	default 6
	depends on S5J_PWM
	---help---
		Sets the number of pwm channel exposed on SIDK S5JT200
		evaluation board

config SIDK_S5JT200_FLASH_CAPACITY
	int "Size of external flash memory (in bytes)"
	default 8388608
	depends on S5J_SFLASH
	---help---
		Sets the capacity of the external flash memory
		on the SIDK S5JT200 evaluation board.

config SIDK_S5JT200_FLASH_PAGE_SIZE
	int "Page size of external flash memory (in bytes)"
	default 4096
	depends on S5J_SFLASH
	---help---
		Sets the page size of the external flash memory
		on the SIDK S5JT200 evaluation board. It can be the
		size of erase unit flash memory supports.

config SIDK_S5JT200_FLASH_MINOR
	int "Minor number for the FLASH /dev/smart entry"
	default 0
	depends on S5J_SFLASH
	---help---
		Sets the minor number for /dev node of the external flash
		device.

config SIDK_S5JT200_FLASH_PART
	bool "Enable partition support on FLASH"
	default n
	select MTD
	select MTD_PARTITION
	select MTD_PROGMEM
	depends on S5J_SFLASH
	depends on NFILE_DESCRIPTORS != 0
	---help---
		Enables creation of partitions on the FLASH

config SIDK_S5JT200_FLASH_PART_LIST
	string "Flash partition size list (in KBytes)"
	default "8192,"
	depends on SIDK_S5JT200_FLASH_PART
	---help---
		Comma separated list of partition sizes in KB.

config SIDK_S5JT200_FLASH_PART_TYPE
	string "Flash partition type list"
	default "none,"
	---help---
		Comma separated list of partition types that can be
		one of followings: none, smartfs, config

config SIDK_S5JT200_FLASH_PART_NAME
	string "FLash partition name list"
	default "mx25,"
	depends on SIDK_S5JT200_FLASH_PART
	depends on MTD_PARTITION_NAMES
	---help---
		Comma separated list of partition names.

config SIDK_S5JT200_AUTOMOUNT
	bool "Automount partitions"
	default n
	depends on SIDK_S5JT200_FLASH_PART
	depends on !DISABLE_MOUNTPOINT
	---help---
		If enabled, mount userrw and sssrw partitions at boot.

config SIDK_S5JT200_AUTOMOUNT_ROMFS
	bool "Automount ROM read only partiton"
	default n
	depends on SIDK_S5JT200_AUTOMOUNT
	depends on FS_ROMFS
	---help---
		If enabled, rom readonly partition will be mounted automatically
		at boot.

config SIDK_S5JT200_AUTOMOUNT_ROMFS_MOUNTPOINT
	string "Mountpoint of the partition for rom read only file system"
	default "/rom"
	depends on SIDK_S5JT200_AUTOMOUNT_ROMFS
	---help---
		Specifies the mount point where rom readonly file system
		will be mounted at.

config SIDK_S5JT200_AUTOMOUNT_USERFS
	bool "Automount user r/w partiton"
	default n
	depends on SIDK_S5JT200_AUTOMOUNT
	---help---
		If enabled, user r/w partition will be mounted automatically
		at boot.

config SIDK_S5JT200_AUTOMOUNT_USERFS_DEVNAME
	string "Device name of the partition for user r/w file system"
	default "/dev/smart0p13"
	depends on SIDK_S5JT200_AUTOMOUNT_USERFS
	---help---
		Specifies the device name (/dev/smart0pX) of the partition
		for user r/w file system.
		when SMARTFS_MULTI_ROOT_DIRS config is enabled the device name
		will be appended by "d1" (/dev/smart0pxd1).

config SIDK_S5JT200_AUTOMOUNT_USERFS_MOUNTPOINT
	string "Mountpoint of the partition for user r/w file system"
	default "/mnt"
	depends on SIDK_S5JT200_AUTOMOUNT_USERFS
	---help---
		Specifies the mount point where user r/w file system
		will be mounted at.

config SIDK_S5JT200_AUTOMOUNT_SSSRW
	bool "Automount sss r/w partiton"
	default n
	depends on SIDK_S5JT200_AUTOMOUNT
	---help---
		If enabled, SSS r/w partition will be mounted automatically
		at boot.

config SIDK_S5JT200_AUTOMOUNT_SSSRW_DEVNAME
	string "Device name of the partition for SSS r/w file system"
	default "/dev/smart0p14"
	depends on SIDK_S5JT200_AUTOMOUNT_SSSRW
	---help---
		Specifies the device name (/dev/smart0pX) of the partition
		for SSS r/w file system.

config SIDK_S5JT200_AUTOMOUNT_SSSRW_MOUNTPOINT
	string "Mountpoint of the partition for SSS r/w file system"
	default "/sss"
	depends on SIDK_S5JT200_AUTOMOUNT_SSSRW
	---help---
		Specifies the mount point where SSS r/w file system
		will be mounted at.

if RAMMTD
config SIDK_S5JT200_RAMMTD_NEBLOCKS
		int "RAM MTD erase block count"
		default 64
		---help---
				Ramfs size will be RAMMTD_ERASESIZE * SIDK_S5JT200_RAMMTD_NEBLOCKS.
				You have to consider total ramsize to alloc ramfs size.

config SIDK_S5JT200_RAMMTD_DEV_NUMBER
		int "device number for mtd of smartfs"
		default 3

config SIDK_S5JT200_RAMMTD_DEV_POINT
		string "Device name of the partition for ramfs r/w file system"
		default "/dev/smart3"

config SIDK_S5JT200_RAMMTD_MOUNT_POINT
		string "Mountpoint of the partition for ramfs r/w file system"
		default "/ramfs"
endif
endif
```

## os/arch/arm/src/stm32h745/Kconfig
```kconfig
#
# For a description of the syntax of this configuration file,
# see the file kconfig-language.txt in the NuttX tools repository.
#

if ARCH_CHIP_STM32H745

comment "STM32H745 Configuration Options"

choice
	prompt "STM32 H745 Chip Selection"
	default ARCH_CHIP_STM32H745ZI
	depends on ARCH_CHIP_STM32H745

config ARCH_CHIP_STM32H745ZI
	bool "STM32H745ZI"
	select ARCH_CORTEXM7
	select STM32H745_STM32H745ZI
	---help---
		STM32 H745 Cortex M7, 2048 Kb FLASH, 512 Kb AXI RAM

endchoice # STM32 H745 Chip Selection

# Chip product lines

config STM32H745_STM32H745ZI
	# STM32H745ZI Access Lines
	#
	# Avoid using this config as it is basically same subfamily
	# as STM32H745_STM32H745ZI (documented in RMxxxx).
	#
	bool
	default n
	select ARCH_HAVE_RAMFUNCS
	select STM32H745_HAVE_TIM7
	select STM32H745_HAVE_USART2
	select STM32H745_HAVE_USART3
	select STM32H745_HAVE_USART6
	select STM32H745_HAVE_WWDG1
	select STM32H745_HAVE_HSEM

# Pin/package configurations

config STM32H745_IO_CONFIG_A
	bool
	default n

config STM32H745_IO_CONFIG_B
	bool
	default n

config STM32H745_IO_CONFIG_C
	bool
	default n

config STM32H745_IO_CONFIG_D
	bool
	default n

config STM32H745_IO_CONFIG_E
	bool
	default n

config STM32H745_IO_CONFIG_F
	bool
	default n

config STM32H745_IO_CONFIG_G
	bool
	default n

config STM32H745_IO_CONFIG_H
	bool
	default n


comment "STM32H745 Peripherals"

menu "STM32H745 Peripheral Support"

# These "hidden" settings determine is a peripheral option is available for the
# selection MCU

config STM32H745_HAVE_TIM7
	bool
	default y

config STM32H745_HAVE_USART2
	bool
	default y

config STM32H745_HAVE_USART3
	bool
	default y

config STM32H745_HAVE_USART6
	bool
	default y

config STM32H745_HAVE_WWDG1
	bool
	default y

config STM32H745_HAVE_HSEM
	bool
	default y

# These "hidden" settings are the OR of individual peripheral selections
# indicating that the general capability is required.

config STM32H745_TIM7
	bool "TIM7"
	default n
	depends on STM32H745_HAVE_TIM7

config STM32H745_USART2
	bool "USART2"
	default n
	depends on STM32H745_HAVE_USART2
	select ARCH_HAVE_USART2
	select ARCH_HAVE_SERIAL_TERMIOS

config STM32H745_USART3
	bool "USART3"
	default n
	depends on STM32H745_HAVE_USART3
	select ARCH_HAVE_USART3
	select ARCH_HAVE_SERIAL_TERMIOS

config STM32H745_USART6
	bool "USART6"
	default n
	depends on STM32H745_HAVE_USART6
	select ARCH_HAVE_USART6
	select ARCH_HAVE_SERIAL_TERMIOS
	
config STM32H745_WWDG1
	bool "WWDG1"
	default n
	depends on STM32H745_HAVE_WWDG1

config STM32H745_HSEM
	bool "HSEM"
	default n
	depends on STM32H745_HAVE_HSEM

endmenu

endif # ARCH_CHIP_STM32H745
```

## os/arch/xtensa/src/esp32/spi_flash/Kconfig
```kconfig
menu "SPI Flash driver"

config ESP_FLASH_BASE
    hex "Start address for user filesystem"
    default 0x300000
    help
        Setting this vaule to configure flash start address for user filesystem,
        such as smartfs, romfs.

config ESP32_FLASH_CAPACITY
    hex "Size for user filesystem"
    default 0x100000
    help
        Setting this vaule to configure flash size  for user filesystem,
        such as smartfs, romfs.

config ESP32_FLASH_PAGE_SIZE
    int "Read/write unit size of SPI flash"
    default 256
    help
        Setting this vaule to configure read/write unit size of esp32 SPI flash.

config ESP32_FLASH_BLOCK_SIZE
    int "Erase unit size of SPI flash"
    default 4096
    help
        Setting this vaule to configure erase unit size of esp32 SPI flash.

config SPI_FLASH_ROM_DRIVER_PATCH
    bool "Enable SPI flash ROM driver patched functions"
    default y
    help
        Enable this flag to use patched versions of SPI flash ROM driver functions.
        This option is needed to write to flash on ESP32-D2WD, and any configuration
        where external SPI flash is connected to non-default pins.

config PARTITION_TABLE_OFFSET
    hex "Offset of partition table"
    default 0x8000
    help
        The address of partition table (by default 0x8000).
        Allows you to move the partition table, it gives more space for the bootloader.
        Note that the bootloader and app will both need to be compiled with the same PARTITION_TABLE_OFFSET value.

        This number should be a multiple of 0x1000.

        Note that partition offsets in the partition table CSV file may need to be changed if this value is set to a higher value. To have
        each partition offset adapt to the configured partition table offset, leave all partition offsets blank in the CSV file.

endmenu
```
