## lib/libxx/Kconfig
```kconfig
#
# For a description of the syntax of this configuration file,
# see kconfig-language at https://www.kernel.org/doc/Documentation/kbuild/kconfig-language.txt
#

comment "Basic CXX Support"

config C99_BOOL8
	bool "sizeof(_Bool) is 8-bits"
	default n
	---help---
		This setting means (1) your C++ compiler has sizeof(_Bool) == 8, (2)
		your C compiler supports the C99 _Bool intrinsic type, and (2) that
		the C99 _Bool type also has size 1.

config HAVE_CXX
	bool "Have C++ compiler"
	default n
	---help---
		Toolchain supports C++ and CXX, CXXFLAGS, and COMPILEXX have been
		defined in the configurations Make.defs file.

if HAVE_CXX

choice CXX_VERSION
	prompt "c++version"
	default CXX_VERSION_11

config CXX_VERSION_11
	bool "c++11"

config CXX_VERSION_14
	bool "c++14"

config CXX_VERSION_17
	bool "c++17"

endchoice

config CXX_NEWLONG
	bool "size_t is type long"
	default n
	---help---
		size_t may be type long or type int.  This matters for some
		C++ library routines because the TinyAra size_t might not have
		the same underlying type as your toolchain's size_t.


comment "LLVM C++ Library (libcxx)"

config LIBCXX
	bool "Build LLVM libcxx"
	default n
	select HAVE_CXXINITIALIZE if BUILD_FLAT
	select BINFMT_CONSTRUCTORS if APP_BINARY_SEPARATION
	---help---
		LLVM libc++ can be built by selecting this option.

if LIBCXX

config LIBCXX_EXCEPTION
	bool "Enable Exception Suppport"
	default y
	---help---
		Enable exception support in libc++.

		NOTE:  Enabling can cause crashes due to cross-compiler 'arm-none-eabi-g++' version (10.3.1).
		If you are enabling C++ exception then use docker image version 2.0.0. Use
		menuconfig (Build Setup -> Docker Image Version) to set CONFIG_DOCKER_VERSION=2.0.0

config LIBCXX_FILESYSTEM
    bool "Enable full filesystem support"
    default n
    depends on CXX_VERSION_17
    ---help---
        Enable std::filesystem directory operations, iterators, and file status
        functions. This requires sys/statvfs.h and related system calls, which are not currently available.
        Without statvfs.h, enabling this flag will result in build errors.

        When disabled, basic path manipulation support is still available
        (path, filesystem_error, filesystem_clock).

        Note: Filesystem is a C++17 feature and requires CONFIG_CXX_VERSION_17.

config LIBCXX_TIME_UTC
    bool "Enable C++17 UTC time support"
    default n
    depends on CXX_VERSION_17
    ---help---
        Enable std::timespec and std::timespec_get support (C++17).
        Requires TizenRT C library to provide timespec_get() and TIME_UTC.
        Currently TizenRT does not provide these, so this must remain disabled
        until they are implemented in the C library.

choice LIBCXX_RTTI_MODE
	prompt "RTTI mode"
	default LIBCXX_RTTI_AUTO
	---help---
		Control RTTI (Run-Time Type Information) behavior in libc++.

		Auto-detect (default): Reads the compiler's __GXX_RTTI macro to
		determine if -frtti or -fno-rtti was passed from your board config.

		Force enabled: Always enable RTTI regardless of compiler flags.
		You must ensure -frtti is in your board's CXXFLAGS.

		Force disabled: Always disable RTTI regardless of compiler flags.
		Useful for minimizing code size even if -frtti is in CXXFLAGS.
		Disabling RTTI reduces code size.

config LIBCXX_RTTI_AUTO
	bool "Auto-detect from compiler flags (recommended)"

config LIBCXX_RTTI_FORCE_ON
	bool "Force RTTI enabled"

config LIBCXX_RTTI_FORCE_OFF
	bool "Force RTTI disabled"

endchoice

choice LIBCXX_HARDENING_MODE
	prompt "libc++ hardening mode"
	default LIBCXX_HARDENING_DISABLED
	---help---
		Select the hardening mode for libc++ containers and algorithms.
		Modes are mutually exclusive.

		- Disabled: No runtime checks (production, minimal code size)
		- Hardened: Production security (security-critical checks only)
		- Assertions: Safe mode for development (all checks enabled)
		- Debug: Testing mode (comprehensive checks, may affect complexity)

config LIBCXX_HARDENING_DISABLED
	bool "Disabled (recommended for production)"
	---help---
		No runtime checks. Optimal performance and minimal code size.
		Recommended for production builds.

config LIBCXX_HARDENING_HARDENED
	bool "Hardened Mode"
	---help---
		Enable security-critical checks for production.
		Catches: invalid input ranges, invalid element access.
		Does NOT catch: overlapping ranges, allocator compatibility.

config LIBCXX_HARDENING_ASSERTIONS
	bool "Assertions (Safe Mode)"
	---help---
		Enable all runtime assertion checks. Good for development.
		Catches: invalid ranges, out-of-bounds access, overlapping ranges,
		compatible allocator issues, and internal invariants.

config LIBCXX_HARDENING_DEBUG
	bool "Debug Mode"
	---help---
		Enable comprehensive checks for testing.
		Includes all hardened checks plus overlapping ranges,
		allocator compatibility, and internal invariants.
		May change algorithm complexity (e.g., O(1) to O(n)).

endchoice

config LIBCXX_HARDENING_VERBOSE
	bool "Enable verbose assertion messages"
	default y
	depends on !LIBCXX_HARDENING_DISABLED
	---help---
		Include detailed messages in assertion failures.
		Increases code size due to string storage.

config LIBCXX_IOSTREAM_BUFSIZE
	int "IO Stream Buffer Size"
	default 32

config LIBCXX_HAVE_LIBSUPCXX
	bool "Have libsupc++ (required)"
	default y
	---help---
		Select if your toolchain provides libsupc++.  This option is required
		at present because the built-in libsupc++ support is incomplete.


choice LIBCXX_PSTL_BACKEND
	prompt "Parallel STL CPU Backend"
	default LIBCXX_PSTL_BACKEND_SERIAL
	---help---
		Select the Parallel STL (PSTL) CPU backend for C++17 parallel algorithms.
		SERIAL is recommended for embedded systems.

config LIBCXX_PSTL_BACKEND_SERIAL
	bool "Serial (No Parallelism)"
	---help---
		Execute all parallel algorithms sequentially.		
		Recommended for embedded systems:
		- No threading overhead
		- Minimal code size
		- No pthread dependency for parallel algorithms
		- Deterministic execution		
		Use this when: No multi-threading support or constrained resources.

config LIBCXX_PSTL_BACKEND_THREAD
	bool "Thread (std::thread based)"
	---help---
		Use std::thread for actual parallel execution.		
		Requires:
		- Full pthread implementation
		- Thread pool infrastructure
		- Sufficient memory for thread stacks		
		Use this when: Multi-core CPU with full threading support.

config LIBCXX_PSTL_BACKEND_LIBDISPATCH
	bool "libdispatch (Apple's Grand Central Dispatch)"
	---help---
		Use Apple's Grand Central Dispatch for parallel execution.		
		NOTE: Not available on TizenRT - requires Apple's libdispatch library.

endchoice

endif

endif
```

## loadable_apps/loadable_sample/Kconfig
```kconfig
#
# For a description of the syntax of this configuration file,
# see kconfig-language at https://www.kernel.org/doc/Documentation/kbuild/kconfig-language.txt
#

menuconfig EXAMPLES_LOADABLE
	bool "Enable Loadable Test Scenarios"
	default n
	depends on APP_BINARY_SEPARATION
	---help---
		Enable Loadable Examples

if EXAMPLES_LOADABLE
config EXAMPLES_LOADABLE_MANUAL_TEST
	bool "Manual Various Tests"
	default y
	depends on !EXAMPLES_LOADABLE_AUTOMATIC_TEST
	---help---
		Enable Manual Various Tests.
		User can run various tests manually.
		Test scenarios : Messaging Test / Binary Recovery Test / Binary Update Test

if EXAMPLES_LOADABLE_MANUAL_TEST
config EXAMPLES_MESSAGING_TEST
	bool "Messaging Framework Test"
	default y
	depends on MESSAGING_IPC
	---help---
		Enable the Messaging Framework Test"

if EXAMPLES_MESSAGING_TEST
config MESSAGING_TEST_REPETITION_NUM
	int "Messaging F/W Test Repetition Number"
	default 1
	---help---
		Messaging F/W Test repetition number.
		If set to 0(zero) or negative number, test runs infinitely.
endif

config EXAMPLES_RECOVERY_TEST
	bool "Binary Manager Recovery example"
	default y
	depends on BINMGR_RECOVERY
	select EXAMPLES_MPU_TEST
	select DRIVERS_KERNEL_TEST
	---help---
		Enable the Binary Manager Recovery test

config EXAMPLES_BINARY_UPDATE_TEST
	bool "Binary Update example"
	default n
	depends on BINMGR_UPDATE
	---help---
		Enable Binary Update example

endif #EXAMPLES_LOADABLE_MANUAL_TEST

config EXAMPLES_LOADABLE_AUTOMATIC_TEST
	bool "Automatic Various Tests"
	default n
	---help---
		Enable Automatic Test.
		Only One test can run at a time.
		Test scenarios : Binary Recovery Aging Test / Binary Update Aging Test / Micom Timer Test

if EXAMPLES_LOADABLE_AUTOMATIC_TEST
choice
	prompt "Automatic tests selection"
	default ENABLE_RECOVERY_AGING_TEST

config EXAMPLES_RECOVERY_AGING_TEST
	bool "Recovery Aging test"
	depends on BINMGR_RECOVERY
	select EXAMPLES_MPU_TEST
	select DRIVERS_KERNEL_TEST
	---help---
		Enable Recovery Aging test. Another Test cannot run at the same time.

config EXAMPLES_UPDATE_AGING_TEST
	bool "Update Aging test"
	depends on BINMGR_UPDATE
	---help---
		Enable Update Aging test. Another Test cannot run at the same time.

config EXAMPLES_MICOM_TIMER_TEST
	bool "Micom Timer Test"
	---help---
		Enable Timer test in micom app.
		If this test is enabled, another test will not run.
endchoice

if EXAMPLES_MICOM_TIMER_TEST
config EXAMPLES_MICOM_TIMER_REPEAT
	string "Repetition Number of Micom Timer Test"
	default 10
	---help---
		Repetition Number of Micom Timer Test

config EXAMPLES_MICOM_TIMER_INTERVAL
	string "Interval for Micom Timer Test"
	default 100
	---help---
		Time Interval for testing Timer.
		Interval is based on microsecond.
endif #EXAMPLES_MICOM_TIMER_TEST

endif #EXAMPLES_LOADABLE_AUTOMATIC_TEST
endif #EXAMPLES_LOADABLE
```

## loadable_apps/loadable_sample/micomapp/Kconfig
```kconfig
#
# For a description of the syntax of this configuration file,
# see kconfig-language at https://www.kernel.org/doc/Documentation/kbuild/kconfig-language.txt
#

menuconfig APP1_INFO
	bool "App1 Information"
	default y
	---help---
		Set App1 Information

if APP1_INFO
config APP1_BIN_NAME
	string "App1 binary name"
	default "app1"
	---help---
		App1 Binary Name

config APP1_BIN_TYPE
	string "App1 binary type"
	default "ELF"
	---help---
		App1 Binary Type. Currently, only support for ELF.

config APP1_BIN_VER
	int "App1 binary version(YYMMDD)"
	default 190412
	---help---
		App1 Binary version(YYMMDD format)

config APP1_BIN_DYN_RAMSIZE
	int "App1 binary Dynamic RAM size"
	default 512000
	---help---
		App1 Binary Dynamic RAM size

config APP1_BIN_LOADING_PRIORITY
	string "App1 binary Loading Priority"
	default "HIGH"
	---help---
		App1 Binary Loading Priority.
		HIGH(or H), MID(or M) and LOW(or L) can be.

config APP1_MAIN_STACKSIZE
	int "Main Task Stacksize of App1 Binary"
	default 4096
	---help---
		Main Task Stacksize of App1 Binary

config APP1_MAIN_PRIORITY
	int "Main Task Priority of App1 Binary"
	default 220
	---help---
		Main Task Priority of App1 Binary

endif
```

## loadable_apps/loadable_sample/wifiapp/Kconfig
```kconfig
#
# For a description of the syntax of this configuration file,
# see kconfig-language at https://www.kernel.org/doc/Documentation/kbuild/kconfig-language.txt
#

menuconfig APP2_INFO
	bool "App2 Information"
	default y
	---help---
		Set App2 Information

if APP2_INFO
config APP2_BIN_NAME
	string "App2 binary name"
	default "app2"
	---help---
		App2 Binary Name

config APP2_BIN_TYPE
	string "App2 binary type"
	default "ELF"
	---help---
		App2 Binary Type. Currently, only support for ELF.

config APP2_BIN_VER
	int "App2 binary version(YYMMDD)"
	default 190412
	---help---
		App2 Binary version(YYMMDD format)

config APP2_BIN_DYN_RAMSIZE
	int "App2 binary Dynamic RAM size"
	default 512000
	---help---
		App2 Binary Dynamic RAM size

config APP2_BIN_LOADING_PRIORITY
	string "App2 binary Loading Priority"
	default "HIGH"
	---help---
		App2 Binary Loading Priority.
		HIGH(or H), MID(or M) and LOW(or L) can be.

config APP2_MAIN_STACKSIZE
	int "Main Task Stacksize of App2 Binary"
	default 8192
	---help---
		Main Task Stacksize of App2 Binary

config APP2_MAIN_PRIORITY
	int "Main Task Priority of App2 Binary"
	default 180
	---help---
		Main Task Priority of App2 Binary

endif
```

## os/Kconfig.runtime
```kconfig
#
# For a description of the syntax of this configuration file,
# see kconfig-language at https://www.kernel.org/doc/Documentation/kbuild/kconfig-language.txt
#

source "$EXTERNALDIR/iotjs/config/tizenrt/Kconfig.runtime"
```
