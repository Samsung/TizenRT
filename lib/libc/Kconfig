## os/arch/arm/src/bcm4390x/Kconfig
```kconfig
#
# For a description of the syntax of this configuration file,
# see kconfig-language at https://www.kernel.org/doc/Documentation/kbuild/kconfig-language.txt
#

comment "BCM4390x Configuration Options"

# Summary Configurations

# Chip Selection

choice
	prompt "Cypress BCM4390x Chip Selection"
	default ARCH_CHIP_BCM43907

config ARCH_CHIP_BCM43907
	bool "Cypress BCM43907"
	select BCM4390X_BCM43907
	select BOOT_RESULT

config ARCH_CHIP_BCM43909
	bool "Cypress BCM43909"
	select BCM4390X_BCM43909
	select BOOT_RESULT

endchoice # Cypress BCM4390X Chip Selection

# These hidden selections represent automatically selected MCU families and,
# in turn, select general capabilities of the MCU family

config BOOT_RESULT
	bool
	default y

config BCM4390X_BCM43907
	bool
	default n
	select ARCH_CORTEXR4
	select ARMV7R_ICACHE
	select ARMV7R_DCACHE
	select ARCH_HAVE_RESET
	select BCM4390X_HAVE_UART0
	select BCM4390X_HAVE_UART1
	select BCM4390X_HAVE_UART2

config BCM4390X_BOOT_RESULT_ADDR
	hex "boot result address (physical)"
	default 0x6A0000
	depends on BOOT_RESULT

config BCM4390X_BCM43909
	bool
	default n
	select ARCH_CORTEXR4
	select ARMV7R_ICACHE
	select ARMV7R_DCACHE
	select ARC_HAVE_RESET
	select BCM4390X_HAVE_UART0
	select BCM4390X_HAVE_UART1
	select BCM4390X_HAVE_UART2

config ARMCR4_CYCLE_COUNTER_REG
	hex "Cpu clock Register address"
	default 0x18003028

config BCM4390X_USE_EXTMEM
	bool "Use external DDR memory"
	default n
	---help---
		If the board uses external DDR RAM memory, enable this.

config BCM4390X_DVFS
	bool "CPU DVFS Support interface"
	default n
	select ARCH_USE_DVFS
	---help---
		BCM4390x has 7 different frequency, This interface
		helps to switch among them. Say Y here, if you want.


menu "BCM4390x Peripheral Support"

# These "hidden" settings determine peripheral options
# that are available for the selected MCU.

# BCM43907 and BCM43909 are almost identical and
# we have no features different between them for now.

config BCM4390X_HAVE_UART0
        bool
        default n

config BCM4390X_HAVE_UART1
        bool
        default n

config BCM4390X_HAVE_UART2
        bool
        default n

config BCM4390X_UART0
	bool "UART0 (Slow UART)"
	default n
	depends on BCM4390X_HAVE_UART0
	select ARCH_HAVE_UART0
	select ARCH_HAVE_SERIAL_TERMIOS
	---help---
		Enable Slow UART0

config BCM4390X_UART1
	bool "UART1 (Fast UART)"
	default n
	depends on BCM4390X_HAVE_UART1
	select ARCH_HAVE_UART1
	select ARCH_HAVE_SERIAL_TERMIOS
        ---help---
                Enable Fast UART1

config BCM4390X_UART2
	bool "UART2 (GCI UART)"
	default n
	depends on BCM4390X_HAVE_UART2
	select ARCH_HAVE_UART2
	select ARCH_HAVE_SERIAL_TERMIOS
	 ---help---
                Enable GCI UART2

config BCM4390X_I2C
	bool
	depends on BCM4390X_I2C0 || BCM4390X_I2C1
	default n

config BCM4390X_I2C0
	bool "I2C0"
	depends on I2C
	select BCM4390X_I2C
	default n

config BCM4390X_I2C1
	bool "I2C1"
	depends on I2C
	select BCM4390X_I2C
	default n

config BCM4390X_I2S
	bool "I2S"
	select I2S
	select AUDIO
	default n

config BCM4390X_PWM
	bool "PWM"
	depends on PWM
	default n

config BCM4390X_SPI
	bool
	depends on BCM4390X_SPI0 || BCM4390X_SPI1
	default n

config BCM4390X_SPI0
	bool "SPI0"
	depends on SPI
        select BCM4390X_SPI
	default y

config BCM4390X_SPI1
	bool "SPI1"
	depends on SPI
        select BCM4390X_SPI
	default n

config BCM4390X_GPIO
	bool "GPIO"
	depends on GPIO
	default y

config CY4390X_RECFG_PWM_TO_GPIO
	bool "reconfig for pwm gpio"
	depends on BCM4390X_GPIO
	default n

config CY4390X_USE_PWM0_TO_GPIO18
	bool "use pwm0 to gpio18"
	depends on CY4390X_RECFG_PWM_TO_GPIO
	default n

config CY4390X_USE_PWM1_TO_GPIO19
	bool "use pwm1 to gpio19"
	depends on CY4390X_RECFG_PWM_TO_GPIO
	default n

config CY4390X_USE_PWM2_TO_GPIO20
	bool "use pwm2 to gpio20"
	depends on CY4390X_RECFG_PWM_TO_GPIO
	default n

config CY4390X_USE_PWM3_TO_GPIO21
	bool "use pwm3 to gpio21"
	depends on CY4390X_RECFG_PWM_TO_GPIO
	default n

config CY4390X_USE_PWM4_TO_GPIO22
	bool "use pwm4 to gpio22"
	depends on CY4390X_RECFG_PWM_TO_GPIO
	default n

config CY4390X_USE_PWM5_TO_GPIO23
	bool "use pwm5 to gpio23"
	depends on CY4390X_RECFG_PWM_TO_GPIO
	default n

config BCM4390X_GPIO_LOG
	bool "debug log for GPIO"
	depends on DEBUG
	default n

config BCM4390X_GPIO_COUNT
	int "Number of GPIO"
	depends on BCM4390X_GPIO
	default 16

config BCM4390X_SFLASH
	bool "Serial Flash controller"
	default n

config BCM4390X_BOOTLOADER_REGION_SIZE
	int "Bootloader size(KB)"
	depends on BCM4390X_SFLASH
	default 4128

config BCM4390X_WDT
	bool "WATCHDOG"
	select WATCHDOG
	default y

config BCM4390X_WIRELESS
	bool "Wireless"
	default n

config BCM4390X_M2M
	bool "M2M"
	default y

endmenu # BCM4390x Peripheral Support
```

## os/arch/arm/src/lm3s6965-ek/Kconfig
```kconfig
#
# For a description of the syntax of this configuration file,
# see kconfig-language at https://www.kernel.org/doc/Documentation/kbuild/kconfig-language.txt
#

if ARCH_BOARD_LM3S6965EK

choice
	bool "Build for qemu hardware"
	default QEMU_NONE

config QEMU_NONE
	bool "NONE"
	---help---
		Build for FLASH 256K, SRAM 64K.
		Dont build for Qemu Hardware.

config QEMU_FLASH_512K_SRAM_128K
	bool "FLASH 512K, SRAM 128K"
	---help---
		Build for FLASH 512K, SRAM 128K QEMU Hardware.

config QEMU_FLASH_2400K_SRAM_946K
	bool "FLASH 2400K, SRAM 722K"
	---help---
		Build for FLASH 2400K, SRAM 946K QEMU Hardware.

config QEMU_FLASH_128M_SRAM_16M
	bool "FLASH 128M, SRAM 16M"
	---help---
		Build for FLASH 128M, SRAM 16M QEMU Hardware.

endchoice
endif
```

## os/arch/arm/src/qemu-mps2-an505/Kconfig
```kconfig
#
# For a description of the syntax of this configuration file,
# see kconfig-language at https://www.kernel.org/doc/Documentation/kbuild/kconfig-language.txt
#

comment "QEMU MPS2 AN505 Chipset Options"

if ARCH_CHIP_QEMU_MPS2_AN505

menu "QEMU MPS2 AN505 Configuration"

config QEMU_MPS2_AN505_PROFILE_BK7239N
	bool "BK7239N execution profile"
	default y
	---help---
		Select the qemu-mps2-an505 execution profile intended to model the
		bk7239n software environment on a Cortex-M33 QEMU board.

config QEMU_MPS2_AN505_SECURE_STATE
	bool "Boot TizenRT in secure state"
	default y if QEMU_MPS2_AN505_PROFILE_BK7239N
	default n
	select ARMV8M_SECURE_STATE
	---help---
		QEMU mps2-an505 currently boots the kernel directly in Secure state.
		Keep the ARMv8-M exception-return template aligned with that runtime
		behavior so kernel threads can start correctly.

config QEMU_MPS2_AN505_CPU_CLOCK
	int "QEMU mps2-an505 core clock (Hz)"
	default 25000000 if QEMU_MPS2_AN505_PROFILE_BK7239N
	default 25000000
	---help---
		Core clock used by the SysTick runtime and default runtime timing
		assumptions for the qemu-mps2-an505 Cortex-M33 platform.

config QEMU_MPS2_AN505_UART_CLOCK
	int "QEMU mps2-an505 UART clock (Hz)"
	default QEMU_MPS2_AN505_CPU_CLOCK
	---help---
		Input clock used to program the CMSDK APB UART baud divider.

config QEMU_MPS2_AN505_CMSDK_UART
	bool "CMSDK APB UART support"
	default y if QEMU_MPS2_AN505_PROFILE_BK7239N
	default y
	select ARCH_HAVE_UART0
	select ARCH_HAVE_SERIAL_TERMIOS
	---help---
		Enable the in-tree CMSDK APB UART driver for the non-secure UART0
		instance on the qemu-mps2-an505 board.

config QEMU_MPS2_AN505_LOADABLE_LOADER
	bool "Seed loadable/XIP runtime loader helpers"
	default y if QEMU_MPS2_AN505_PROFILE_BK7239N
	default n
	---help---
		Build the lightweight qemu-mps2-an505 loader hook used as the Phase 4
		runtime stub for later loadable and XIP bring-up work.

endmenu # "QEMU MPS2 AN505 Configuration"

endif # ARCH_CHIP_QEMU_MPS2_AN505
```

## os/arch/arm/src/qemu-virt/Kconfig
```kconfig
#
# For a description of the syntax of this configuration file,
# see kconfig-language at https://www.kernel.org/doc/Documentation/kbuild/kconfig-language.txt
#

comment "QEMU Virt Chipset Options"

if ARCH_CHIP_QEMU_ARM_VIRT

menu "Qemu Virt Configuration"

config QEMU_VIRT_PROFILE_RTL8730E
	bool "RTL8730E execution profile"
	default y
	---help---
		Select the qemu-virt execution profile intended to model the
		rtl8730e software environment on an A-profile QEMU virt machine.

config QEMU_VIRT_CPU_MODEL
	string "QEMU virt CPU model"
	default "cortex-a15" if QEMU_VIRT_PROFILE_RTL8730E
	default "cortex-a15"
	---help---
		CPU model passed to QEMU for the qemu-virt runtime.

config QEMU_VIRT_MEMORY_MB
	int "QEMU virt memory size (MiB)"
	range 32 4096
	default 64 if QEMU_VIRT_PROFILE_RTL8730E
	default 64
	---help---
		Guest memory size passed to QEMU for the qemu-virt runtime.

config QEMU_VIRT_SMP_DEFAULT
	int "Default CPU count for qemu-virt SMP"
	range 1 4
	default 2 if QEMU_VIRT_PROFILE_RTL8730E
	default 1
	---help---
		Fallback CPU count used by qemu-virt runtime helpers when SMP is
		enabled but CONFIG_SMP_NCPUS is not explicitly set in a defconfig.

config QEMU_VIRT_ARCH_TIMER_FREQ
	int "Architected timer frequency"
	default 62500000 if QEMU_VIRT_PROFILE_RTL8730E
	default 62500000
	---help---
		Architected timer frequency used by the qemu-virt timer driver.

config QEMU_VIRT_MOUNT_FLASH_PARTITIONS
	bool "Mount flash partitions during board init"
	default y if QEMU_VIRT_PROFILE_RTL8730E
	default y
	---help---
		Initialize the in-tree CFI-backed flash layout and mount the runtime
		filesystems during board initialization.

config QEMU_VIRT_INIT_FTL
	bool "Initialize FTL during board init"
	depends on FTL_ENABLED
	default y if QEMU_VIRT_PROFILE_RTL8730E
	default y if FTL_ENABLED
	---help---
		Run the generic FTL initialization step during board initialization.

config QEMU_VIRT_INIT_VIRTIO_BLK_AT_BOOT
	bool "Initialize virtio-blk during board init"
	depends on QEMU_VIRT_VIRTIO_BLK
	default y if QEMU_VIRT_PROFILE_RTL8730E
	default y if QEMU_VIRT_VIRTIO_BLK
	---help---
		Bring up the virtio-blk transport during board initialization so the
		runtime environment matches the rtl8730e execution profile assumptions.

if BOOT_RUNFROMSDRAM
config QEMU_KERNEL_LOAD_ADDR
	hex "Kernel Load address"
	default 0x40100000
endif #BOOT_RUNFROMSDRAM

choice
	prompt "Qemu Core Configuration"
	default ARCH_CHIP_QEMU_CORTEXA15

config ARCH_CHIP_QEMU_CORTEXA15
	bool "Qemu virtual Processor (cortex-a15)"
	select ARCH_CORTEXA15
	select ARCH_HAVE_ADDRENV
	select ARCH_HAVE_ELF_EXECUTABLE
	select ARCH_HAVE_LOWVECTORS
	select ARCH_HAVE_MULTICPU
	select ARCH_NEED_ADDRENV_MAPPING
	select ARM_HAVE_NEON
	select ARM_HAVE_PSCI
	select ARMV7A_HAVE_GICv2
	select ARCH_HAVE_FPU
	select ARMV7A_HAVE_GTM
	select ARMV7A_HAVE_PTM
	select ARCH_BOARD_HAVE_SECOND_FLASH

endchoice

config ARCH_CHIP_QEMU_TRUSTZONE
	bool "Enable Arm Security Extensions (TrustZone)"
	select ARCH_HAVE_TRUSTZONE
	default n
	---help---
		Doc: https://qemu-project.gitlab.io/qemu/system/arm/virt.html
		shows that set secure=on/of can emulating a guest CPU which
		implements the Arm Security Extensions (TrustZone).
		The default is off. And this config can enable/disable
		TrustZone in qemu chip.
		(Currently not supported.)

config ARM_HAVE_PSCI
	bool "ARM PSCI (Power State Coordination Interface) Support"
	default n
	---help---
		This Power State Coordination Interface (PSCI) defines
		a standard interface for power management. the PCSI need
		to implement handling firmware at EL2 or EL3. The option
		maybe not applicable for arm core without PCSI firmware
		interface implement

config ARM_PSCI
	bool "Enabled PSCI"
	depends on ARM_HAVE_PSCI
	default y if QEMU_VIRT_PROFILE_RTL8730E
	default n
	---help---
		See ARM_HAVE_PSCI for details


menuconfig UART_PL011
	bool "PL011 Chip support"
	default y if QEMU_VIRT_PROFILE_RTL8730E
	default n

if UART_PL011
source "arch/arm/src/qemu-virt/Kconfig-pl011"
endif

# Virtio support
source "arch/arm/src/qemu-virt/virtio/Kconfig"

endmenu # "Qemu Virt Configuration"

endif # ARCH_CHIP_QEMU_ARM_VIRT
```

## os/arch/arm/src/qemu-virt/virtio/Kconfig
```kconfig
# QEMU Virtio support
#

config QEMU_VIRT_VIRTIO
	bool "Virtio support for QEMU Virt machine"
	default y
	help
	  Enable Virtio support for QEMU Virt machine.
	  This enables the generic virtio-mmio framework and
	  device drivers for virtio devices.

if QEMU_VIRT_VIRTIO

config QEMU_VIRT_VIRTIO_BLK
	bool "Virtio block device support"
	default y
	help
	  Enable Virtio block device support.
	  This enables the virtio-blk driver for block devices
	  connected via virtio-mmio transport.

endif # QEMU_VIRT_VIRTIO
```
