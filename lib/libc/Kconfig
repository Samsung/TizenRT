## os/arch/arm/src/armino/Kconfig
```kconfig
#
# For a description of the syntax of this configuration file,
# see kconfig-language at https://www.kernel.org/doc/Documentation/kbuild/kconfig-language.txt
#

comment "ARMINO Configuration Options"

choice
	prompt "ARMINO Chip Selection"
	default ARCH_CHIP_BK7239N
	depends on ARCH_CHIP_ARMINO

config ARCH_CHIP_BK7239N
	bool "BK7239N"
	select ARCH_CORTEXM33
	select ARMV8M_HAVE_ICACHE
	select ARMV8M_HAVE_DCACHE

endchoice


menu "Beken BK7239N Peripheral Support"

config ARMINO_UART
	bool "UART"
	default n

config ARMINO_UART0
	bool "UART 0"
	default n
	select ARMINO_UART
	select ARCH_HAVE_UART0
	select ARCH_HAVE_SERIAL_TERMIOS

config ARMINO_UART1
	bool "UART 1"
	default n
	select ARMINO_UART
	select ARCH_HAVE_UART1
	select ARCH_HAVE_SERIAL_TERMIOS	

config ARMINO_UART2
	bool "UART 2"
	default n
	select ARMINO_UART
	select ARCH_HAVE_UART2
	select ARCH_HAVE_SERIAL_TERMIOS

menu "ARMINO BLE Support"
config ARMINO_BLE
	bool "Enable ARMINO BLE"
	default n
endmenu

config ARMINO_I2S
	bool "Enable Armino I2S"
	default n

if ARMINO_I2S
config ARMINO_I2S_RX
	bool "Enable I2S RX"
	default n

config ARMINO_I2S_TX
	bool "Enable I2S TX"
	default n

config ARMINO_I2S_ROLE_MASTER
	bool "Enable Armino I2S master role"
	default n
	---help---
		Enable Armino I2S work in master role
endif

endmenu
```

## os/arch/arm/src/artik053/Kconfig
```kconfig
config ARTIK053_BOOT_FAILURE_DETECTION
	bool "Clear bootcount when boot completes"
	default y
	---help---
		BL2 sets up a watchdog before it jumps to TinyARA to detect
		boot failures. On a successful boot, the secondary OS should
		turn the watchdog off and clear the bootcount register that
		stores the number of tries to boot. Otherwise, the watchdog
		will bark and BL2 may go into recovery mode.

config ARTIK053_BOOT_COUNTS_ADDR
	hex "Address of scratch pad register to store the bootcount"
	default 0x80090810
	depends on ARTIK053_BOOT_FAILURE_DETECTION
	---help---
		The number of tries to boot will be stored in this address.
		On successful boot, it is cleared to zero. The register should
		be kept intact even on watchdog resets.

config ARTIK053_FLASH_CAPACITY
	int "Size of external flash memory (in bytes)"
	default 8388608
	depends on S5J_SFLASH
	---help---
		Sets the capacity of the external flash memory
		on the ARTIK-053 Starter Kit board.

config ARTIK053_FLASH_PAGE_SIZE
	int "Page size of external flash memory (in bytes)"
	default 4096
	depends on S5J_SFLASH
	---help---
		Sets the page size of the external flash memory on the
		ARTIK-053 Starter Kit board. It can be the size of erase
		unit flash memory supports.

config ARTIK053_FLASH_PART
	bool "Enable partition support on FLASH"
	default n
	select MTD
	select MTD_PARTITION
	select MTD_PROGMEM
	depends on S5J_SFLASH
	---help---
		Enables creation of partitions on the FLASH

config ARTIK053_FLASH_MINOR
	int "Minor number for the FLASH device"
	default 0
	depends on ARTIK053_FLASH_PART
	---help---
		Sets the minor number for /dev node of the external flash
		device.

config ARTIK053_FLASH_PART_LIST
	string "Flash partition size list (in KBytes)"
	default "16,48,192,32,512,2400,1536,1536,1400,8,512,"
	depends on ARTIK053_FLASH_PART
	---help---
		Comma separated list of partition sizes in KB.

config ARTIK053_FLASH_PART_TYPE
	string "Flash partition type list"
	default "none,none,none,none,none,none,none,none,smartfs,config,none,"
	depends on ARTIK053_FLASH_PART
	---help---
		Comma separated list of partition types that can be one of
		followings: none, smartfs, config

config ARTIK053_FLASH_PART_NAME
	string "Flash partition name list"
	default "bl1,sssro,bl2,sssfw,wlanfw,os,factory,ota,user,nvram,sssrw,"
	depends on MTD_PARTITION_NAMES
	depends on ARTIK053_FLASH_PART
	---help---
		Comma separated list of partition names.

config ARTIK053_AUTOMOUNT
	bool "Automount partitions"
	default n
	depends on ARTIK053_FLASH_PART
	depends on !DISABLE_MOUNTPOINT
	---help---
		If enabled, mount userrw and sssrw partitions at boot.

config ARTIK053_AUTOMOUNT_USERFS
	bool "Automount user r/w partiton"
	default n
	depends on ARTIK053_AUTOMOUNT
	depends on FS_SMARTFS
	---help---
		If enabled, user r/w partition will be mounted automatically
		at boot.

config ARTIK053_AUTOMOUNT_USERFS_DEVNAME
	string "Device name of the partition for user r/w file system"
	default "/dev/smart0p8"
	depends on ARTIK053_AUTOMOUNT_USERFS
	---help---
		Specifies the device name (/dev/smart0pX) of the partition
		for user r/w file system.

config ARTIK053_AUTOMOUNT_USERFS_MOUNTPOINT
	string "Mountpoint of the partition for user r/w file system"
	default "/mnt"
	depends on ARTIK053_AUTOMOUNT_USERFS
	---help---
		Specifies the mount point where user r/w file system
		will be mounted at.

config ARTIK053_AUTOMOUNT_ROMFS
	bool "Automount romfs partiton"
	default y
	depends on ARTIK053_AUTOMOUNT
	depends on FS_ROMFS
	---help---
		If enabled, romfs partition will be mounted automatically
		at boot.

config ARTIK053_AUTOMOUNT_ROMFS_DEVNAME
	string "Device name of the partition for romfs file system"
	default "/dev/mtdblock9"
	depends on ARTIK053_AUTOMOUNT_ROMFS
	---help---
		Specifies the device name (/dev/mtdblock9) of the partition
		for romfs file system.

config ARTIK053_AUTOMOUNT_ROMFS_MOUNTPOINT
	string "Mountpoint of the partition for romfs file system"
	default "/rom"
	depends on ARTIK053_AUTOMOUNT_ROMFS
	---help---
		Specifies the mount point where romfs file system
		will be mounted at.

if RAMMTD
config ARTIK053_RAMMTD_NEBLOCKS
	int "RAM MTD erase block count"
	default 64
	---help---
		Ramfs size will be RAMMTD_ERASESIZE * SIDK_ARTIK053_RAMMTD_NEBLOCKS.
		You have to consider total ramsize to alloc ramfs size.

config ARTIK053_RAMMTD_DEV_NUMBER
	int "device number for mtd of smartfs"
	default 3

config ARTIK053_RAMMTD_DEV_POINT
	string "Device name of the partition for ramfs r/w file system"
	default "/dev/smart3"

config ARTIK053_RAMMTD_MOUNT_POINT
	string "Mountpoint of the partition for ramfs r/w file system"
	default "/ramfs"
endif
```

## os/arch/arm/src/artik05x/Kconfig
```kconfig
#
# For a description of the syntax of this configuration file,
# see kconfig-language at https://www.kernel.org/doc/Documentation/kbuild/kconfig-language.txt
#

config ARTIK05X_BOOT_FAILURE_DETECTION
	bool "Clear bootcount when boot completes"
	default y
	---help---
		BL2 sets up a watchdog before it jumps to TinyARA to detect
		boot failures. On a successful boot, the secondary OS should
		turn the watchdog off and clear the bootcount register that
		stores the number of tries to boot. Otherwise, the watchdog
		will bark and BL2 may go into recovery mode.

config ARTIK05X_BOOT_COUNTS_ADDR
	hex "Address of scratch pad register to store the bootcount"
	default 0x80090810
	depends on ARTIK05X_BOOT_FAILURE_DETECTION
	---help---
		The number of tries to boot will be stored in this address.
		On successful boot, it is cleared to zero. The register should
		be kept intact even on watchdog resets.

config ARTIK05X_FLASH_CAPACITY
	int "Size of external flash memory (in bytes)"
	default 8388608
	depends on S5J_SFLASH
	---help---
		Sets the capacity of the external flash memory
		on the ARTIK-05x Series Starter Kit board.

config ARTIK05X_FLASH_PAGE_SIZE
	int "Page size of external flash memory (in bytes)"
	default 4096
	depends on S5J_SFLASH
	---help---
		Sets the page size of the external flash memory on the
		ARTIK-05x Series Starter Kit board. It can be the size of erase
		unit flash memory supports.

config ARTIK05X_FLASH_PART
	bool "Enable partition support on FLASH"
	default n
	select MTD
	select MTD_PARTITION
	select MTD_PROGMEM
	depends on S5J_SFLASH
	depends on NFILE_DESCRIPTORS != 0
	---help---
		Enables creation of partitions on the FLASH

config ARTIK05X_FLASH_MINOR
	int "Minor number for the FLASH device"
	default 0
	depends on ARTIK05X_FLASH_PART
	---help---
		Sets the minor number for /dev node of the external flash
		device.

config ARTIK05X_FLASH_PART_LIST
	string "Flash partition size list (in KBytes)"
	default "16,48,192,32,512,2400,1536,1536,1400,8,512,"
	depends on ARTIK05X_FLASH_PART
	---help---
		Comma separated list of partition sizes in KB.

config ARTIK05X_FLASH_PART_TYPE
	string "Flash partition type list"
	default "none,none,none,none,none,none,none,none,smartfs,config,none,"
	depends on ARTIK05X_FLASH_PART
	---help---
		Comma separated list of partition types that can be one of
		followings: none, smartfs, config

config ARTIK05X_FLASH_PART_NAME
	string "Flash partition name list"
	default "bl1,sssro,bl2,sssfw,wlanfw,os,factory,ota,user,nvram,sssrw,"
	depends on MTD_PARTITION_NAMES
	depends on ARTIK05X_FLASH_PART
	---help---
		Comma separated list of partition names.

config ARTIK05X_AUTOMOUNT
	bool "Automount partitions"
	default n
	depends on ARTIK05X_FLASH_PART
	depends on !DISABLE_MOUNTPOINT
	---help---
		If enabled, mount userrw and sssrw partitions at boot.

config ARTIK05X_AUTOMOUNT_USERFS
	bool "Automount user r/w partiton"
	default n
	depends on ARTIK05X_AUTOMOUNT
	depends on FS_SMARTFS
	---help---
		If enabled, user r/w partition will be mounted automatically
		at boot.

config ARTIK05X_AUTOMOUNT_USERFS_DEVNAME
	string "Device name of the partition for user r/w file system"
	default "/dev/smart0p8"
	depends on ARTIK05X_AUTOMOUNT_USERFS
	---help---
		Specifies the device name (/dev/smart0pX) of the partition
		for user r/w file system.
		when SMARTFS_MULTI_ROOT_DIRS is enabled the device name
		will be appended by "d1" (/dev/smart0pxd1).

config ARTIK05X_AUTOMOUNT_USERFS_MOUNTPOINT
	string "Mountpoint of the partition for user r/w file system"
	default "/mnt"
	depends on ARTIK05X_AUTOMOUNT_USERFS
	---help---
		Specifies the mount point where user r/w file system
		will be mounted at.

config ARTIK05X_AUTOMOUNT_SSSRW
	bool "Automount secure storage partiton"
	default n
	depends on ARTIK05X_AUTOMOUNT
	---help---
		If enabled, secure storage partition will be mounted
		automatically at boot.

config ARTIK05X_AUTOMOUNT_SSSRW_DEVNAME
	string "Device name of the partition for secure storage"
	default "/dev/smart0p10"
	depends on ARTIK05X_AUTOMOUNT_SSSRW
	---help---
		Specifies the device name (/dev/smart0pX) of the partition
		for secure storage.

config ARTIK05X_AUTOMOUNT_SSSRW_MOUNTPOINT
	string "Mountpoint of the partition for secure storage"
	default "/sss"
	depends on ARTIK05X_AUTOMOUNT_SSSRW
	---help---
		Specifies the mount point where secure storage
		will be mounted at.

config ARTIK05X_AUTOMOUNT_ROMFS
	bool "Automount romfs partiton"
	default y
	depends on ARTIK05X_AUTOMOUNT
	depends on FS_ROMFS
	---help---
		If enabled, romfs partition will be mounted automatically
		at boot.

config ARTIK05X_AUTOMOUNT_ROMFS_DEVNAME
	string "Device name of the partition for romfs file system"
	default "/dev/mtdblock9"
	depends on ARTIK05X_AUTOMOUNT_ROMFS
	---help---
		Specifies the device name (/dev/mtdblock9) of the partition
		for romfs file system.

config ARTIK05X_AUTOMOUNT_ROMFS_MOUNTPOINT
	string "Mountpoint of the partition for romfs file system"
	default "/rom"
	depends on ARTIK05X_AUTOMOUNT_ROMFS
	---help---
		Specifies the mount point where romfs file system
		will be mounted at.

if RAMMTD
config ARTIK05X_RAMMTD_NEBLOCKS
	int "RAM MTD erase block count"
	default 64
	---help---
		Ramfs size will be RAMMTD_ERASESIZE * ARTIK05X_RAMMTD_NEBLOCKS.
		You have to consider total ramsize to alloc ramfs size.

config ARTIK05X_RAMMTD_DEV_NUMBER
	int "device number for mtd of smartfs"
	default 3

config ARTIK05X_RAMMTD_DEV_POINT
	string "Device name of the partition for ramfs r/w file system"
	default "/dev/smart3"

config ARTIK05X_RAMMTD_MOUNT_POINT
	string "Mountpoint of the partition for ramfs r/w file system"
	default "/ramfs"
endif
```
