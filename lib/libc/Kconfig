## os/binfmt/Kconfig
```kconfig
#
# For a description of the syntax of this configuration file,
# see kconfig-language at https://www.kernel.org/doc/Documentation/kbuild/kconfig-language.txt
#

config BINFMT_ENABLE
	bool "Enable BINFMT support"
	default n
	select LIBC_SYMTAB
	---help---
		By default, support for loadable binary formats is disable.  This logic
		may be build by defining this setting.

if BINFMT_ENABLE

config PATH_INITIAL
	string "Initial PATH Value"
	default ""
	depends on LIB_ENVPATH
	---help---
		The initial value of the PATH variable.  This is the colon-separated
		list of absolute paths.  E.g., "/bin:/usr/bin:/sbin"

config BINFMT_LOADABLE
	bool
	default n
	depends on APP_BINARY_SEPARATION
	---help---
		Automatically selected if a loadable binary format is selected.

config ELF
	bool "Enable the ELF Binary Format"
	default n
	select BINFMT_LOADABLE
	select LIBC_ARCH_ELF
	---help---
		Enable support for the ELF binary format.  Default: n

if ELF
source binfmt/libelf/Kconfig
endif

config BUILTIN
	bool "Support Builtin Applications"
	default n
	depends on (!BUILD_PROTECTED && !BUILD_KERNEL) || EXPERIMENTAL
	---help---
		Enable support for builtin applications.  This features assigns a string
		name to an application and in addition if FS_BINFS is defined, retaining
		those names in a file system from which they can be executed.  This feature
		is also the underlying requirement to support built-in applications in the
		NuttShell (NSH).

		ISSUES:  This feature is highly coupled with logic in the apps/
		sub-directory and, as a consequence, cannot be used in environments
		that do not include the standard apps/ nor in build
		configurations using BUILD_PROTECTED or BUILD_KERNEL.

if BUILTIN
source binfmt/libbuiltin/Kconfig
endif

config BINFMT_CONSTRUCTORS
	bool "C++ Static Constructor Support"
	default n
	depends on HAVE_CXX && SCHED_STARTHOOK && ELF
	---help---
		Build in support for C++ constructors in loaded modules.  Currently
		only support for ELF binary formats.

config SYMTAB_ORDEREDBYNAME
	bool "Symbol Tables Ordered by Name"
	default n
	---help---
		Select if the symbol table is ordered by symbol name.  In this case,
		the logic can perform faster lookups using a binary search.
		Otherwise, the symbol table is assumed to be un-ordered an only
		slow, linear searches are supported.

config OPTIMIZE_APP_RELOAD_TIME
        bool "Optimizations for application reload time"
        default y
        ---help---
		If this option is enabled, the app reload time is optimized by maintaining a backup
		of the data section in the apps RO region. During reload time, the ELF file is not
		accessed. Instead the RO sections which are already present in RAM are reused. The backup
		RW sections are copied to appropriate address and the new instance of the application is
		started. In order for this method to work, the RO regions must be strictly write protected
		using additional MPU regions. It must also be noted that all the memory regions need to
		have a size which is power of two and also need to be aligned to their size according to
		the MPU requirements. Hence, using this option can result in a steep increase in the memory
		requirement for this application.

config BINFMT_SECTION_UNIFIED_MEMORY
	bool "Allocate section memory as one chunk"
	depends on OPTIMIZE_APP_RELOAD_TIME
	depends on ARM_MPU
	default n
	---help---
		When this option is enabled, binary loader allocates one big memory chunk enough to contain each loading sections
		like text, ro, data and uses each loading sections address by pointer.
		When this option is disabled, by default, loader allocates separated memory for each section.
		In ARMv7m MPU, there are size and address alignment restrictions, so it can enhance memory usage efficiency.
		In ARMv8m MPU, there is no restriction about address alignment, it is not recommended to use this option.
		This option does not provide any advantage when MMU is being used.

config SAVE_BIN_SECTION_ADDR
	bool "Save binary section address"
	default n
	depends on APP_BINARY_SEPARATION
	---help---
		For debugging binary symbol, save the each section address.

endif # BINFMT_ENABLE
```
