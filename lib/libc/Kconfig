## os/arch/Kconfig.board
```kconfig
#
# For a description of the syntax of this configuration file,
# see kconfig-language at https://www.kernel.org/doc/Documentation/kbuild/kconfig-language.txt
#

choice
	prompt "Select target board"
	default ARCH_BOARD_SIDK_S5JT200
	---help---
		Select the board hosting the architecture.  You must first select the
		exact MCU part number, then the boards supporting that part will
		be available for selection.  Use ARCH_BOARD_CUSTOM to create a new
		board configuration.

config ARCH_BOARD_ARTIK053
	bool "Samsung ARTIK-053 Starter Kit"
	depends on ARCH_CHIP_S5JT200
	select SAMSUNG_NS2
	---help---
		Samsung ARTIK-053 Starter Kit based on S5JT200 IoT WiFi MCU

config ARCH_BOARD_LM3S6965EK
	bool "Stellaris LM3S6965 Evaluation Kit"
	depends on ARCH_CHIP_LM3S6965
	select ARCH_HAVE_LEDS
	---help---
		Stellaris LM3S6965 Evaluation Kit.  This board is based on the
		an ARM Cortex-M3 MCU, the Luminary/TI LM3S6965.

config ARCH_BOARD_SIDK_S5JT200
	bool "Samsung S5JT200 sidk board"
	depends on ARCH_CHIP_S5JT200
	select SAMSUNG_NS2
	select ARCH_HAVE_BUTTONS
	select ARCH_HAVE_IRQBUTTONS
	---help---
		Samsung S5JT200 IoT wifi MCU
endchoice

config ARCH_BOARD
	string
	default "artik053"           if ARCH_BOARD_ARTIK053
	default "lm3s6965-ek"        if ARCH_BOARD_LM3S6965EK
	default "sidk_s5jt200"       if ARCH_BOARD_SIDK_S5JT200

comment "Common Board Options"

config ARCH_HAVE_LEDS
	bool

config ARCH_LEDS
	bool "Board LED support"
	default y
	depends on ARCH_HAVE_LEDS
	---help---
		Use board LEDs to show TinyAra execution status state. Unique to boards that have LEDs

config ARCH_HAVE_BUTTONS
	bool

config ARCH_BUTTONS
	bool "Board button support"
	default n
	depends on ARCH_HAVE_BUTTONS
	---help---
		"Support interfaces to use buttons provided by the board."

config ARCH_HAVE_IRQBUTTONS
	bool

config ARCH_IRQBUTTONS
	bool "Button interrupt support"
	default n
	depends on ARCH_BUTTONS && ARCH_HAVE_IRQBUTTONS
	---help---
		"Support interrupts on button presses and releases."

config BOARD_CRASHDUMP
	bool "Enable Board level logging of crash dumps"
	default n
	---help---
		If selected up_asseert will call out to board_crashdump, in the case
		of an assertion failure, prior to calling exit. Or in the
		case of a hardfault prior to looping indefinitely. board_crashdump
		then has a chance to save the state of the machine.

		The purpose of board_crashdump is to save as much information as it can
		about the cause of the fault and then most likely reset the system.

		N.B. There is limited system resources that can be used, who knows
		what memory is trashed? So all we can expect to do is save the
		"machine state" in a place where on the next reset can write it
		to more sophisticated storage in a sane operating environment.

config LIB_BOARDCTL
	bool "Enable boardctl() interface"
	default n
	---help---
		Enables support for the boardctl() interface.  Architecture
		specific logic must provide board_app_initialize() interface.

if LIB_BOARDCTL

config BOARDCTL_POWEROFF
	bool "Enable power off interfaces"
	default n
	depends on ARCH_HAVE_POWEROFF
	---help---
		Enables support for the BOARDIOC_POWEROFF boardctl() command.
		Architecture specific logic must provide the board_power_off()
		interface.

config BOARDCTL_RESET
	bool "Enable reset interfaces"
	default n
	depends on ARCH_HAVE_RESET
	---help---
		Enables support for the BOARDIOC_RESET boardctl() command.
		Architecture specific logic must provide the board_reset()
		interface.

config BOARDCTL_UNIQUEID
	bool "Return board unique ID"
	default n
	---help---
		Enables support for the BOARDIOC_UNIQUEID boardctl() command.
		Architecture specific logic must provide the board_uniqueid()
		interface.

config BOARDCTL_UNIQUEID_SIZE
	int "Size of the board unique ID (bytes)"
	default 16
	depends on BOARDCTL_UNIQUEID
	---help---
		Provides the size of the memory buffer that must be provided by the
		caller of board_uniqueid() in which to receive the board unique ID.

endif # LIB_BOARDCTL

config BOARD_COREDUMP_FLASH
	bool "Enable crashlog dump to flash"
	default n
	---help---
		If selected it will dump the assert log information to flash.

config BOARD_FOTA_SUPPORT
	bool "Enable board support for FOTA"
	default n
	select FOTA_DRIVER
	---help---
		If selected the board provides support for FOTA.

config BOARD_RAMDUMP_FLASH
	bool "Enable ramdump to flash"
	default n
	---help---
		If selected it will dump the RAM contents to flash.

config BOARD_RAMDUMP_UART
	bool "Enable ramdump via UART"
	default n
	---help---
		If selected it will send the RAM dump via UART.

config ROMFS_SOURCE_DIR
    string "Source directory for ROMFS filesystem image"
	---help---
        ROMFS image would be built off this directory.
        Useful together wit FS_ROMFS and *_AUTOMOUNT_ROMFS options.

comment "Board-Specific Options"

if ARCH_BOARD_ARTIK053
source arch/arm/src/artik053/Kconfig
endif
if ARCH_BOARD_LM3S6965EK
source arch/arm/src/lm3s6965-ek/Kconfig
endif
if ARCH_BOARD_SIDK_S5JT200
source arch/arm/src/sidk_s5jt200/Kconfig
endif
```

## os/arch/arm/src/amebad/Kconfig
```kconfig
#
# For a description of the syntax of this configuration file,
# see kconfig-language at https://www.kernel.org/doc/Documentation/kbuild/kconfig-language.txt
#

comment "AMEBAD Configuration Options"

choice
	prompt "AMEBAD Chip Selection"
	default ARCH_CHIP_RTL8721CSM
	depends on ARCH_CHIP_AMEBAD

config ARCH_CHIP_RTL8721CSM
	bool "RTL8721CSM"
	select ARCH_CORTEXM33
	select ARCH_HAVE_FPU
	select AMEBAD_WIFI
	select ARMV8M_HAVE_ICACHE
	select ARMV8M_HAVE_DCACHE

endchoice

menu "Realtek RTL8721D Peripheral Support"

config RTL8721D_UART
	bool "UART"
	default n

config RTL8721D_UART0
	bool "UART 0"
	default n
	select RTL8721D_UART
	select ARCH_HAVE_UART0
	select ARCH_HAVE_SERIAL_TERMIOS

config RTL8721D_UART1
	bool "UART 1"
	default n
	select RTL8721D_UART
	select ARCH_HAVE_UART1
	select ARCH_HAVE_SERIAL_TERMIOS	

config RTL8721D_UART2
	bool "UART 2"
	default n
	select RTL8721D_UART
	select ARCH_HAVE_UART2
	select ARCH_HAVE_SERIAL_TERMIOS

config RTL8721D_SERIAL_FIFO
	bool "UART SERIAL FIFO"
	default n

config AMEBAD_I2S
	bool "Enable Amebad I2S"
	default n

if AMEBAD_I2S
config AMEBAD_I2S_RX
	bool "Enable I2S RX"
	default n

config AMEBAD_I2S_TX
	bool "Enable I2S TX"
	default n

config AMEBAD_I2S_16BIT_PADDING
	bool "Enable I2S 16-bit padding"
	default n
	---help---
		Enable 16-bit padding to send 16bit I2S data in 32bit word length
endif

config AMEBAD_I2C_DYNTIMEO
	bool "[Amebad I2C]Use dynamic timeouts"
	default n

config AMEBAD_I2C_DYNTIMEO_USECPERBYTE
	int "[Amebad I2C]Timeout Microseconds per Byte"
	default 500
	depends on AMEBAD_I2C_DYNTIMEO

config AMEBAD_I2C_DYNTIMEO_STARTSTOP
	int "[Amebad I2C]Timeout for Start/Stop (Milliseconds)"
	default 1000
	depends on AMEBAD_I2C_DYNTIMEO

config AMEBAD_I2CTIMEOSEC
	int "[Amebad I2C]Timeout seconds"
	default 0
	depends on !AMEBAD_I2C_DYNTIMEO

config AMEBAD_I2CTIMEOMS
	int "[Amebad I2C]Timeout Milliseconds"
	default 500
	depends on !AMEBAD_I2C_DYNTIMEO

config AMEBAD_I2CTIMEOTICKS
	int "[Amebad I2C]Timeout for Done and Stop (ticks)"
	default 500
	depends on !AMEBAD_I2C_DYNTIMEO

config RTL8721D_SPI
	bool "RTL8721D_SPI
	default n

config SPI1_MASTER
	bool "SPI1_MASTER"
	select RTL8721D_SPI
	default y

if RTL8721D_SPI
config CONFIG_SPI_CS
	bool "Multi-slaves CS pins"
	default n

config CONFIG_SPI_EXCHANGE
	bool "Enable SPI EXCHANGE"
	default y

config CONFIG_SPI_CMDDATA
	bool "Enable SPI CMDDATA"
	default y
endif

endmenu

menu "Realtek RTL8721D WIFI Support"

config AMEBAD_WIFI
	bool "Enable Amebad WIFI"
	default n
endmenu
menu "Realtek RTL8721D BLE Support"

config AMEBAD_BLE
	bool "Enable Amebad BLE"
	default n
	select FTL_ENABLED

if AMEBAD_BLE
config FTL_ENABLED
	bool "Enable FTL"
	default n

config BLE_INDICATION
	bool "Enable BLE Indication Blocking Mode"
	default n

config AMEBAD_BLE_DEBUG
	bool "Enable BLE Debug"
	default n

config AMEBAD_BLE_PERIPHERAL
	bool "Enable Amebad BLE Peripheral"
	default n

config AMEBAD_BLE_CENTRAL
	bool "Enable Amebad BLE Central"
	default n

if AMEBAD_BLE_CENTRAL && AMEBAD_BLE_PERIPHERAL
	config AMEBAD_BLE_SCATTERNET
		bool "Enable Amebad BLE Scatternet"
		default n
endif

endif

endmenu

menu "Realtek RTL8721D TrustZone Support"

config AMEBAD_TRUSTZONE
	bool "Enable Amebad TrustZone"
	default n
	select ARMV8M_TRUSTZONE

config AMEBAD_RDP
	bool "Enable Amebad RDP"
	default n
	depends on AMEBAD_TRUSTZONE
	---help---
		Enable RDP Encryption for binary.
		RDP key once written, cannot be reprogrammed.
		Can disable this for testing only TrustZone without writing RDP key.
		However, should be enabled along with TrustZone to provide binary security.
		If unsure, do not enable this.

config AMEBAD_RDP_KEY
	hex "Amebad RDP Key"
	default 0x2473040ab47c48655a15aa431c4bbb8a
	range 00000000000000000000000000000000 ffffffffffffffffffffffffffffffff
	depends on AMEBAD_RDP

endmenu

menu "Realtek RTL8721D CMSIS_NN Support"

config AMEBAD_CMSIS_NN
	bool "Enable Amebad CMSIS_NN"
	default n

endmenu
```

## os/arch/arm/src/amebalite/Kconfig
```kconfig
#
# For a description of the syntax of this configuration file,
# see kconfig-language at https://www.kernel.org/doc/Documentation/kbuild/kconfig-language.txt
#

comment "AMEBALITE Configuration Options"

choice
	prompt "AMEBALITE Chip Selection"
	default ARCH_CHIP_RTL8720E
	depends on ARCH_CHIP_AMEBALITE

config ARCH_CHIP_RTL8720E
	bool "RTL8720E"
	select ARCH_CORTEXM33
	select ARCH_HAVE_FPU
	select AMEBALITE_WIFI
	select ARMV8M_HAVE_ICACHE
	select ARMV8M_HAVE_DCACHE

endchoice

menu "Realtek RTL8720E Peripheral Support"

config RTL8720E_UART
	bool "UART"
	default n

config RTL8720E_UART0
	bool "UART 0"
	default n
	select RTL8720E_UART
	select ARCH_HAVE_UART0
	select ARCH_HAVE_SERIAL_TERMIOS

config RTL8720E_UART1
	bool "UART 1"
	default n
	select RTL8720E_UART
	select ARCH_HAVE_UART1
	select ARCH_HAVE_SERIAL_TERMIOS

config RTL8720E_UART2
	bool "UART 2"
	default n
	select RTL8720E_UART
	select ARCH_HAVE_UART2
	select ARCH_HAVE_SERIAL_TERMIOS

config RTL8720E_UART3
	bool "UART 3"
	default n
	select RTL8720E_UART
	select ARCH_HAVE_UART3
	select ARCH_HAVE_SERIAL_TERMIOS

config RTL8720E_UART4
	bool "UART 4"
	default n
	select RTL8720E_UART
	select ARCH_HAVE_UART4
	select ARCH_HAVE_SERIAL_TERMIOS
	select SERIAL_CONSOLE

config RTL8720E_SERIAL_FIFO
	bool "UART SERIAL FIFO"
	default n

endmenu

menu "Realtek RTL8720E WIFI Support"

config AMEBALITE_WIFI
	bool "Enable Amebalite WIFI"
	default n

endmenu

menu "Realtek RTL8720E BLE Support"

config AMEBALITE_BLE
	bool "Enable Amebalite BLE"
	default n
#	select FTL_ENABLED

if AMEBALITE_BLE
config FTL_ENABLED
	bool "Enable FTL"
	default n

config AMEBALITE_BLE_DEBUG
	bool "Enable BLE Debug"
	default n

config AMEBALITE_BLE_PERIPHERAL
	bool "Enable Amebalite BLE Peripheral"
	default n

config AMEBALITE_BLE_CENTRAL
	bool "Enable Amebalite BLE Central"
	default n

if AMEBALITE_BLE_CENTRAL && AMEBALITE_BLE_PERIPHERAL
	config AMEBALITE_BLE_SCATTERNET
		bool "Enable Amebalite BLE Scatternet"
		default n
endif

endif

endmenu

menu "Realtek RTL8720E TrustZone Support"

config AMEBALITE_TRUSTZONE
	bool "Enable Amebalite TrustZone"
	default n
	select ARMV8M_TRUSTZONE

endmenu
```

## os/arch/arm/src/amebasmart/Kconfig
```kconfig
#
# For a description of the syntax of this configuration file,
# see kconfig-language at https://www.kernel.org/doc/Documentation/kbuild/kconfig-language.txt
#

comment "AMEBASMART Configuration Options"

choice
	prompt "AMEBASMART Chip Selection"
	default ARCH_CHIP_RTL8730E
	depends on ARCH_CHIP_AMEBASMART

config ARCH_CHIP_RTL8730E
	bool "RTL8730E"
	select ARCH_CORTEXA32
	select ARCH_HAVE_MULTICPU
	select ARMV7A_HAVE_GICv2
	select ARCH_HAVE_FPU
	select AMEBASMART_WIFI

endchoice

menu "Realtek RTL8730E Peripheral Support"

config RTL8730E_UART
	bool "UART"
	default n

config RTL8730E_UART0
	bool "UART 0"
	default n
	select RTL8730E_UART
	select ARCH_HAVE_UART0
	select ARCH_HAVE_SERIAL_TERMIOS

config RTL8730E_UART1
	bool "UART 1"
	default n
	select RTL8730E_UART
	select ARCH_HAVE_UART1
	select ARCH_HAVE_SERIAL_TERMIOS

config RTL8730E_UART2
	bool "UART 2"
	default n
	select RTL8730E_UART
	select ARCH_HAVE_UART2
	select ARCH_HAVE_SERIAL_TERMIOS

config RTL8730E_UART3
	bool "UART 3"
	default n
	select RTL8730E_UART
	select ARCH_HAVE_UART3
	select ARCH_HAVE_SERIAL_TERMIOS

config RTL8730E_UART4
	bool "UART 4"
	default n
	select RTL8730E_UART
	select ARCH_HAVE_UART4
	select ARCH_HAVE_SERIAL_TERMIOS
	select SERIAL_CONSOLE

config RTL8730E_SERIAL_FIFO
	bool "UART SERIAL FIFO"
	default n

config AMEBASMART_SPI
	bool "AMEBASMART_SPI"
	default n
	
if AMEBASMART_SPI
config AMEBASMART_SPI0
	bool "SPI0"
	default n
config AMEBASMART_SPI1
	bool "SPI1"
	default n

config AMEBASMART_SPI_EXCHANGE
	bool "Enable AMEBASMART SPI EXCHANGE"
	default y
config AMEBASMART_SPI_DMA
	bool "SPI DMA"
	default n
	---help---
		Use DMA to improve SPI transfer performance.  Cannot be used with CONFIG_AMEBASMART_SPI_INTERRUPT.
endif


config AMEBASMART_MIPI
	bool "AMEBASMART_MIPI"
	default n
	
config AMEBASMART_I2C
	bool "AMEBASMART_I2C"
	default n

if AMEBASMART_I2C

config AMEBASMART_I2C0
	bool "I2C_0"
	default n
config AMEBASMART_I2C1
	bool "I2C_1"
	default n
config AMEBASMART_I2C2
	bool "I2C_2"
	default n

config AMEBASMART_I2C_DYNTIMEO
	bool "[AMEBASMART I2C]Use dynamic timeouts"
	default n
if AMEBASMART_I2C_DYNTIMEO
config AMEBASMART_I2C_DYNTIMEO_USECPERBYTE
	int "[AMEBASMART I2C]Timeout Microseconds per Byte"
	default 500
	depends on AMEBASMART_I2C_DYNTIMEO

config AMEBASMART_I2C_DYNTIMEO_STARTSTOP
	int "[AMEBASMART I2C]Timeout for Start/Stop (Milliseconds)"
	default 1000
	depends on AMEBASMART_I2C_DYNTIMEO
endif
config AMEBASMART_I2CTIMEOSEC
	int "[AMEBASMART I2C]Timeout seconds"
	default 0
	depends on !AMEBASMART_I2C_DYNTIMEO

config AMEBASMART_I2CTIMEOMS
	int "[AMEBASMART I2C]Timeout Milliseconds"
	default 500
	depends on !AMEBASMART_I2C_DYNTIMEO

config AMEBASMART_I2CTIMEOTICKS
	int "[AMEBASMART I2C]Timeout for Done and Stop (ticks)"
	default 500
	depends on !AMEBASMART_I2C_DYNTIMEO
endif

config AMEBASMART_I2S
	bool "Amebasmart I2S"
	default n

if AMEBASMART_I2S
config AMEBASMART_I2S2
	bool "I2S_2"
	default n
config AMEBASMART_I2S3
	bool "I2S_3"
	default n

config AMEBASMART_I2S_RX
	bool "Enable I2S RX"
	default n

config AMEBASMART_I2S_TX
	bool "Enable I2S TX"
	default n
endif
endmenu

menu "Realtek RTL8730E WIFI Support"

config AMEBASMART_WIFI
	bool "Enable Amebasmart WIFI"
	default n

endmenu

menu "Realtek RTL8730E BLE Support"

config AMEBASMART_BLE
	bool "Enable Amebasmart BLE"
	default n
	select AMEBASMART_FTL

if AMEBASMART_BLE
config AMEBASMART_FTL
	bool "Enable FTL"
	default n

config AMEBASMART_BLE_DEBUG
	bool "Enable BLE Debug"
	default n

config AMEBASMART_BLE_PERIPHERAL
	bool "Enable Amebasmart BLE Peripheral"
	default n

config AMEBASMART_BLE_CENTRAL
	bool "Enable Amebasmart BLE Central"
	default n

if AMEBASMART_BLE_CENTRAL && AMEBASMART_BLE_PERIPHERAL
	config AMEBASMART_BLE_SCATTERNET
		bool "Enable Amebasmart BLE Scatternet"
		default n
endif

endif

endmenu

menu "Realtek RTL8730E TrustZone Support"

config AMEBASMART_TRUSTZONE
	bool "Enable Amebasmart TrustZone"
	default n

endmenu
```
